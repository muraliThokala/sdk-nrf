## CMakeLists.txt
```
#
# Copyright (c) 2026 Nordic Semiconductor ASA
#
# SPDX-License-Identifier: LicenseRef-Nordic-5-Clause
#

cmake_minimum_required(VERSION 3.20.0)

find_package(Zephyr REQUIRED HINTS $ENV{ZEPHYR_BASE})
project(nrf_wifi_sr_coex)

target_sources(app PRIVATE
  src/sr_coex_main.c
  src/sr_coex_shell.c
)


if(CONFIG_NRF71_SR_COEX_DRIVER)
  target_include_directories(app PRIVATE
    ${ZEPHYR_NRF_MODULE_DIR}/drivers/nrf71_sr_coex/src
    ${ZEPHYR_NRF_MODULE_DIR}/drivers/wifi/nrf71/inc
    ${ZEPHYR_NRF_MODULE_DIR}/drivers/wifi/nrf71/inc/common/fw_if
  )
endif()
```

## Kconfig
```
#
# Copyright (c) 2026 Nordic Semiconductor ASA
#
# SPDX-License-Identifier: LicenseRef-Nordic-5-Clause
#

# Bluetooth LE controller settings. These symbols only exist in the image that contains
# the controller, which is the application image on single-core SoCs such as the nRF7120.
# They must come before Kconfig.zephyr so they take precedence over the driver defaults,
# and are set here instead of in prj.conf so that they are silently ignored when the
# controller does not support the feature.
if HAS_BT_CTLR

config BT_CTLR_DATA_LENGTH_MAX
	default 251

config BT_CTLR_PHY_2M
	default y

config BT_CTLR_PHY_CODED
	default y

endif # HAS_BT_CTLR

source "Kconfig.zephyr"

menu "Wi-Fi and Short-Range coexistence shell sample"

config COEX_SHELL_BT_INTERVAL_MIN
	int "Bluetooth LE minimum connection interval"
	range 6 3200
	default 80
	help
	  Minimum connection interval requested for the throughput test, in units of
	  1.25 ms. For example, 6 is 7.5 ms and 80 is 100 ms. The value must not be
	  larger than COEX_SHELL_BT_INTERVAL_MAX.

config COEX_SHELL_BT_INTERVAL_MAX
	int "Bluetooth LE maximum connection interval"
	range 6 3200
	default 80
	help
	  Maximum connection interval requested for the throughput test, in units of
	  1.25 ms. The connection is only updated when the current interval differs
	  from this value.

config COEX_SHELL_BT_CONN_LATENCY
	int "Bluetooth LE connection latency"
	range 0 499
	default 0
	help
	  Peripheral latency, in number of connection events that the peripheral may
	  skip. It is used for both the initial connection and the throughput test.

config COEX_SHELL_BT_SUPERVISION_TIMEOUT
	int "Bluetooth LE supervision timeout"
	range 10 3200
	default 3200
	help
	  Supervision timeout requested for the throughput test, in units of 10 ms.
	  It must be longer than twice the maximum connection interval multiplied
	  by (1 + COEX_SHELL_BT_CONN_LATENCY). This is checked at build time.

config SR_COEX_BRINGUP_IN_MAIN
	bool "Bring up the coexistence manager from main"
	depends on NRF71_SR_COEX_DRIVER
	default y
	help
	  After the network interface is up, main() waits for the Wi-Fi FMAC
	  transport and then for the coexistence driver to finish sending the
	  coexistence configuration to the Coexistence Manager on the RPU and
	  enabling it. The driver starts that sequence itself when Wi-Fi comes up.

config SR_COEX_SR_NOTIFY_IN_MAIN
	bool "Report the Short-Range radio as ready from main"
	depends on SR_COEX_BRINGUP_IN_MAIN
	default y
	help
	  Also call nrf71_sr_coex_sr_power_notify() with
	  NRF71_SR_COEX_SR_POWERED_UP_READY from main() once the CM is active, so the
	  coexistence gate opens without waiting for Bluetooth. The sample sends the
	  same notification when Bluetooth is enabled by the first bt_cfg_tput, so
	  sending it twice is harmless. Disable this to keep coexistence off until
	  Bluetooth is enabled.

endmenu
```

## Kconfig.sysbuild
```
#
# Copyright (c) 2026 Nordic Semiconductor ASA
#
# SPDX-License-Identifier: LicenseRef-Nordic-5-Clause
#

# Common nRF sysbuild options, such as SB_CONFIG_WIFI_NRF70.
source "share/sysbuild/Kconfig"

config NRF_DEFAULT_IPC_RADIO
	default y
```

## sample.yaml
```
sample:
  description: Wi-Fi and Short-Range coexistence shell sample
  name: Wi-Fi and SR coexistence shell
tests:
  sample.nrf7120.sr_coex_shell:
    sysbuild: true
    build_only: true
    integration_platforms:
      - nrf7120dk/nrf7120/cpuapp
    platform_allow: nrf7120dk/nrf7120/cpuapp
    extra_args:
      - SB_CONFIG_WIFI_NRF70=n
      - SNIPPET=nrf7120-coex
      - CONFIG_NRF71_SR_COEX_DRIVER=y
    tags:
      - ci_build
      - sysbuild
      - ci_samples_nrf71_wifi
```

## prj.conf
```kconfig
#
# Copyright (c) 2026 Nordic Semiconductor ASA
#
# SPDX-License-Identifier: LicenseRef-Nordic-5-Clause
#

# General
CONFIG_NCS_SAMPLES_DEFAULTS=y
CONFIG_ENTROPY_GENERATOR=y
CONFIG_POSIX_API=y
CONFIG_POSIX_TIMERS=y
CONFIG_INIT_STACKS=y

# Logging and shell
CONFIG_LOG=y
CONFIG_PRINTK=y
CONFIG_SHELL=y
CONFIG_SHELL_GETOPT=y
CONFIG_DEVICE_SHELL=y

# Wi-Fi
CONFIG_WIFI=y
CONFIG_NRF_WIFI_IF_AUTO_START=y

# Operating band passed to the Wi-Fi firmware. Wi-Fi shares the 2.4 GHz band with
# Bluetooth LE, so use dual band, or CONFIG_NRF_WIFI_2G_BAND=y to test only 2.4 GHz.
CONFIG_NRF_WIFI_DUAL_BAND=y

# On the nRF7120 DK, the nRF71 IPC holds commands and events (including every scan
# result) in this heap until the Wi-Fi core processes them. Going below the driver
# default of 40000 stalls "wifi scan" in a crowded environment.
CONFIG_NRF_WIFI_CTRL_HEAP_SIZE=40000
CONFIG_NRF_WIFI_DATA_HEAP_SIZE=168192

# Variable-size net bufs save RAM, but can split an IPv4/UDP header across fragments.
# Fixed-size buffers (see CONFIG_NET_BUF_FIXED_DATA_SIZE below) keep headers contiguous.
CONFIG_NRF_WIFI_USE_VARIABLE_NET_BUFS=n

# WPA supplicant
CONFIG_WIFI_NM_WPA_SUPPLICANT=y
CONFIG_WIFI_NM_WPA_SUPPLICANT_LOG_LEVEL_INF=y

# Wi-Fi credentials. The static credentials are placeholders; connect with the
# "wifi connect" command.
CONFIG_WIFI_CREDENTIALS=y
CONFIG_WIFI_CREDENTIALS_STATIC=y
CONFIG_WIFI_CREDENTIALS_STATIC_SSID="Myssid"
CONFIG_WIFI_CREDENTIALS_STATIC_PASSWORD="Mypassword"

# Settings storage
CONFIG_FLASH=y
CONFIG_FLASH_PAGE_LAYOUT=y
CONFIG_FLASH_MAP=y
CONFIG_NVS=y
CONFIG_SETTINGS=y
CONFIG_SETTINGS_NVS=y

# Networking
CONFIG_NETWORKING=y
CONFIG_NET_L2_ETHERNET=y
CONFIG_NET_SOCKETS=y
CONFIG_NET_LOG=y
CONFIG_NET_IPV6=y
CONFIG_NET_IPV4=y
CONFIG_NET_UDP=y
CONFIG_NET_TCP=y
CONFIG_NET_DHCPV4=y
CONFIG_DNS_RESOLVER=y
CONFIG_NET_CONTEXT_SYNC_RECV=y
CONFIG_NET_MAX_CONTEXTS=8
CONFIG_NET_IF_UNICAST_IPV4_ADDR_COUNT=2
CONFIG_NET_IF_UNICAST_IPV6_ADDR_COUNT=4
CONFIG_NET_IF_MCAST_IPV6_ADDR_COUNT=5
CONFIG_ZVFS_POLL_MAX=12
CONFIG_ZVFS_OPEN_MAX=16

# Net management. Printing of scan results puts pressure on the queues in the new
# locking design in net_mgmt, so use a higher timeout for a crowded environment.
CONFIG_NET_MGMT_EVENT_QUEUE_TIMEOUT=5000
CONFIG_NET_MGMT_EVENT_QUEUE_SIZE=16

# Zephyr NET Connection Manager Connectivity layer
CONFIG_NET_CONNECTION_MANAGER=y
CONFIG_NET_CONNECTION_MANAGER_MONITOR_STACK_SIZE=5000
CONFIG_L2_WIFI_CONNECTIVITY=y
CONFIG_L2_WIFI_CONNECTIVITY_AUTO_CONNECT=n
CONFIG_L2_WIFI_CONNECTIVITY_AUTO_DOWN=n

# Network statistics and shell commands
CONFIG_NET_STATISTICS=y
CONFIG_NET_STATISTICS_WIFI=y
CONFIG_NET_STATISTICS_USER_API=y
CONFIG_NET_SHELL=y
CONFIG_NET_L2_WIFI_SHELL=y

# Wi-Fi is the default interface. main() calls net_config_init_app() on it, which
# assigns the static address and starts DHCP. The timeout of 0 keeps main() from
# blocking while it waits.
CONFIG_NET_CONFIG_SETTINGS=y
CONFIG_NET_CONFIG_INIT_TIMEOUT=0
CONFIG_NET_CONFIG_MY_IPV4_ADDR="192.168.1.99"
CONFIG_NET_CONFIG_MY_IPV4_NETMASK="255.255.255.0"
CONFIG_NET_CONFIG_MY_IPV4_GW="192.168.1.1"

# main() already calls net_config_init_app() on the Wi-Fi interface, so skip the
# automatic call at boot.
CONFIG_NET_CONFIG_AUTO_INIT=n

# Network buffers, tuned for throughput
CONFIG_NET_TC_TX_COUNT=1
CONFIG_NET_PKT_RX_COUNT=8
CONFIG_NET_PKT_TX_COUNT=24
CONFIG_NET_BUF_RX_COUNT=8
CONFIG_NET_BUF_TX_COUNT=24
CONFIG_NET_BUF_FIXED_DATA_SIZE=y
CONFIG_NET_BUF_DATA_SIZE=1600

# Wi-Fi throughput (zperf)
CONFIG_NET_ZPERF=y
CONFIG_NET_ZPERF_MAX_PACKET_SIZE=1024

# Memory
CONFIG_HEAP_MEM_POOL_SIZE=41808
CONFIG_MBEDTLS_HEAP_SIZE=1024
CONFIG_MAIN_STACK_SIZE=8192
CONFIG_SHELL_STACK_SIZE=5200
CONFIG_NET_TX_STACK_SIZE=4096
CONFIG_NET_RX_STACK_SIZE=4096
CONFIG_BT_RX_STACK_SIZE=4096
CONFIG_BT_LONG_WQ_STACK_SIZE=2560

# Bluetooth LE
CONFIG_BT=y
CONFIG_BT_DEVICE_NAME="Nordic_Throughput"
CONFIG_BT_SMP=y
CONFIG_BT_BONDABLE=n
CONFIG_BT_PERIPHERAL=y
CONFIG_BT_CENTRAL=y
CONFIG_BT_MAX_CONN=2

CONFIG_BT_SCAN=y
CONFIG_BT_SCAN_FILTER_ENABLE=y
CONFIG_BT_SCAN_UUID_CNT=1

CONFIG_BT_GATT_CLIENT=y
CONFIG_BT_GATT_DM=y
CONFIG_BT_THROUGHPUT=y

# The sample drives the data length and PHY updates itself. Leaving the host's
# automatic PHY update enabled makes both run at connection, and the second one gets
# 0x3a (busy).
CONFIG_BT_USER_DATA_LEN_UPDATE=y
CONFIG_BT_USER_PHY_UPDATE=y
CONFIG_BT_AUTO_PHY_CENTRAL_NONE=y
CONFIG_BT_GAP_AUTO_UPDATE_CONN_PARAMS=n

# Bluetooth LE buffers
CONFIG_BT_BUF_ACL_RX_SIZE=502
CONFIG_BT_BUF_ACL_TX_SIZE=502
CONFIG_BT_BUF_ACL_TX_COUNT=10
CONFIG_BT_BUF_EVT_RX_COUNT=11
CONFIG_BT_ATT_PREPARE_COUNT=2
CONFIG_BT_ATT_TX_COUNT=10
CONFIG_BT_CONN_TX_MAX=10
CONFIG_BT_L2CAP_TX_BUF_COUNT=10
CONFIG_BT_L2CAP_TX_MTU=498
CONFIG_BT_L2CAP_DYNAMIC_CHANNEL=y

# The Bluetooth LE controller data length and PHY defaults are set in Kconfig so
# they only apply to the image that contains the controller.

# Frame Space Update renegotiates T_IFS.
CONFIG_BT_FRAME_SPACE_UPDATE=n
CONFIG_BT_LE_EXTENDED_FEAT_SET=n

# Debugging
CONFIG_STACK_SENTINEL=y
CONFIG_DEBUG_COREDUMP=y
CONFIG_DEBUG_COREDUMP_BACKEND_LOGGING=y
CONFIG_DEBUG_COREDUMP_MEMORY_DUMP_MIN=y

# Set to y (with CONFIG_THREAD_ANALYZER_AUTO=y) to print thread stack usage.
# Use CONFIG_THREAD_ANALYZER_AUTO_INTERVAL (in seconds) to control the interval
# between the two successive prints.
CONFIG_THREAD_ANALYZER=n

# Wi-Fi and Short-Range coexistence. The driver programs the on-chip Coexistence
# Controller (COEXC) and configures the Coexistence Manager each time the Wi-Fi
# interface comes up. The coexistence bring-up in main() and the coex_enable_wifi_sr
# and coex_disable_wifi_sr commands need it.
CONFIG_NRF71_SR_COEX_DRIVER=y

# MPSL radio coexistence interface. The Bluetooth LE controller then requests the
# radio through the coexistence arbiter before each radio activity, so Wi-Fi and
# Bluetooth LE do not use the shared 2.4 GHz band at the same time.
CONFIG_MPSL_CX=y
```

## socs/nrf7120_cpuapp.overlay
```dts
/*
 * Copyright (c) 2026 Nordic Semiconductor ASA
 *
 * SPDX-License-Identifier: LicenseRef-Nordic-5-Clause
 */

/* Define the nRF7120 Wi-Fi ROM patch regions that CONFIG_WIFI_NRF71_PATCH expects. */
#include "../../../../../nrfxlib/nrf71_wifi/bins/0.1.0/nrf7120_wifi_patch.dtsi"
```

## src/ble_coex_main.c
```c
/*
 * Copyright (c) 2025 Nordic Semiconductor ASA
 *
 * SPDX-License-Identifier: LicenseRef-Nordic-5-Clause
 */

/** @file
 * @brief Wi-Fi and Bluetooth LE coexistence sample
 */

#include <zephyr/sys/printk.h>
#include <zephyr/kernel.h>
#if defined(CONFIG_NRFX_CLOCK_HFCLK) &&                                                            \
	(defined(CLOCK_FEATURE_HFCLK_DIVIDE_PRESENT) || NRF_CLOCK_HAS_HFCLK192M)
#include <nrfx_clock_hfclk.h>
#endif
#include <zephyr/device.h>
#include <zephyr/net/net_if.h>
#include <zephyr/net/net_config.h>

int main(void)
{
#if defined(CONFIG_NRFX_CLOCK_HFCLK) &&                                                            \
	(defined(CLOCK_FEATURE_HFCLK_DIVIDE_PRESENT) || NRF_CLOCK_HAS_HFCLK192M)
	/* For now hardcode to 128MHz */
	nrfx_clock_hfclk_divider_set(NRF_CLOCK_HFCLK_DIV_1);
#endif
	printk("Starting %s with CPU frequency: %d MHz\n", CONFIG_BOARD, SystemCoreClock / MHZ(1));

#if defined(CONFIG_NET_CONFIG_SETTINGS) && defined(CONFIG_WIFI)
	/* Without this, DHCPv4 starts on first interface and if that is not Wi-Fi or
	 * only supports IPv6, then its an issue. (E.g., OpenThread)
	 *
	 * So, we start DHCPv4 on Wi-Fi interface always, independent of the ordering.
	 */
	const struct device *dev = DEVICE_DT_GET(DT_CHOSEN(zephyr_wifi));
	struct net_if *wifi_iface = net_if_lookup_by_dev(dev);

	if (!wifi_iface) {
		printk("No network interface for the Wi-Fi device\n");
		return -ENODEV;
	}

	/* As both are Ethernet, we need to set specific interface */
	net_if_set_default(wifi_iface);

	net_config_init_app(dev, "Initializing network");
#endif

	return 0;
}
```

## src/sr_coex_main.c
```c
/*
 * Copyright (c) 2026 Nordic Semiconductor ASA
 *
 * SPDX-License-Identifier: LicenseRef-Nordic-5-Clause
 */

/** @file
 * @brief Wi-Fi and Short-Range coexistence sample
 */

#include <errno.h>
#include <stdbool.h>
#include <stdint.h>
#include <string.h>

#include <zephyr/device.h>
#include <zephyr/kernel.h>
#include <zephyr/net/net_config.h>
#include <zephyr/net/net_if.h>
#include <zephyr/sys/printk.h>
#include <zephyr/sys/util.h>

#if defined(CONFIG_NRFX_CLOCK_HFCLK) &&                                                            \
	(defined(CLOCK_FEATURE_HFCLK_DIVIDE_PRESENT) || NRF_CLOCK_HAS_HFCLK192M)
#include <nrfx_clock_hfclk.h>
#endif

#ifdef CONFIG_SR_COEX_BRINGUP_IN_MAIN
/* Wi-Fi FMAC coexistence transport, used to wait until CM commands can be sent. */
#include <drivers/wifi/nrf71/nrf71_wifi_coex.h>
/* Coexistence driver SR notification API and its CM configuration state. */
#include <drivers/nrf71_sr_coex/nrf71_sr_coex_sr.h>
#include "nrf71_sr_coex_internal.h"

/** Interval between polls while waiting for the Wi-Fi FMAC transport, in milliseconds. */
#define COEX_POLL_INTERVAL_MS 100U

/** Consecutive ready polls required before the transport is trusted. */
#define COEX_TRANSPORT_STABLE_POLLS 5U

/** Give up waiting for the Wi-Fi transport or the network interface after this long. */
#define COEX_TRANSPORT_TIMEOUT_MS 60000U

/** Poll until the Wi-Fi FMAC coexistence transport reports ready. */
static int coex_wait_transport_ready(void)
{
	uint32_t elapsed_ms = 0U;
	unsigned int stable_polls = 0U;

	while (stable_polls < COEX_TRANSPORT_STABLE_POLLS) {
		if (elapsed_ms >= COEX_TRANSPORT_TIMEOUT_MS) {
			printk("Coex: Wi-Fi transport not ready after %u ms (%d)\n", elapsed_ms,
			       -ETIMEDOUT);
			return -ETIMEDOUT;
		}

		if (nrf71_wifi_coex_is_ready()) {
			stable_polls++;
		} else {
			stable_polls = 0U;
		}

		k_msleep(COEX_POLL_INTERVAL_MS);
		elapsed_ms += COEX_POLL_INTERVAL_MS;
	}

	printk("Coex: Wi-Fi transport stable after %u ms\n", elapsed_ms);

	return 0;
}

/*
 * Wait for administrative up only. The nRF71 driver keeps the interface dormant
 * until a Wi-Fi association, so net_if_is_up() stays false while unassociated.
 */
static int coex_wait_net_if_up(void)
{
	uint32_t elapsed_ms = 0U;

	while (elapsed_ms < COEX_TRANSPORT_TIMEOUT_MS) {
		struct net_if *iface = net_if_get_default();

		if ((iface != NULL) && net_if_is_admin_up(iface)) {
			printk("Coex: network interface admin up after %u ms\n", elapsed_ms);
			return 0;
		}

		k_msleep(COEX_POLL_INTERVAL_MS);
		elapsed_ms += COEX_POLL_INTERVAL_MS;
	}

	printk("Coex: network interface not admin up after %u ms (%d)\n",
	       COEX_TRANSPORT_TIMEOUT_MS, -ETIMEDOUT);

	return -ETIMEDOUT;
}

/*
 * The driver runs the CM bring-up itself when the Wi-Fi interface comes up, so
 * wait for it to report the CM as active.
 */
static int coex_wait_cm_active(void)
{
	uint32_t elapsed_ms = 0U;

	while (elapsed_ms < COEX_TRANSPORT_TIMEOUT_MS) {
		const char *state = cd_wifi_state_name();

		if (strcmp(state, "active") == 0) {
			printk("Coex: CM active after %u ms\n", elapsed_ms);
			return 0;
		}

		if (strcmp(state, "failed") == 0) {
			printk("Coex: CM configuration failed (%d)\n", -EIO);
			return -EIO;
		}

		k_msleep(COEX_POLL_INTERVAL_MS);
		elapsed_ms += COEX_POLL_INTERVAL_MS;
	}

	printk("Coex: CM not active after %u ms (%d)\n", COEX_TRANSPORT_TIMEOUT_MS,
	       -ETIMEDOUT);

	return -ETIMEDOUT;
}

/**
 * Wait until the coexistence driver has configured the CM, then report the SR
 * radio as ready.
 *
 * On Wi-Fi interface up the driver runs the full CM bring-up sequence: COEXC
 * tables, priority ranges, user params, coex params and finally enable, each
 * waiting for its completion event. This waits for the Wi-Fi FMAC transport,
 * the network interface and then for that sequence to finish.
 *
 * The SR notification, when enabled with CONFIG_SR_COEX_SR_NOTIFY_IN_MAIN,
 * enables coexistence in the SR driver and opens the driver's runtime
 * coexistence gate. The sample also sends it when Bluetooth is enabled, so it is
 * harmless to send it twice.
 */
static int coex_init_and_enable(void)
{
	int ret;

	ret = coex_wait_transport_ready();
	if (ret != 0) {
		return ret;
	}

	ret = coex_wait_net_if_up();
	if (ret != 0) {
		return ret;
	}

	ret = coex_wait_cm_active();
	if (ret != 0) {
		return ret;
	}

#ifdef CONFIG_SR_COEX_SR_NOTIFY_IN_MAIN
	ret = nrf71_sr_coex_sr_power_notify(NRF71_SR_COEX_SR_POWERED_UP_READY);
	if (ret != 0) {
		printk("Coex: SR power notify failed: %d\n", ret);
		return ret;
	}

	printk("Coex: SR power notify accepted\n");
#endif /* CONFIG_SR_COEX_SR_NOTIFY_IN_MAIN */

	printk("Coex: radios reported ready\n");

	return 0;
}
#endif /* CONFIG_SR_COEX_BRINGUP_IN_MAIN */

int main(void)
{
#if defined(CONFIG_NRFX_CLOCK_HFCLK) &&                                                            \
	(defined(CLOCK_FEATURE_HFCLK_DIVIDE_PRESENT) || NRF_CLOCK_HAS_HFCLK192M)
	/* Run the CPU at the full HFCLK frequency, without a divider. */
	nrfx_clock_hfclk_divider_set(NRF_CLOCK_HFCLK_DIV_1);
#endif
	printk("Starting %s with CPU frequency: %u MHz\n", CONFIG_BOARD,
	       (unsigned int)(SystemCoreClock / MHZ(1)));

#ifdef CONFIG_SR_COEX_BRINGUP_IN_MAIN
	/*
	 * The coexistence driver initialises itself at boot (SYS_INIT), so there is no
	 * init call here. A failure is not fatal: the shell stays usable, but
	 * coexistence stays disabled.
	 */
	if (coex_init_and_enable() != 0) {
		printk("Coex: bring-up failed, coexistence is not enabled\n");
	}
#endif

#if defined(CONFIG_NET_CONFIG_SETTINGS) && defined(CONFIG_WIFI)
	/*
	 * Without this, DHCPv4 starts on first interface and if that is not Wi-Fi or
	 * only supports IPv6, then it is an issue. (E.g., OpenThread)
	 *
	 * So, we start DHCPv4 on Wi-Fi interface always, independent of the ordering.
	 */
	const struct device *dev = DEVICE_DT_GET(DT_CHOSEN(zephyr_wifi));
	struct net_if *wifi_iface = net_if_lookup_by_dev(dev);

	if (!wifi_iface) {
		printk("No network interface for the Wi-Fi device\n");
		return -ENODEV;
	}

	/* As both are Ethernet, we need to set specific interface */
	net_if_set_default(wifi_iface);

	net_config_init_app(dev, "Initializing network");
#endif



	return 0;
}
```
