## CMakeLists.txt
```
#
# Copyright (c) 2022 Nordic Semiconductor ASA
#
# SPDX-License-Identifier: LicenseRef-Nordic-5-Clause
#

cmake_minimum_required(VERSION 3.20.0)

set(DTC_OVERLAY_FILE "dts.overlay")

find_package(Zephyr REQUIRED HINTS $ENV{ZEPHYR_BASE})
project(nrf_wifi_ble_coex)

target_sources(app PRIVATE
	src/bt_utils.c
	src/bt_coex_test_functions.c
	src/main.c
)

# For net_private.h
target_include_directories(app PUBLIC
	${ZEPHYR_BASE}/subsys/net/ip
)

zephyr_library_include_directories(${ZEPHYR_BASE}/samples/bluetooth)
```

## Kconfig
```
#
# Copyright (c) 2022 Nordic Semiconductor
#
# SPDX-License-Identifier: LicenseRef-Nordic-5-Clause
#

source "Kconfig.zephyr"

menu "Nordic Coex sample"

choice TEST_TYPE
	prompt "Test type"
	default TEST_TYPE_WLAN_BLE

config TEST_TYPE_WLAN_ONLY
	bool "WLAN only"
	help
	  Enable WLAN only

config TEST_TYPE_BLE_ONLY
	bool "BLE only"
	help
	  Enable BLE only

config TEST_TYPE_WLAN_BLE
	bool "WLAN and BLE"
	help
	  Enable WLAN and BLE

endchoice

config TEST_TYPE_WLAN
	bool "WLAN"
	default y if TEST_TYPE_WLAN_ONLY || TEST_TYPE_WLAN_BLE
	select WIFI
	help
	  Enable WLAN

config TEST_TYPE_BLE
	bool "BLE"
	default y if TEST_TYPE_BLE_ONLY || TEST_TYPE_WLAN_BLE
	help
	  Enable BLE

config STA_SSID
	string "SSID"
	default "wifi_sr_coex_24"
	help
	  Specify the SSID to connect

choice  STA_KEY_MGMT_SELECT
	prompt "Security Option"
	default STA_KEY_MGMT_NONE

config STA_KEY_MGMT_NONE
	bool "Open Security"
	help
	  Enable for Open Security

config STA_KEY_MGMT_WPA2
	bool "WPA2 Security"
	help
	  Enable for WPA2 Security

config STA_KEY_MGMT_WPA2_256
	bool "WPA2 SHA 256 Security"
	help
	  Enable for WPA2-PSK-256 Security

config STA_KEY_MGMT_WPA3
	bool "WPA3 Security"
	help
	  Enable for WPA3 Security
endchoice

config STA_PASSWORD
	string "Passphrase (WPA2) or password (WPA3)"
	help
	  Specify the Password to connect

config NET_CONFIG_PEER_IPV4_ADDR
	string "Peer IPv4 address"
	default "192.168.1.253"

config NET_CONFIG_PEER_IPV4_PORT
	int "Peer IPv4 port"
	default 5001

config WIFI_THREAD_STACK_SIZE
	int "Wi-Fi thread stack size"
	default 4096

config WIFI_THREAD_PRIORITY
	int "Wi-Fi thread priority"
	default 5

config WIFI_ZPERF_SERVER
	bool "Zperf role: server or client"
	default n

config WIFI_ZPERF_PROT_UDP
	bool "UDP or TCP"
	default y

config WIFI_ZPERF_PKT_SIZE
	int "packet size"
	default 1024

config WIFI_ZPERF_RATE
	int "rate in kbps"
	default 10000

config INTERVAL_MIN
	int "BLE min connection interval. Each unit 1.25milliseconds"
	default 80

config INTERVAL_MAX
	int "BLE max connection interval. Each unit 1.25milliseconds"
	default 80

config COEX_ENABLE
	bool "Control if coexistence HW is enable"
	default y

config COEX_WLAN_2PT4G
	bool "Indicates if WLAN operating band is 2.4GHz or 5GHz"
	default y

config WIFI_TEST_DURATION
	int "test duration in milliseconds"
	default 20000

config BLE_TEST_DURATION
	int "test duration in milliseconds"
	default 20000

config COEX_BT_CENTRAL
	bool "BT device role"
	default y

config COEX_SEP_ANTENNAS
	bool "Control if the antennas are shared/serparate for BT and WLAN"
	default y

config WIFI_COEX_ENABLE
	bool "Indicates if Wi-Fi posts requests to PTA"
	default y

config RPU_ENABLE
	bool "Indicates if PRU is enable"
	default y

config BT_GAP_ADV_FAST_INT_MIN_2
	int "BT GAP ADV interval min value. Each unit 0.625milliseconds"
	default 160

config BT_GAP_ADV_FAST_INT_MAX_2
	int "BT GAP ADV interval max value. Each unit 0.625milliseconds"
	default 240

config BT_LE_SCAN_INTERVAL
	int "BT LE Scan interval  value. Each unit is 0.625milliseconds."
	default 16

config BT_LE_SCAN_WINDOW
	int "BT LE Scan Window value. Each unit is 0.625milliseconds."
	default 16

config COEX_HARDWARE_ENABLE
	bool "Indicates if COEX hardware module enabled"
	default y


config BT_EXTERNAL_ANTENNA
	bool "Indicates if external antenna used for BT"
	default n

rsource "test/Kconfig"
endmenu
```

## prj.conf
```kconfig
#
# Copyright (c) 2022 Nordic Semiconductor ASA
#
# SPDX-License-Identifier: LicenseRef-Nordic-5-Clause
#

CONFIG_WIFI=y
CONFIG_WIFI_NRF700X=y

# WPA supplicant
CONFIG_WPA_SUPP=y

# System settings
CONFIG_NEWLIB_LIBC=y
CONFIG_NEWLIB_LIBC_NANO=n

# Networking
CONFIG_NETWORKING=y
CONFIG_NET_SOCKETS=y
CONFIG_NET_LOG=y
CONFIG_NET_IPV4=y
CONFIG_NET_UDP=y
CONFIG_NET_TCP=y
CONFIG_NET_DHCPV4=y


CONFIG_NET_IF_UNICAST_IPV4_ADDR_COUNT=2
CONFIG_NET_MAX_CONTEXTS=8
CONFIG_NET_CONTEXT_SYNC_RECV=y

CONFIG_INIT_STACKS=y

CONFIG_NET_L2_ETHERNET=y

CONFIG_NET_CONFIG_SETTINGS=y
CONFIG_NET_CONFIG_INIT_TIMEOUT=0

CONFIG_NET_SOCKETS_POLL_MAX=6

# Memories
CONFIG_MAIN_STACK_SIZE=4096
CONFIG_SYSTEM_WORKQUEUE_STACK_SIZE=2048
CONFIG_NET_TX_STACK_SIZE=4096
CONFIG_NET_RX_STACK_SIZE=4096

# Debugging
CONFIG_STACK_SENTINEL=y
CONFIG_DEBUG_COREDUMP=y
CONFIG_DEBUG_COREDUMP_BACKEND_LOGGING=y
CONFIG_DEBUG_COREDUMP_MEMORY_DUMP_MIN=y

# Kernel options
CONFIG_ENTROPY_GENERATOR=y

# Logging
CONFIG_LOG=y
CONFIG_PRINTK=y
CONFIG_POSIX_CLOCK=y

# Benchmarking
CONFIG_NET_ZPERF=y
CONFIG_POSIX_MAX_FDS=16

# Optimized networking settings for performance
CONFIG_NET_TC_TX_COUNT=1
CONFIG_NET_PKT_RX_COUNT=2
CONFIG_NET_PKT_TX_COUNT=4
CONFIG_NET_BUF_RX_COUNT=2
CONFIG_NET_BUF_TX_COUNT=8
CONFIG_HEAP_MEM_POOL_SIZE=200000
CONFIG_NET_BUF_DATA_SIZE=1100

# Below configs need to be modified based on security
# CONFIG_STA_KEY_MGMT_NONE=y
# CONFIG_STA_KEY_MGMT_WPA2=y
# CONFIG_STA_KEY_MGMT_WPA2_256=y
# CONFIG_STA_KEY_MGMT_WPA3=y
CONFIG_STA_SAMPLE_SSID="wifi_sr_coex_24"
CONFIG_STA_SAMPLE_PASSWORD="Mypassword"

CONFIG_NET_CONFIG_MY_IPV4_ADDR="192.168.1.99"
CONFIG_NET_CONFIG_MY_IPV4_NETMASK="255.255.255.0"
CONFIG_NET_CONFIG_MY_IPV4_GW="192.168.1.1"

# DUT zperf configuration
CONFIG_WIFI_ZPERF_PROT_UDP=y
CONFIG_WIFI_ZPERF_PKT_SIZE=1024
CONFIG_WIFI_ZPERF_RATE=10000
CONFIG_WIFI_ZPERF_SERVER=n

CONFIG_BT_DEVICE_NAME="Nordic_Throughput"
CONFIG_BT=y
CONFIG_BT_SMP=y
CONFIG_BT_PERIPHERAL=y
CONFIG_BT_CENTRAL=y
CONFIG_BT_MAX_CONN=2

CONFIG_BT_SCAN=y
CONFIG_BT_SCAN_FILTER_ENABLE=y
CONFIG_BT_SCAN_UUID_CNT=1

CONFIG_BT_GATT_CLIENT=y
CONFIG_BT_GATT_DM=y
CONFIG_BT_THROUGHPUT=y

CONFIG_BT_USER_DATA_LEN_UPDATE=y
CONFIG_BT_USER_PHY_UPDATE=y
CONFIG_BT_GAP_AUTO_UPDATE_CONN_PARAMS=n

CONFIG_BT_BUF_ACL_RX_SIZE=502
CONFIG_BT_ATT_PREPARE_COUNT=2
CONFIG_BT_CONN_TX_MAX=10
CONFIG_BT_L2CAP_TX_BUF_COUNT=10
CONFIG_BT_L2CAP_TX_MTU=498
CONFIG_BT_BUF_ACL_TX_SIZE=502
CONFIG_BT_L2CAP_DYNAMIC_CHANNEL=y

CONFIG_DK_LIBRARY=y
CONFIG_DK_LIBRARY_DYNAMIC_BUTTON_HANDLERS=y
CONFIG_NRF700X_MAX_TX_PENDING_QLEN=12
CONFIG_NRF700X_QSPI_LOW_POWER=n
```

## src/main.c
```c
/**
 * Copyright (c) 2022 Nordic Semiconductor ASA
 *
 * SPDX-License-Identifier: LicenseRef-Nordic-5-Clause
 */

/** @file
 * @brief SR coexistence sample test bench
 */

#include <stdio.h>
#include <stdlib.h>
#include <string.h>
#include <stdbool.h>

/*#include "common.h"*/
#include "main.h"

#include <nrfx_clock.h>

#if !defined(BLE_PEER_THROUGHPUT_TEST) && !defined(BLE_PEER_CONN_CENTRAL_TEST)
#include "zephyr_fmac_main.h"
#endif

#include <zephyr/logging/log.h>
LOG_MODULE_REGISTER(main, CONFIG_LOG_DEFAULT_LEVEL);

#if !defined(BLE_PEER_THROUGHPUT_TEST) && !defined(BLE_PEER_CONN_CENTRAL_TEST)
void print_test_params_info(bool test_wlan, bool test_ble,
				bool antenna_mode, bool ble_role, bool wifi_coex_enable,
				bool ble_coex_enable, bool coex_hardware_enable)
{
	if (test_wlan && test_ble) {
		if (coex_hardware_enable) {
			LOG_INF("Running WLAN and BLE tests with coex hardware enable");
		} else {
			LOG_INF("Running WLAN and BLE tests with coex hardware disable");
		}
	} else {
		if (test_wlan) {
			LOG_INF("Running WLAN only test");
		} else {
			LOG_INF("Running BLE only test");
		}
	}
	if (antenna_mode) {
		LOG_INF("Antenna mode : Separate antennas");
	} else {
		LOG_INF("Antenna mode : Shared antennas");
	}

	if (ble_role) {
		LOG_INF("BLE role : Central");
	} else {
		LOG_INF("BLE role : Peripheral");
	}

	if (wifi_coex_enable) {
		LOG_INF("WLAN posts requests to PTA");
	} else {
		LOG_INF("WLAN doesn't post requests to PTA");
	}

	if (ble_coex_enable) {
		LOG_INF("BLE posts requests to PTA");
	} else {
		LOG_INF("BLE doesn't post requests to PTA");
	}
	if (IS_ENABLED(CONFIG_RPU_ENABLE)) {
		LOG_INF("RPU enabled");
	} else {
		LOG_INF("RPU disabled");
	}
}


void net_mgmt_event_handler(struct net_mgmt_event_callback *cb,
				    uint32_t mgmt_event, struct net_if *iface)
{
	switch (mgmt_event) {
	case NET_EVENT_IPV4_DHCP_BOUND:
		print_dhcp_ip(cb);
		break;
	default:
		break;
	}
}

void wifi_mgmt_event_handler(struct net_mgmt_event_callback *cb,
				uint32_t mgmt_event, struct net_if *iface)
{
	const struct device *dev = iface->if_dev->dev;
	struct wifi_nrf_vif_ctx_zep *vif_ctx_zep = NULL;

	vif_ctx_zep = dev->data;

	switch (mgmt_event) {
	case NET_EVENT_WIFI_CONNECT_RESULT:
		handle_wifi_connect_result(cb);
		break;
	case NET_EVENT_WIFI_DISCONNECT_RESULT:
		handle_wifi_disconnect_result(cb);
		break;
	case NET_EVENT_WIFI_SCAN_RESULT:
		vif_ctx_zep->scan_in_progress = 0;
		handle_wifi_scan_result(cb);
		break;
	case NET_EVENT_WIFI_SCAN_DONE:
		handle_wifi_scan_done(cb);
		break;
	default:
		break;
	}
}
#endif

int main(void)
{

#if defined(BLE_PEER_THROUGHPUT_TEST) || defined(BLE_PEER_CONN_CENTRAL_TEST)
#ifdef BLE_PEER_THROUGHPUT_TEST
	LOG_INF("BLE peer throughput test");
#else
	LOG_INF("BLE peer connection-central test");
#endif
	ble_peer_tp_conn();
#endif

#if !defined(BLE_PEER_THROUGHPUT_TEST) && !defined(BLE_PEER_CONN_CENTRAL_TEST)

	int ret = 0;
	bool wifi_coex_enable = IS_ENABLED(CONFIG_WIFI_COEX_ENABLE);
	bool ble_coex_enable = IS_ENABLED(CONFIG_MPSL_CX);
	bool coex_hardware_enable = IS_ENABLED(CONFIG_COEX_HARDWARE_ENABLE);
	bool antenna_mode = IS_ENABLED(CONFIG_COEX_SEP_ANTENNAS);
	bool ble_role = IS_ENABLED(CONFIG_COEX_BT_CENTRAL);
	bool wlan_role = IS_ENABLED(CONFIG_WIFI_ZPERF_SERVER);

	bool test_wlan = IS_ENABLED(CONFIG_TEST_TYPE_WLAN);
	bool test_ble = IS_ENABLED(CONFIG_TEST_TYPE_BLE);

	bool wifi_connected_scan = 
			IS_ENABLED(CONFIG_WIFI_CON_SCAN_BLE_CON_CENTRAL) ||
			IS_ENABLED(CONFIG_WIFI_CON_SCAN_BLE_CON_PERIPH) ||
			IS_ENABLED(CONFIG_WIFI_CON_SCAN_BLE_TP_CENTRAL) ||
			IS_ENABLED(CONFIG_WIFI_CON_SCAN_BLE_TP_PERIPH);

#if !defined(CONFIG_BOARD_NRF7002DK_NRF5340_CPUAPP) && !defined(CONFIG_COEX_SEP_ANTENNAS)
	BUILD_ASSERT("Shared antenna support is not available with nRF7002 shields");
#endif

	memset_context();

	net_mgmt_init_event_callback(&wifi_sta_mgmt_cb,
				wifi_mgmt_event_handler,
				WIFI_MGMT_EVENTS);

	net_mgmt_add_event_callback(&wifi_sta_mgmt_cb);

	net_mgmt_init_event_callback(&net_addr_mgmt_cb,
				net_mgmt_event_handler,
				NET_EVENT_IPV4_DHCP_BOUND);

	net_mgmt_add_event_callback(&net_addr_mgmt_cb);

#ifdef CLOCK_FEATURE_HFCLK_DIVIDE_PRESENT
	nrfx_clock_divider_set(NRF_CLOCK_DOMAIN_HFCLK, NRF_CLOCK_HFCLK_DIV_1);
#endif

	LOG_INF("Starting %s with CPU frequency: %d MHz", CONFIG_BOARD,
				SystemCoreClock/MHZ(1));
	k_sleep(K_SECONDS(1));

	print_test_params_info(test_wlan, test_ble, antenna_mode, ble_role,
				wifi_coex_enable, ble_coex_enable, coex_hardware_enable);

#ifdef CONFIG_NRF700X_BT_COEX
	/* Configure SR side (nRF5340 side) switch in nRF7002 DK */
	LOG_INF("Configure SR side (nRF5340 side) switch");
	ret = nrf_wifi_config_sr_switch(antenna_mode);
	if (ret != 0) {
		LOG_ERR("Unable to configure SR side switch: %d", ret);
		goto err;
	}

	/* Configure Coexistence Hardware non-PTA registers */
	LOG_INF("Configuring non-PTA registers.");
	ret = nrf_wifi_coex_config_non_pta(antenna_mode);
	if (ret != 0) {
		LOG_ERR("Configuring non-PTA registers of CoexHardware FAIL");
		goto err;
	}
#endif /* CONFIG_NRF700X_BT_COEX */

	/**if (!(IS_ENABLED(CONFIG_RPU_ENABLE))) {
	 *	LOG_INF("RPU disabled");
	 *	rpu_disable();
	 *}
	 */

	if (IS_ENABLED(CONFIG_WIFI_SCAN_BLE_CON_CENTRAL) ||
		IS_ENABLED(CONFIG_WIFI_CON_SCAN_BLE_CON_CENTRAL)) {
		LOG_INF("Test case: wifi_scan_ble_conn_central");
		ret = wifi_scan_ble_conn_central(wifi_coex_enable, antenna_mode, test_ble,
				test_wlan, ble_role, wlan_role, coex_hardware_enable,
				wifi_connected_scan);
		if (ret != 0) {
			LOG_ERR("Running wifi_scan_ble_conn_central fail");
			goto err;
		}
	}

	if (IS_ENABLED(CONFIG_WIFI_SCAN_BLE_CON_PERIPH) ||
		IS_ENABLED(CONFIG_WIFI_CON_SCAN_BLE_CON_PERIPH)) {
		LOG_INF("Test case: wifi_scan_ble_conn_peripheral");
		ret = wifi_scan_ble_conn_peripheral(wifi_coex_enable, antenna_mode, test_ble,
				test_wlan, ble_role, wlan_role, coex_hardware_enable,
				wifi_connected_scan);
		if (ret != 0) {
			LOG_ERR("Running wifi_scan_ble_conn_peripheral fail");
			goto err;
		}
	}

	if (IS_ENABLED(CONFIG_WIFI_SCAN_BLE_TP_CENTRAL) ||
		IS_ENABLED(CONFIG_WIFI_CON_SCAN_BLE_TP_CENTRAL)) {
		LOG_INF("Test case: wifi_scan_ble_tput_central");
		ret = wifi_scan_ble_tput_central(wifi_coex_enable, antenna_mode,
				test_ble, test_wlan, ble_role, wlan_role, coex_hardware_enable,
				wifi_connected_scan);
		if (ret != 0) {
			LOG_ERR("Running wifi_scan_ble_tput_central fail");
			goto err;
		}
	}

	if (IS_ENABLED(CONFIG_WIFI_SCAN_BLE_TP_PERIPH) ||
		IS_ENABLED(CONFIG_WIFI_CON_SCAN_BLE_TP_PERIPH)) {
		LOG_INF("Test case: wifi_scan_ble_tput_peripheral");
		ret = wifi_scan_ble_tput_peripheral(wifi_coex_enable, antenna_mode,
				test_ble, test_wlan, ble_role, wlan_role, coex_hardware_enable,
				wifi_connected_scan);
		if (ret != 0) {
			LOG_ERR("Running wifi_scan_ble_tput_peripheral fail");
			goto err;
		}
	}

	if (IS_ENABLED(CONFIG_WIFI_CON_BLE_CON_CENTRAL)) {
		LOG_INF("Test case: wifi_con_ble_con_central");
		ret = wifi_con_ble_con_central(test_wlan, wifi_coex_enable, test_ble, ble_role,
				wlan_role, antenna_mode, coex_hardware_enable);
		if (ret != 0) {
			LOG_ERR("Running wifi_con_ble_con_central fail");
			goto err;
		}
	}

	if (IS_ENABLED(CONFIG_WIFI_CON_BLE_CON_PERIPH)) {
		LOG_INF("Test case: wifi_con_ble_con_peripheral");
		ret = wifi_con_ble_con_peripheral(test_wlan, wifi_coex_enable, test_ble,
				ble_role, wlan_role, antenna_mode, coex_hardware_enable);
		if (ret != 0) {
			LOG_ERR("Running wifi_con_ble_con_peripheral fail");
			goto err;
		}
	}

	if (IS_ENABLED(CONFIG_WIFI_CON_BLE_TP_CENTRAL)) {
		LOG_INF("Test case: wifi_con_ble_tput_central");
		ret = wifi_con_ble_tput_central(test_wlan, wifi_coex_enable, antenna_mode,
				test_ble, ble_role, wlan_role, coex_hardware_enable);
		if (ret != 0) {
			LOG_ERR("Running wifi_con_ble_tput_central fail");
			goto err;
		}
	}

	if (IS_ENABLED(CONFIG_WIFI_CON_BLE_TP_PERIPH)) {
		LOG_INF("Test case: wifi_con_ble_tput_peripheral");
		ret = wifi_con_ble_tput_peripheral(test_wlan, wifi_coex_enable, antenna_mode,
				test_ble, ble_role, wlan_role, coex_hardware_enable);
		if (ret != 0) {
			LOG_ERR("Running wifi_con_ble_tput_peripheral fail");
			goto err;
		}
	}

	if (IS_ENABLED(CONFIG_WIFI_TP_CLIENT_BLE_CON_CENTRAL)) {
		LOG_INF("Test case: wifi_tput_client_ble_con_central");
		ret = wifi_tput_client_ble_con_central(test_wlan, wifi_coex_enable, test_ble,
				ble_role, wlan_role, antenna_mode, coex_hardware_enable);
		if (ret != 0) {
			LOG_ERR("Running wifi_tput_client_ble_con_central fail");
			goto err;
		}
	}

	if (IS_ENABLED(CONFIG_WIFI_TP_CLIENT_BLE_CON_PERIPH)) {
		LOG_INF("Test case: wifi_tput_client_ble_con_peripheral");
		ret = wifi_tput_client_ble_con_peripheral(test_wlan, wifi_coex_enable, test_ble,
				ble_role, wlan_role, antenna_mode, coex_hardware_enable);
		if (ret != 0) {
			LOG_ERR("Running wifi_tput_client_ble_con_peripheral fail");
			goto err;
		}
	}

	if (IS_ENABLED(CONFIG_WIFI_TP_SERVER_BLE_CON_CENTRAL)) {
		LOG_INF("Test case: wifi_tput_server_ble_con_central");
		ret = wifi_tput_server_ble_con_central(test_wlan, wifi_coex_enable, test_ble,
				ble_role, wlan_role, antenna_mode, coex_hardware_enable);
		if (ret != 0) {
			LOG_ERR("Running wifi_tput_server_ble_con_central fail");
			goto err;
		}
	}

	if (IS_ENABLED(CONFIG_WIFI_TP_SERVER_BLE_CON_PERIPH) ||
		IS_ENABLED(CONFIG_WIFI_TP_TCP_SERVER_BLE_CON_PERIPH)) {
		LOG_INF("Test case: wifi_tput_server_ble_con_peripheral");
		ret = wifi_tput_server_ble_con_peripheral(test_wlan, wifi_coex_enable, test_ble,
				ble_role,
				wlan_role, antenna_mode, coex_hardware_enable);
		if (ret != 0) {
			LOG_ERR("Running wifi_tput_server_ble_con_peripheral fail");
			goto err;
		}
	}

	if (IS_ENABLED(CONFIG_WIFI_TP_CLIENT_BLE_TP_CENTRAL) ||
		IS_ENABLED(CONFIG_WIFI_TP_TCP_CLIENT_BLE_TP_CENTRAL)) {
		if (!IS_ENABLED(CONFIG_WIFI_ZPERF_SERVER) && IS_ENABLED(CONFIG_COEX_BT_CENTRAL)) {
			LOG_INF(" Test case: wifi_tput_client_ble_tput_central");
			ret = wifi_tput_client_ble_tput_central(test_wlan, wifi_coex_enable,
					antenna_mode, test_ble, ble_role,
			wlan_role, coex_hardware_enable);
			if (ret != 0) {
				LOG_ERR("Running wifi_tput_client_ble_tput_central fail");
				goto err;
			}
		}
	}

	if (IS_ENABLED(CONFIG_WIFI_TP_CLIENT_BLE_TP_PERIPH) ||
		IS_ENABLED(CONFIG_WIFI_TP_TCP_CLIENT_BLE_TP_PERIPH)) {
		if (!IS_ENABLED(CONFIG_WIFI_ZPERF_SERVER) && !IS_ENABLED(CONFIG_COEX_BT_CENTRAL)) {
			LOG_INF(" Test case: wifi_tput_client_ble_tput_peripheral");
			ret = wifi_tput_client_ble_tput_peripheral(test_wlan, wifi_coex_enable,
			antenna_mode, test_ble, ble_role, wlan_role, coex_hardware_enable);
			if (ret != 0) {
				LOG_ERR("Running wifi_tput_client_ble_tput_peripheral fail");
				goto err;
			}
		}
	}

	if (IS_ENABLED(CONFIG_WIFI_TP_SERVER_BLE_TP_CENTRAL) ||
		IS_ENABLED(CONFIG_WIFI_TP_TCP_SERVER_BLE_TP_CENTRAL)) {
		if (IS_ENABLED(CONFIG_WIFI_ZPERF_SERVER) && IS_ENABLED(CONFIG_COEX_BT_CENTRAL)) {
			LOG_INF(" Test case: wifi_tput_server_ble_tput_central");
			ret = wifi_tput_server_ble_tput_central(test_wlan, wifi_coex_enable,
				antenna_mode, test_ble, ble_role, wlan_role, coex_hardware_enable);
			if (ret != 0) {
				LOG_ERR("Running wifi_tput_server_ble_tput_central fail");
				goto err;
			}
		}
	}

	if (IS_ENABLED(CONFIG_WIFI_TP_SERVER_BLE_TP_PERIPH) ||
		IS_ENABLED(CONFIG_WIFI_TP_TCP_SERVER_BLE_TP_PERIPH)) {
		if (IS_ENABLED(CONFIG_WIFI_ZPERF_SERVER) && !IS_ENABLED(CONFIG_COEX_BT_CENTRAL)) {
			LOG_INF(" Test case: wifi_tput_server_ble_tput_peripheral");
			ret = wifi_tput_server_ble_tput_peripheral(test_wlan, wifi_coex_enable,
					antenna_mode, test_ble, ble_role, wlan_role,
					coex_hardware_enable);
			if (ret != 0) {
				LOG_ERR("Running wifi_tput_server_ble_tput_peripheral fail");
				goto err;
			}
		}
	}

	return 0;

err:
	LOG_INF("Returning with error");
	return ret;
#endif
}
```

## src/bt_coex_test_functions.h
```c
/*
 * Copyright (c) 2022 Nordic Semiconductor ASA
 *
 * SPDX-License-Identifier: LicenseRef-Nordic-5-Clause
 */

#ifndef BT_COEX_TEST_FUNCTIONS_
#define BT_COEX_TEST_FUNCTIONS_

#include <stdio.h>
#include <stdlib.h>
#include <string.h>

#include "common.h"

#include <bluetooth/scan.h>

#include <zephyr/logging/log.h>
LOG_MODULE_REGISTER(bt_coex_test_func, CONFIG_LOG_DEFAULT_LEVEL);

#include <nrfx_clock.h>
#include <zephyr/kernel.h>
#include <zephyr/init.h>
#include <zephyr/device.h>
#include <zephyr/devicetree.h>
#include <zephyr/drivers/gpio.h>

#include <zephyr/shell/shell.h>
#include <zephyr/shell/shell_uart.h>

#include <zephyr/sys/byteorder.h>
#include <zephyr/net/zperf.h>
#include <zephyr/net/net_if.h>
#include <zephyr/net/wifi_mgmt.h>
#include <zephyr/net/net_event.h>
#include <zephyr/net/socket.h>

/* For net_sprint_ll_addr_buf */
#include "net_private.h"
#if !defined(BLE_PEER_THROUGHPUT_TEST) && !defined(BLE_PEER_CONN_CENTRAL_TEST)
#include <zephyr_coex.h>
#include <zephyr_coex_struct.h>
#endif

#include "bt_utils.h"
#if !defined(BLE_PEER_THROUGHPUT_TEST) && !defined(BLE_PEER_CONN_CENTRAL_TEST)
#include "zephyr_fmac_main.h"
#endif

#define MAX_SSID_LEN 32
#define WIFI_CONNECTION_TIMEOUT 30

#define PRINT_WIFI_SCAN_RESULT
#define PRINT_WIFI_CONN_RESULT
#define DEMARCATE_TEST_START

#define HIGHEST_CHANNUM_24G 14

extern bool ble_periph_connected;
uint8_t wait_for_ble_central_run;

static uint32_t wifi_scan_cnt_24g;
static uint32_t wifi_scan_cnt_5g;
static uint32_t wifi_scan_cmd_cnt;

static uint8_t wait_for_wifi_client_start;

extern uint32_t ble_conn_success_cnt;
extern uint32_t ble_conn_fail_cnt;

static uint32_t wifi_conn_success_cnt;
static uint32_t wifi_conn_fail_cnt;

static struct sockaddr_in in4_addr_my = {
	.sin_family = AF_INET,
	.sin_port = htons(CONFIG_NET_CONFIG_PEER_IPV4_PORT),
};

static uint32_t scan_result_count;
/**
 * @brief BT throughtput tets run
 *
 * @return Zero on success or (negative) error code otherwise.
 */
void run_bt_benchmark(void);
/**
 * @brief commnad to start wifi scan
 *
 * @return Zero on success or (negative) error code otherwise.
 */
int cmd_wifi_scan(void);
/**
 * @brief Call wifi connection event
 *
 * @return Zero on success or (negative) error code otherwise.
 */
int wifi_connection(bool test_wlan, bool wifi_coex_enable,
				bool antenna_mode);
/**
 * @brief configure PTA registers
 *
 * @return Zero on success or (negative) error code otherwise.
 */
int config_pta(bool wifi_coex_enable, bool antenna_mode, bool ble_role,
				bool wlan_role);
/**
 * @brief Start wi-fi traffic for zperf udp upload or configure
 * zperf traffic for udp download
 *
 * @return Zero on success or (negative) error code otherwise.
 */
int run_wifi_traffic(bool test_wlan);
/**
 * @brief start BLE traffic using thread start
 *
 * @return Zero on success or (negative) error code otherwise.
 */
void start_ble_traffic(bool test_ble, bool ble_role);
/**
 * @brief check if iperf traffic is complete
 *
 * @return Zero on success or (negative) error code otherwise.
 */
void check_wifi_traffic(bool test_wlan);
/**
 * @brief run BLE traffic using thread join
 *
 * @return Zero on success or (negative) error code otherwise.
 */
void run_ble_traffic(bool test_ble, bool ble_role);
/**
 * @brief Disconnect Wi-Fi
 *
 * @return Zero on success or (negative) error code otherwise.
 */
void disconnect_wifi(bool test_wlan);
/**
 * @brief Disconnect BLE
 *
 * @return Zero on success or (negative) error code otherwise.
 */
void disconnect_ble(bool test_ble, bool ble_role);

static struct {
	uint8_t connected :1;
	uint8_t disconnect_requested: 1;
	uint8_t _unused : 6;
} context;

K_SEM_DEFINE(wait_for_next, 0, 1);
K_SEM_DEFINE(udp_callback, 0, 1);
struct wifi_iface_status status = { 0 };
uint32_t repeat_scan = 1;

#if !defined(BLE_PEER_THROUGHPUT_TEST) && !defined(BLE_PEER_CONN_CENTRAL_TEST)
K_THREAD_DEFINE(run_bt_traffic,
		CONFIG_WIFI_THREAD_STACK_SIZE,
		run_bt_benchmark,
		NULL,
		NULL,
		NULL,
		CONFIG_WIFI_THREAD_PRIORITY,
		0,
		K_TICKS_FOREVER);
#endif

/**
 * @brief Print Wi-Fi status
 *
 * @return Zero on success or (negative) error code otherwise.
 */
int cmd_wifi_status(void);
/**
 * @brief Initailise wifi arguments in variables
 *
 * @return Zero on success or (negative) error code otherwise.
 */
int __wifi_args_to_params(struct wifi_connect_req_params *params);
/**
 * @brief Request connection
 *
 * @return Zero on success or (negative) error code otherwise.
 */
int wifi_connect(void);
/**
 * @brief Request disconnection
 *
 * @return Zero on success or (negative) error code otherwise.
 */
int wifi_disconnect(void);
/**
 * @brief parse IPv4 address
 *
 * @return Zero on success or (negative) error code otherwise.
 */
int parse_ipv4_addr(char *host, struct sockaddr_in *addr);
/**
 * @brief wait for next wifi event
 *
 * @return Zero on success or (negative) error code otherwise.
 */
int wait_for_next_event(const char *event_name, int timeout);
/**
 * @brief CB for UDP download results
 *
 * @return Zero on success or (negative) error code otherwise.
 */
void udp_download_results_cb(enum zperf_status status,
			   struct zperf_results *result,
			   void *user_data);
/**
 * @brief CB for UDP upload results
 *
 * @return Zero on success or (negative) error code otherwise.
 */
void udp_upload_results_cb(enum zperf_status status,
			struct zperf_results *result,
			void *user_data);

#endif /* BT_COEX_TEST_FUNCTIONS_ */
```

## src/bt_main.c
```c
/*
 * Copyright (c) 2018 Nordic Semiconductor ASA
 *
 * SPDX-License-Identifier: LicenseRef-Nordic-5-Clause
 */

#include <zephyr/kernel.h>
#include <zephyr/console/console.h>
#include <zephyr/sys/printk.h>
#include <string.h>
#include <stdlib.h>
#include <zephyr/types.h>

#include <zephyr/bluetooth/bluetooth.h>
#include <zephyr/bluetooth/crypto.h>
#include <zephyr/bluetooth/conn.h>
#include <zephyr/bluetooth/gatt.h>
#include <zephyr/bluetooth/hci.h>
#include <zephyr/bluetooth/uuid.h>
#include <bluetooth/services/throughput.h>
#include <bluetooth/scan.h>
#include <bluetooth/gatt_dm.h>

#include <zephyr/shell/shell_uart.h>

#include <dk_buttons_and_leds.h>

#include "bt_main.h"


#define DEVICE_NAME	CONFIG_BT_DEVICE_NAME
#define DEVICE_NAME_LEN (sizeof(DEVICE_NAME) - 1)
#define INTERVAL_MIN	80	/* 320 units, 400 ms */
#define INTERVAL_MAX	80	/* 320 units, 400 ms */

#define THROUGHPUT_CONFIG_TIMEOUT K_SECONDS(20)

static K_SEM_DEFINE(throughput_sem, 0, 1);

static volatile bool data_length_req;
static volatile bool test_ready;
static struct bt_conn *default_conn;
static struct bt_throughput throughput;
static struct bt_uuid *uuid128 = BT_UUID_THROUGHPUT;
static struct bt_gatt_exchange_params exchange_params;

static struct bt_le_conn_param *conn_param =
	BT_LE_CONN_PARAM(INTERVAL_MIN, INTERVAL_MAX, 0, 400);

static const struct bt_data ad[] = {
	BT_DATA_BYTES(BT_DATA_FLAGS, (BT_LE_AD_GENERAL | BT_LE_AD_NO_BREDR)),
	BT_DATA_BYTES(BT_DATA_UUID128_ALL,
		0xBB, 0x4A, 0xFF, 0x4F, 0xAD, 0x03, 0x41, 0x5D,
		0xA9, 0x6C, 0x9D, 0x6C, 0xDD, 0xDA, 0x83, 0x04),
};

static const struct bt_data sd[] = {
	BT_DATA(BT_DATA_NAME_COMPLETE, DEVICE_NAME, DEVICE_NAME_LEN),
};

static void button_handler_cb(uint32_t button_state, uint32_t has_changed);

static const char *phy2str(uint8_t phy)
{
	switch (phy) {
	case 0: return "No packets";
	case BT_GAP_LE_PHY_1M: return "LE 1M";
	case BT_GAP_LE_PHY_2M: return "LE 2M";
	case BT_GAP_LE_PHY_CODED: return "LE Coded";
	default: return "Unknown";
	}
}

static void instruction_print(void)
{
	/* printk("\nType 'config' to change the configuration parameters.\n");
	 * printk("You can use the Tab key to autocomplete your input.\n");
	 * printk("Type 'run' when you are ready to run the test.\n");
	 */
}

void scan_filter_match(struct bt_scan_device_info *device_info,
		       struct bt_scan_filter_match *filter_match,
		       bool connectable)
{
	char addr[BT_ADDR_LE_STR_LEN];

	bt_addr_le_to_str(device_info->recv_info->addr, addr, sizeof(addr));

	printk("Filters matched. Address: %s connectable: %d\n",
		addr, connectable);
}

void scan_filter_no_match(struct bt_scan_device_info *device_info,
			  bool connectable)
{
	char addr[BT_ADDR_LE_STR_LEN];

	bt_addr_le_to_str(device_info->recv_info->addr, addr, sizeof(addr));

	printk("Filter not match. Address: %s connectable: %d\n",
				addr, connectable);
}

void scan_connecting_error(struct bt_scan_device_info *device_info)
{
	printk("Connecting failed\n");
}

BT_SCAN_CB_INIT(scan_cb, scan_filter_match, scan_filter_no_match,
		scan_connecting_error, NULL);

static void exchange_func(struct bt_conn *conn, uint8_t att_err,
			  struct bt_gatt_exchange_params *params)
{
	struct bt_conn_info info = {0};
	int err;

	printk("MTU exchange %s\n", att_err == 0 ? "successful" : "failed");

	err = bt_conn_get_info(conn, &info);
	if (err) {
		printk("Failed to get connection info %d\n", err);
		return;
	}

	if (info.role == BT_CONN_ROLE_CENTRAL) {
		instruction_print();
		test_ready = true;
	}
}

static void discovery_complete(struct bt_gatt_dm *dm,
			       void *context)
{
	int err;
	struct bt_throughput *throughput = context;

	printk("Service discovery completed\n");

	bt_gatt_dm_data_print(dm);
	bt_throughput_handles_assign(dm, throughput);
	bt_gatt_dm_data_release(dm);

	exchange_params.func = exchange_func;

	err = bt_gatt_exchange_mtu(default_conn, &exchange_params);
	if (err) {
		printk("MTU exchange failed (err %d)\n", err);
	} else {
		printk("MTU exchange pending\n");
	}
}

static void discovery_service_not_found(struct bt_conn *conn,
					void *context)
{
	printk("Service not found\n");
}

static void discovery_error(struct bt_conn *conn,
			    int err,
			    void *context)
{
	printk("Error while discovering GATT database: (%d)\n", err);
}

struct bt_gatt_dm_cb discovery_cb = {
	.completed         = discovery_complete,
	.service_not_found = discovery_service_not_found,
	.error_found       = discovery_error,
};

static void connected(struct bt_conn *conn, uint8_t hci_err)
{
	struct bt_conn_info info = {0};
	int err;

	if (hci_err) {
		if (hci_err == BT_HCI_ERR_UNKNOWN_CONN_ID) {
			/* Canceled creating connection */
			return;
		}

		printk("Connection failed (err 0x%02x)\n", hci_err);
		return;
	}

	if (default_conn) {
		printk("Connection exists, disconnect second connection\n");
		bt_conn_disconnect(conn, BT_HCI_ERR_REMOTE_USER_TERM_CONN);
		return;
	}

	default_conn = bt_conn_ref(conn);

	err = bt_conn_get_info(default_conn, &info);
	if (err) {
		printk("Failed to get connection info %d\n", err);
		return;
	}

	printk("Connected as %s\n",
	       info.role == BT_CONN_ROLE_CENTRAL ? "central" : "peripheral");
	printk("Conn. interval is %u units\n", info.le.interval);

	if (info.role == BT_CONN_ROLE_CENTRAL) {
		err = bt_gatt_dm_start(default_conn,
				       BT_UUID_THROUGHPUT,
				       &discovery_cb,
				       &throughput);

		if (err) {
			printk("Discover failed (err %d)\n", err);
		}
	}
}

static void scan_init(void)
{
	int err;
	struct bt_le_scan_param scan_param = {
		.type = BT_LE_SCAN_TYPE_PASSIVE,
		.options = BT_LE_SCAN_OPT_FILTER_DUPLICATE,
		.interval = 0x0010,
		.window = 0x0010,
	};

	struct bt_scan_init_param scan_init = {
		.connect_if_match = 1,
		.scan_param = &scan_param,
		.conn_param = conn_param
	};

	bt_scan_init(&scan_init);
	bt_scan_cb_register(&scan_cb);

	err = bt_scan_filter_add(BT_SCAN_FILTER_TYPE_UUID, uuid128);
	if (err) {
		printk("Scanning filters cannot be set\n");

		return;
	}

	err = bt_scan_filter_enable(BT_SCAN_UUID_FILTER, false);
	if (err) {
		printk("Filters cannot be turned on\n");
	}
}

static void scan_start(void)
{
	int err;

	err = bt_scan_start(BT_SCAN_TYPE_SCAN_PASSIVE);
	if (err) {
		printk("Starting scanning failed (err %d)\n", err);
		return;
	}
}

static void adv_start(void)
{
	struct bt_le_adv_param *adv_param =
		BT_LE_ADV_PARAM(BT_LE_ADV_OPT_CONNECTABLE |
				BT_LE_ADV_OPT_ONE_TIME,
				BT_GAP_ADV_FAST_INT_MIN_2,
				BT_GAP_ADV_FAST_INT_MAX_2,
				NULL);
	int err;

	err = bt_le_adv_start(adv_param, ad, ARRAY_SIZE(ad), sd,
			      ARRAY_SIZE(sd));
	if (err) {
		printk("Failed to start advertiser (%d)\n", err);
		return;
	}
}

static void disconnected(struct bt_conn *conn, uint8_t reason)
{
	struct bt_conn_info info = {0};
	int err;

	printk("Disconnected (reason 0x%02x)\n", reason);

	test_ready = false;
	if (default_conn) {
		bt_conn_unref(default_conn);
		default_conn = NULL;
	}

	err = bt_conn_get_info(conn, &info);
	if (err) {
		printk("Failed to get connection info (%d)\n", err);
		return;
	}

	/* Re-connect using same roles */
	if (info.role == BT_CONN_ROLE_CENTRAL) {
		scan_start();
	} else {
		adv_start();
	}
}

static bool le_param_req(struct bt_conn *conn, struct bt_le_conn_param *param)
{
	printk("Connection parameters update request received.\n");
	printk("Minimum interval: %d, Maximum interval: %d\n",
	       param->interval_min, param->interval_max);
	printk("Latency: %d, Timeout: %d\n", param->latency, param->timeout);

	return true;
}

static void le_param_updated(struct bt_conn *conn, uint16_t interval,
			     uint16_t latency, uint16_t timeout)
{
	printk("Connection parameters updated.\n"
	       " interval: %d, latency: %d, timeout: %d\n",
	       interval, latency, timeout);

	k_sem_give(&throughput_sem);
}

static void le_phy_updated(struct bt_conn *conn,
			   struct bt_conn_le_phy_info *param)
{
	printk("LE PHY updated: TX PHY %s, RX PHY %s\n",
	       phy2str(param->tx_phy), phy2str(param->rx_phy));

	k_sem_give(&throughput_sem);
}

static void le_data_length_updated(struct bt_conn *conn,
				   struct bt_conn_le_data_len_info *info)
{
	if (!data_length_req) {
		return;
	}

	printk("LE data len updated: TX (len: %d time: %d)"
	       " RX (len: %d time: %d)\n", info->tx_max_len,
	       info->tx_max_time, info->rx_max_len, info->rx_max_time);

	data_length_req = false;
	k_sem_give(&throughput_sem);
}

static uint8_t throughput_read(const struct bt_throughput_metrics *met)
{
	printk("[peer] received %u bytes (%u KB)"
	       " in %u GATT writes at %u bps\n",
	       met->write_len, met->write_len / 1024, met->write_count,
	       met->write_rate);

	k_sem_give(&throughput_sem);

	return BT_GATT_ITER_STOP;
}

static void throughput_received(const struct bt_throughput_metrics *met)
{
	static uint32_t kb;

	if (met->write_len == 0) {
		kb = 0;
		printk("\n");

		return;
	}

	if ((met->write_len / 1024) != kb) {
		kb = (met->write_len / 1024);
		printk("=");
	}
}

static void throughput_send(const struct bt_throughput_metrics *met)
{
	printk("\n[local] received %u bytes (%u KB)"
		" in %u GATT writes at %u bps\n",
		met->write_len, met->write_len / 1024,
		met->write_count, met->write_rate);
}

static const struct bt_throughput_cb throughput_cb = {
	.data_read = throughput_read,
	.data_received = throughput_received,
	.data_send = throughput_send
};

static struct button_handler button = {
	.cb = button_handler_cb,
};

void select_role(bool is_central)
{
	int err;
	static bool role_selected;

	if (role_selected) {
		printk("\nCannot change role after it was selected once.\n");
		return;
	} else if (is_central) {
		printk("\nCentral. Starting scanning\n");
		scan_start();
	} else {
		printk("\nPeripheral. Starting advertising\n");
		adv_start();
	}

	role_selected = true;

	/* The role has been selected, button are not needed any more. */
	err = dk_button_handler_remove(&button);
	if (err) {
		printk("Button disable error: %d\n", err);
	}
}

static void button_handler_cb(uint32_t button_state, uint32_t has_changed)
{
	ARG_UNUSED(has_changed);

	if (button_state & DK_BTN1_MSK) {
		select_role(true);
	} else if (button_state & DK_BTN2_MSK) {
		select_role(false);
	}
}

static void buttons_init(void)
{
	int err;

	err = dk_buttons_init(NULL);
	if (err) {
		printk("Buttons initialization failed.\n");
		return;
	}

	/* Add dynamic buttons handler. Buttons should be activated only when
	 * during the board role choosing.
	 */
	dk_button_handler_add(&button);
}

int connection_configuration_set(const struct bt_le_conn_param *conn_param,
			const struct bt_conn_le_phy_param *phy,
			const struct bt_conn_le_data_len_param *data_len)
{
	int err;
	struct bt_conn_info info = {0};

	err = bt_conn_get_info(default_conn, &info);
	if (err) {
		printk("Failed to get connection info %d", err);
		return err;
	}

	if (info.role != BT_CONN_ROLE_CENTRAL) {
		printk("'run' command shall be executed only on the central board");
	}

	err = bt_conn_le_phy_update(default_conn, phy);
	if (err) {
		printk("PHY update failed: %d\n", err);
		return err;
	}

	printk("PHY update pending");
	err = k_sem_take(&throughput_sem, THROUGHPUT_CONFIG_TIMEOUT);
	if (err) {
		printk("PHY update timeout");
		return err;
	}

	if (info.le.data_len->tx_max_len != data_len->tx_max_len) {
		data_length_req = true;

		err = bt_conn_le_data_len_update(default_conn, data_len);
		if (err) {
			printk("LE data length update failed: %d",
				    err);
			return err;
		}

		printk("LE Data length update pending");
		err = k_sem_take(&throughput_sem, THROUGHPUT_CONFIG_TIMEOUT);
		if (err) {
			printk("LE Data Length update timeout");
			return err;
		}
	}

	if (info.le.interval != conn_param->interval_max) {
		err = bt_conn_le_param_update(default_conn, conn_param);
		if (err) {
			printk("Connection parameters update failed: %d",
				    err);
			return err;
		}

		printk("Connection parameters update pending");
		err = k_sem_take(&throughput_sem, THROUGHPUT_CONFIG_TIMEOUT);
		if (err) {
			printk("Connection parameters update timeout");
			return err;
		}
	}

	return 0;
}

int test_run(void)
{
	int err;
	uint64_t stamp;
	int64_t delta;
	uint32_t data = 0;

	/* a dummy data buffer */
	static char dummy[495];

	if (!default_conn) {
		printk("Device is disconnected %s",
			    "Connect to the peer device before running test");
		return -EFAULT;
	}

	if (!test_ready) {
		printk("Device is not ready."
			"Please wait for the service discovery and MTU exchange end");
		return 0;
	}

	printk("\n==== Starting throughput test ====");

	/* reset peer metrics */
	err = bt_throughput_write(&throughput, dummy, 1);
	if (err) {
		printk("Reset peer metrics failed.");
		return err;
	}

	/* get cycle stamp */
	stamp = k_uptime_get_32();

	/* uint16_t count = 200; */
	delta = 0;
	while (true) {
		err = bt_throughput_write(&throughput, dummy, 495);
		if (err) {
			printk("GATT write failed (err %d)", err);
			break;
		}
		data += 495;
		if (k_uptime_get_32() - stamp > CONFIG_BLE_TEST_DURATION) {
			break;
		}
	}

	delta = k_uptime_delta(&stamp);

	printk("\nDone\n");
	printk("[local] sent %u bytes (%u KB) in %lld ms at %llu kbps\n",
	       data, data / 1024, delta, ((uint64_t)data * 8 / delta));

	/* read back char from peer */
	err = bt_throughput_read(&throughput);
	if (err) {
		printk("GATT read failed (err %d)", err);
		return err;
	}

	k_sem_take(&throughput_sem, THROUGHPUT_CONFIG_TIMEOUT);

	instruction_print();

	return 0;
}

BT_CONN_CB_DEFINE(conn_callbacks) = {
	.connected = connected,
	.disconnected = disconnected,
	.le_param_req = le_param_req,
	.le_param_updated = le_param_updated,
	.le_phy_updated = le_phy_updated,
	.le_data_len_updated = le_data_length_updated
};



void bt_main(void)
{
	int err;

	/* printk("Starting Bluetooth Throughput example\n"); */

	err = bt_enable(NULL);
	if (err) {
		printk("Bluetooth init failed (err %d)\n", err);
		return;
	}

	printk("Bluetooth initialized\n");

	scan_init();

	err = bt_throughput_init(&throughput, &throughput_cb);
	if (err) {
		printk("Throughput service initialization failed.\n");
		return;
	}

	buttons_init();
}
```

## src/cm_struct.h
```c
/**
 * Copyright (c) 2022 Nordic Semiconductor ASA
 *
 * SPDX-License-Identifier: LicenseRef-Nordic-5-Clause
 */

/**
 * @brief Structures and related enumerations used in Coexistence.
 */

#ifndef __CM_STRUCT_H__
#define __CM_STRUCT_H__

/* #include "uccrt.h" */
#include <stdint.h>
#include <stdbool.h>

/* Max size of message buffer (exchanged between host and MAC). This is in "bytes" */
#define MAX_MESSAGE_BUF_SIZE 320
/* Number of elements in coex_ch_configuration other than configbuf[] */
#define NUM_ELEMENTS_EXCL_CONFIGBUF 4
/* Each configuration value is of type uint32_t */
#define MAX_NUM_CONFIG_VALUES ((MAX_MESSAGE_BUF_SIZE-\
	(NUM_ELEMENTS_EXCL_CONFIGBUF*sizeof(uint32_t)))>>2)
/* Number of elements in coex_sr_traffic_info other than srTrafficInfo[] */
#define NUM_ELEMENTS_EXCL_SRINFOBUF 1
/* Each SR Traffic Info is of type uint32_t */
#define MAX_SR_TRAFFIC_BUF_SIZE 32


/* Indicates the type of priority window i.e., WLAN or SR */
enum {
	WLAN_WINDOW = 0,
	SR_WINDOW
} coex_pti_window_type;

/* Recommended power save mechanism for WLAN's downlink when a priority window is allocated. */
enum {
	PM_BIT = 0,
	PS_POLL,
	U_APSD,
	S_APSD,
	U_PSMP,
	S_PSMP,
	TRIGGER_FRAME,
} coex_wlan_pm_protocol_type;

/** Indicates device requesting a priority window. This is used to check if
 *  window requests from WLAN and SR collide.
 */
enum{
	SR_DEVICE = 0,
	WLAN_DEVICE
} coex_device_req_pti_window;

/* Indicates if a device requesting a priority window can defer its activity */
enum {
	NO = 0,
	YES
} coex_can_defer_activity;

/** Indicates if request from a module/device is to START or END a priority window.
 *  This is used by a module/device while posting a priority window request to CM.
 */
enum {
	END_REQ_WINDOW = 0,
	START_REQ_WINDOW
} coex_pti_win_req_start_end;

/* Indicates if allocation of PPW/VPW is to be started or stopped */
enum {
	STOP_ALLOC_WINDOWS = 0,
	START_ALLOC_WINDOWS
} coex_ppw_vpw_start_stop;

/* Indicates importance of the activity for which protection from interference is required */
enum {
	LESS_IMPORTANCE = 0,
	MEDIUM_IMPORTANCE,
	HIGH_IMPORTANCE,
	HIGHEST_IMPORTANCE
} coex_imp_activity;

enum {
	/** Used two different values for AGGREGATION module because offset from base is
	 *  beyond supported message buffer size for  WAIT_STATE_1_TIME register
	 */
	COEX_HARDWARE = 1,
	MAC_CTRL,
	MAC_CTRL_AGG_WAIT_STATE_1_TIME,
	MAC_CTRL_AGG,
	MAC_CTRL_DEAGG,
	WLAN_CTRL,
} coex_hardware_to_config;

/* IDs of different messages posted from Coexistence Driver to Coexistence Manager */
enum {
	/* To insturct Coexistence Manager to collect and post SR traffic information */
	COLLECT_SR_TRAFFIC_INFO = 1,
	/* To insturct Coexistence Manager to allocate a priority window to SR */
	ALLOCATE_PTI_WINDOW,
	/* To do configuration of hardware related to coexistence */
	HW_CONFIGURATION,
	/* To start allocating periodic priority windows to WLAN and SR */
	ALLOCATE_PPW,
	/* To start allocating virtual priority windows to WLAN */
	ALLOCATE_VPW,
	/* To configure CM SW parameters */
	SW_CONFIGURATION,
	/* To control sheliak side switch */
	UPDATE_SWITCH_CONFIG
} msg_id_to_cm;

/* ID(s) of different messages posted from Coexistence Manager to Coexistence Driver */
enum {
	/* To post SR traffic information */
	SR_TRAFFIC_INFO = 1
} msg_id_from_cm;

/**
 * struct coex_collect_sr_traffic_info - Message from CD to CM  to request SR traffic info.
 * @messageID: Indicates message ID. This is to be set to COLLECT_SR_TRAFFIC_INFO.
 * @numSetsRequested: Indicates the number of sets of duration and periodicity to be collected.
 *
 * Message from CD to CM  to request SR traffic information.
 */

struct coex_collect_sr_traffic_info {
	uint32_t messageID;
	uint32_t numSetsRequested;
};

/**
 * struct coex_ch_configuration -Message from CD to CM  to configure CH.
 * @messageID: Indicates message ID. This is to be set to HW_CONFIGURATION.
 * @numOfRegistersToConfigure: Indicates the number of registers to be configured.
 * @hwToConfig: Indicates the hardware block that is to be configured.
 * @hwBlockBaseAddress: Base address of the hardware block to be configured.
 * @configbuf: Configuration buffer that holds packed offset and configuration value.
 *
 * Message from CD to CM  to configure CH
 */

struct coex_ch_configuration {
	uint32_t messageID;
	uint32_t numOfRegistersToConfigure;
	uint32_t hwToConfig;
	uint32_t hwBlockBaseAddress;
	uint32_t configbuf[MAX_NUM_CONFIG_VALUES];
};

/**
 * struct coex_allocate_pti_window - Message to CM to request a priority window.
 * @messageID: Indicates message ID. This is to be set to ALLOCATE_PTI_WINDOW.
 * @deviceRequestingWindow: Indicates device requesting a priority window.
 * @windowStartOrEnd: Indicates if request is posted to START or END a priority window.
 * @importanceOfRequest: Indicates importance of activity for which the window is requested.
 * @canBeDeferred: activity of WLAN/SR, for which window is requested can be deferred or not.
 *
 * Message to CM to request a priority window
 */

struct coex_allocate_pti_window {
	uint32_t messageID;
	uint32_t deviceRequestingWindow;
	uint32_t windowStartOrEnd;
	uint32_t importanceOfRequest;
	uint32_t canBeDeferred;
};

/**
 * struct coex_allocate_ppw - Message from CD to CM  to allocate Periodic Priority Windows.
 * @messageID: Indicates message ID. This is to be set to ALLOCATE_PPW.
 * @startOrStop: Indiates start or stop allocation of PPWs.
 * @firstPriorityWindow: Indicates first priority window in the series of PPWs.
 * @powersaveMechanism: Indicates recommended powersave mechanism for WLAN's downlink.
 * @wlanWindowDuration: Indicates duration of WLAN priority window.
 * @srWindowDuration: Indicates duration of SR priority window.
 *
 * Message from CD to CM  to allocate Periodic Priority Windows.
 */

struct coex_allocate_ppw {
	uint32_t messageID;
	uint32_t startOrStop;
	uint32_t firstPriorityWindow;
	uint32_t powersaveMechanism;
	uint32_t wlanWindowDuration;
	uint32_t srWindowDuration;
};

/**
 * struct coex_allocate_vpw - Message from CD to CM  to allocate Virtual Priority Windows.
 * @messageID: Indicates message ID. This is to be set to ALLOCATE_VPW.
 * @startOrStop: Indicates start or stop allocation of VPWs.
 * @wlanWindowDuration: Indicates duration of WLAN virtual priority window.
 * @powersaveMechanism: Indicates recommended powersave mechanism for WLAN's downlink.
 *
 * Message from CD to CM  to allocate Virtual Priority Windows.
 */

struct coex_allocate_vpw {
	uint32_t messageID;
	uint32_t startOrStop;
	uint32_t wlanWindowDuration;
	uint32_t powersaveMechanism;
};

/**
 * struct coex_config_cm_params - Message from CD to CM  to configure CM parameters
 * @messageID: Indicates message ID. This is to be set to SW_CONFIGURATION.
 * @first_isr_trigger_period: microseconds . used to trigger the ISR mechanism.
 * @sr_window_poll_periodicity_vpw: microseconds. This is used to poll through SR window.
 *  that comes after WLAN window ends and next SR activity starts, in the case of VPWs.
 * @lead_time_from_end_of_wlan_win: microseconds. Lead time from the end of WLAN window.
 *  (to inform  AP that WLAN is entering powersave) in the case of PPW and VPW generation.
 * @sr_window_poll_count_threshold: This is equal to "WLAN contention timeout.
 *  threshold"/sr_window_poll_periodicity_vpw.
 *
 * Message from CD to CM  to configure CM parameters.
 */

struct coex_config_cm_params {
	uint32_t messageID;
	uint32_t first_isr_trigger_period;
	uint32_t sr_window_poll_periodicity_vpw;
	uint32_t lead_time_from_end_of_wlan_win;
	uint32_t sr_window_poll_count_threshold;
};

/**
 * struct coex_sr_traffic_info - Message from CM to CD to post SR traffic information.
 * @messageID: Indicates message ID. This is to be set to SR_TRAFFIC_INFO.
 * @srTrafficInfo: Traffic information buffer.
 *
 * Message from CM to CD to post SR traffic inforamtion
 */

struct coex_sr_traffic_info {
	uint32_t messageID;
	uint32_t srTrafficInfo[MAX_SR_TRAFFIC_BUF_SIZE];
};

#endif /* __CM_STRUCT_H__ */
```

## src/coex.h
```c
/*
 * Copyright (c) 2022 Nordic Semiconductor ASA
 *
 * SPDX-License-Identifier: LicenseRef-Nordic-5-Clause
 */

#ifndef COEX_H_
#define COEX_H_

enum{
	SEA1 = 1,
	SEA2,
	SEA3,
	SEA4,
	SEA5
};

enum{
	SHA1 = 1,
	SHA2,
	SHA3,
	SHA4,
	SHA5
};

int nrf_wifi_coex_hw_enable(uint32_t coexHwEn);
int nrf_wifi_coex_enable(uint32_t wifiCoexEn);
int nrf_wifi_coex_config_non_pta(uint32_t coexEnable);
int nrf_wifi_coex_config_pta(uint32_t ptaTblType);
int nrf_wifi_coex_allocate_spw(uint32_t deviceRequestingWindow,
	uint32_t windowStartOrEnd,
	uint32_t importanceOfRequest,
	uint32_t canBeDeferred);
int nrf_wifi_coex_allocate_ppw(int32_t startOrStop,
	uint32_t firstPriorityWindow,
	uint32_t powersaveMechanism,
	uint32_t wlanWindowDuration,
	uint32_t srWindowDuration);

#endif /* COEX_H_ */
```

## src/common.h
```c
/*
 * Copyright (c) 2022 Nordic Semiconductor ASA
 *
 * SPDX-License-Identifier: LicenseRef-Nordic-5-Clause
 */

#ifndef COMMON_H_
#define COMMON_H_

/**
 * Use one of the defines to generate hex file for BLE peer.
 * Comment both to generate hex file for DUT coexistence sample.
 */
#define BLE_PEER_THROUGHPUT_TEST
/*#define BLE_PEER_CONN_CENTRAL_TEST*/

#endif /* COMMON_H_ */
```
