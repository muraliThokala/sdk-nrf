## prj.conf
```kconfig
#
# Copyright (c) 2023 Nordic Semiconductor ASA
#
# SPDX-License-Identifier: LicenseRef-Nordic-5-Clause
#

CONFIG_WIFI=y
CONFIG_WIFI_NRF700X=y

# WPA supplicant
CONFIG_WPA_SUPP=y

# System settings
CONFIG_NEWLIB_LIBC=y
CONFIG_NEWLIB_LIBC_NANO=n

# Networking
CONFIG_NETWORKING=y
CONFIG_NET_SOCKETS=y
CONFIG_NET_LOG=y
CONFIG_NET_IPV4=y
CONFIG_NET_UDP=y
CONFIG_NET_TCP=y
CONFIG_NET_DHCPV4=y


CONFIG_NET_IF_UNICAST_IPV4_ADDR_COUNT=2
CONFIG_NET_MAX_CONTEXTS=8
CONFIG_NET_CONTEXT_SYNC_RECV=y

CONFIG_INIT_STACKS=y

CONFIG_NET_L2_ETHERNET=y

CONFIG_NET_CONFIG_SETTINGS=y
CONFIG_NET_CONFIG_INIT_TIMEOUT=0

#CONFIG_NET_SOCKETS_POLL_MAX=6

# Memories
CONFIG_MAIN_STACK_SIZE=4096
#CONFIG_SYSTEM_WORKQUEUE_STACK_SIZE=2048
CONFIG_NET_TX_STACK_SIZE=4096
CONFIG_NET_RX_STACK_SIZE=4096

# Debugging
CONFIG_STACK_SENTINEL=y
CONFIG_DEBUG_COREDUMP=y
CONFIG_DEBUG_COREDUMP_BACKEND_LOGGING=y
CONFIG_DEBUG_COREDUMP_MEMORY_DUMP_MIN=y

# Kernel options
CONFIG_ENTROPY_GENERATOR=y

# Logging
CONFIG_LOG=y
CONFIG_PRINTK=y
CONFIG_POSIX_CLOCK=y

# Benchmarking
CONFIG_NET_ZPERF=y
CONFIG_POSIX_MAX_FDS=16

# Optimized networking settings for performance
CONFIG_NET_TC_TX_COUNT=1
CONFIG_NET_PKT_RX_COUNT=16
CONFIG_NET_PKT_TX_COUNT=16
CONFIG_NET_BUF_RX_COUNT=16
CONFIG_NET_BUF_TX_COUNT=32
CONFIG_HEAP_MEM_POOL_SIZE=200000
CONFIG_NET_BUF_DATA_SIZE=1100

# Below configs need to be modified based on security
# CONFIG_STA_KEY_MGMT_NONE=y
# CONFIG_STA_KEY_MGMT_WPA2=y
# CONFIG_STA_KEY_MGMT_WPA2_256=y
# CONFIG_STA_KEY_MGMT_WPA3=y
CONFIG_STA_SSID="wifi_sr_coex_24"
CONFIG_STA_PASSWORD="Mypassword"

CONFIG_NET_CONFIG_MY_IPV4_ADDR="192.168.1.99"
CONFIG_NET_CONFIG_MY_IPV4_NETMASK="255.255.255.0"
CONFIG_NET_CONFIG_MY_IPV4_GW="192.168.1.1"

# DUT zperf configuration
CONFIG_WIFI_ZPERF_PROT_UDP=n
CONFIG_WIFI_ZPERF_PKT_SIZE=1024
CONFIG_WIFI_ZPERF_RATE=15000
CONFIG_WIFI_ZPERF_SERVER=n

CONFIG_DK_LIBRARY=y
CONFIG_DK_LIBRARY_DYNAMIC_BUTTON_HANDLERS=y
CONFIG_NRF700X_MAX_TX_PENDING_QLEN=12

CONFIG_COEX_TEST_DURATION=60000

#CONFIG_WPA_SUPP_LOG_LEVEL_DBG=y
CONFIG_THREAD_ROLE_CLIENT=y

CONFIG_NRF700X_QSPI_LOW_POWER=n

CONFIG_OT_CHANNEL=11
CONFIG_OT_PAN_ID=1
```

## src/main.c
```c
/**
 * Copyright (c) 2023 Nordic Semiconductor ASA
 *
 * SPDX-License-Identifier: LicenseRef-Nordic-5-Clause
 */

/** @file
 * @brief SR coexistence sample test bench
 */

#include <stdio.h>
#include <stdlib.h>
#include <string.h>
#include <stdbool.h>

#include "main.h"
#include <nrfx_clock.h>

#include "zephyr_fmac_main.h"
#include <zephyr/logging/log.h>


#include "thread_utils.h"

LOG_MODULE_REGISTER(main, CONFIG_LOG_DEFAULT_LEVEL);

/* To check if the OT device role is as expected */
char* ot_state                   = "router"; /* set to "leader" or "router"*/
uint32_t ot_state_chk_iteration  = 0;
uint32_t total_duration_to_check = 120; /* seconds */
uint32_t time_gap_between_checks = 5; /* seconds */
uint32_t max_iterations          = 1;
uint32_t ret_strcmp              = 1; /* set to non-zero */
bool is_ot_state_matched         = false;

int main(void)
{
	int ret = 0;
	bool is_ant_mode_sep = IS_ENABLED(CONFIG_COEX_SEP_ANTENNAS);
	bool is_thread_client = IS_ENABLED(CONFIG_THREAD_ROLE_CLIENT);
	bool is_wlan_server = IS_ENABLED(CONFIG_WIFI_ZPERF_SERVER);
	bool is_zperf_udp = IS_ENABLED(CONFIG_WIFI_ZPERF_PROT_UDP);
	bool test_wlan = IS_ENABLED(CONFIG_TEST_TYPE_WLAN);
	bool test_thread = IS_ENABLED(CONFIG_TEST_TYPE_THREAD);

#if !defined(CONFIG_COEX_SEP_ANTENNAS) && \
	!(defined(CONFIG_BOARD_NRF7002DK_NRF7001_NRF5340_CPUAPP) || \
	defined(CONFIG_BOARD_NRF7002DK_NRF5340_CPUAPP))
	BUILD_ASSERT("Shared antenna support is not available with nRF7002 shields");
#endif


wifi_memset_context();
	
wifi_net_mgmt_callback_functions();

#if defined(CONFIG_BOARD_NRF7002DK_NRF7001_NRF5340_CPUAPP) || \
	defined(CONFIG_BOARD_NRF7002DK_NRF5340_CPUAPP)
	#if defined(CONFIG_NRF700X_SR_COEX)
		/* Configure SR side (nRF5340 side) switch in nRF7002 DK */
		LOG_INF("Configure SR side (nRF5340 side) switch");
		ret = nrf_wifi_config_sr_switch(is_ant_mode_sep);
		if (ret != 0) {
			LOG_ERR("Unable to configure SR side switch: %d", ret);
			goto err;
		}
	#endif /* CONFIG_NRF700X_SR_COEX */
#endif

#if defined(CONFIG_NRF700X_SR_COEX)
	/* Configure non-PTA registers of Coexistence Hardware */
	LOG_INF("Configuring non-PTA registers.");
	ret = nrf_wifi_coex_config_non_pta(is_ant_mode_sep);
	if (ret != 0) {
		LOG_ERR("Configuring non-PTA registers of CoexHardware FAIL");
		goto err;
	}
#endif /* CONFIG_NRF700X_SR_COEX */


	thread_throughput_test_init(false);
	
	k_sleep(K_SECONDS(3));
	
	/* LOG_INF("Waiting for OT discover to complete"); */
	while (1) {
		if (is_ot_discovery_done) {
			break;
		} 
	}
	LOG_INF("OT discover complete");

	/* check OT device state periodically until the expected state is found */
	max_iterations = total_duration_to_check/time_gap_between_checks;	
	LOG_INF("Check OT device state for every %d seconds..", time_gap_between_checks);
	LOG_INF("until the expected state is found (or) timeout of %d seconds", total_duration_to_check);
	
	LOG_INF("OT device expected state %s", ot_state);
	while(1) {
		ot_state_chk_iteration++;
		/* LOG_INF("ot_state_chk_iteration: %d",ot_state_chk_iteration); */
		ret_strcmp = strcmp(ot_state, check_ot_state());

		/* exit when OT device role matches the expected state (or) timeout */
		if (ret_strcmp == 0) {
			is_ot_state_matched = true;
			break;
		}
		if (ot_state_chk_iteration >= max_iterations) {
			is_ot_state_matched = false;
			break;
		}
		k_sleep(K_SECONDS(time_gap_between_checks));	
	}	
	if (is_ot_state_matched == true) {
		LOG_INF("OT device state matched with the expected role");
	} else {
		LOG_ERR("OT device state NOT matched with the expected role");
	}
	k_sleep(K_SECONDS(3));
	thread_throughput_test_exit();

	LOG_INF("Exiting the test after open thread discovery");
	goto end_of_main;

#if 0	
	if (IS_ENABLED(CONFIG_WIFI_TP_UDP_CLIENT_THREAD_TP_CLIENT) ||
	IS_ENABLED(CONFIG_WIFI_TP_TCP_CLIENT_THREAD_TP_CLIENT) ||
	IS_ENABLED(CONFIG_WIFI_TP_UDP_CLIENT_THREAD_TP_SERVER) ||
	IS_ENABLED(CONFIG_WIFI_TP_TCP_CLIENT_THREAD_TP_SERVER) ||
	IS_ENABLED(CONFIG_WIFI_TP_UDP_SERVER_THREAD_TP_CLIENT) ||
	IS_ENABLED(CONFIG_WIFI_TP_TCP_SERVER_THREAD_TP_CLIENT) ||
	IS_ENABLED(CONFIG_WIFI_TP_UDP_SERVER_THREAD_TP_SERVER) ||
	IS_ENABLED(CONFIG_WIFI_TP_TCP_SERVER_THREAD_TP_SERVER)) {
		ret = wifi_tput_thread_tput(test_wlan, is_ant_mode_sep,
		test_thread, is_thread_client, is_wlan_server, is_zperf_udp);
	}
	if (ret != 0) {
		LOG_INF("Test case failed");
		goto err;
	}
	return 0;


#endif

err:
	LOG_INF("Returning with error");

end_of_main:

	return ret;
}
```

## src/main.h
```c
/*
 * Copyright (c) 2023 Nordic Semiconductor ASA
 *
 * SPDX-License-Identifier: LicenseRef-Nordic-5-Clause
 */

#ifndef MAIN_H_
#define MAIN_H_

#include <nrfx_clock.h>

#include <zephyr/kernel.h>
#include <zephyr/init.h>
#include <zephyr/device.h>
#include <zephyr/devicetree.h>
#include <zephyr/drivers/gpio.h>

#include <zephyr/shell/shell.h>
#include <zephyr/shell/shell_uart.h>

#include <zephyr/sys/byteorder.h>
#include <zephyr/net/zperf.h>
#include <zephyr/net/net_if.h>
#include <zephyr/net/wifi_mgmt.h>
#include <zephyr/net/net_event.h>
#include <zephyr/net/socket.h>

#include <zephyr_coex.h>

uint8_t is_ot_discovery_done;

/**
 * @brief Function to test Wi-Fi throughput client/server and Thread throughput client/server
 *
 * @return Zero on success or (negative) error code otherwise.
 */
int wifi_tput_thread_tput(bool test_wlan, bool is_ant_mode_sep, bool test_thread,
		bool is_thread_client, bool is_wlan_server, bool is_zperf_udp);

/**
 * @brief wifi_memset_context
 *
 * @return No return value.
 */
void wifi_memset_context(void);

/**
 * @brief Handle net management callbacks
 *
 * @return No return value.
 */
void wifi_net_mgmt_callback_functions(void);
#endif /* MAIN_H_ */
```

## src/thread_coex_test_functions.c
```c
/**
 * Copyright (c) 2023 Nordic Semiconductor ASA
 *
 * SPDX-License-Identifier: LicenseRef-Nordic-5-Clause
 */

/** @file
 * @brief Wi-Fi and Thread coexistence test functions
 */

#include "thread_coex_test_functions.h"

int8_t wifi_rssi = RSSI_INIT_VALUE;
static int print_wifi_conn_status_once = 1;



void wifi_memset_context(void)
{
	memset(&context, 0, sizeof(context));
}

int wifi_command_status(void)
{
	struct net_if *iface = net_if_get_default();

	if (net_mgmt(NET_REQUEST_WIFI_IFACE_STATUS, iface, &status,
				sizeof(struct wifi_iface_status))) {
		LOG_INF("Status request failed");

		return -ENOEXEC;
	}

#ifndef CONFIG_PRINTS_FOR_AUTOMATION
	LOG_INF("Status: successful");
	LOG_INF("==================");
	LOG_INF("State: %s", wifi_state_txt(status.state));
#endif

	if (status.state >= WIFI_STATE_ASSOCIATED) {
		uint8_t mac_string_buf[sizeof("xx:xx:xx:xx:xx:xx")];

		if (print_wifi_conn_status_once == 1) {

			LOG_INF("Interface Mode: %s",
				   wifi_mode_txt(status.iface_mode));
			LOG_INF("Link Mode: %s",
				   wifi_link_mode_txt(status.link_mode));
			LOG_INF("SSID: %-32s", status.ssid);
			LOG_INF("BSSID: %s",
				   net_sprint_ll_addr_buf(
					status.bssid, WIFI_MAC_ADDR_LEN,
					mac_string_buf, sizeof(mac_string_buf)));
			LOG_INF("Band: %s", wifi_band_txt(status.band));
			LOG_INF("Channel: %d", status.channel);
			LOG_INF("Security: %s", wifi_security_txt(status.security));
			/* LOG_INF("MFP: %s", wifi_mfp_txt(status.mfp)); */
			LOG_INF("WiFi RSSI: %d", status.rssi);

			print_wifi_conn_status_once++;
		}
		wifi_rssi = status.rssi;
	}

	return 0;
}

void wifi_net_mgmt_callback_functions(void)
{
	net_mgmt_init_event_callback(&wifi_sta_mgmt_cb, wifi_mgmt_event_handler,
		WIFI_MGMT_EVENTS);

	net_mgmt_add_event_callback(&wifi_sta_mgmt_cb);

	net_mgmt_init_event_callback(&net_addr_mgmt_cb, net_mgmt_event_handler,
		NET_EVENT_IPV4_DHCP_BOUND);
	net_mgmt_add_event_callback(&net_addr_mgmt_cb);

#ifdef CLOCK_FEATURE_HFCLK_DIVIDE_PRESENT
	nrfx_clock_divider_set(NRF_CLOCK_DOMAIN_HFCLK, NRF_CLOCK_HFCLK_DIV_1);
#endif

	LOG_INF("Starting %s with CPU frequency: %d MHz", CONFIG_BOARD, SystemCoreClock/MHZ(1));

	k_sleep(K_SECONDS(1));
}
void net_mgmt_event_handler(struct net_mgmt_event_callback *cb, uint32_t mgmt_event,
		struct net_if *iface)
{
	switch (mgmt_event) {
	case NET_EVENT_IPV4_DHCP_BOUND:
		print_dhcp_ip(cb);
		break;
	default:
		break;
	}
}

void wifi_mgmt_event_handler(struct net_mgmt_event_callback *cb,
		uint32_t mgmt_event, struct net_if *iface)
{
	const struct device *dev = iface->if_dev->dev;
	struct wifi_nrf_vif_ctx_zep *vif_ctx_zep = NULL;

	vif_ctx_zep = dev->data;

	switch (mgmt_event) {
	case NET_EVENT_WIFI_CONNECT_RESULT:
		wifi_handle_connect_result(cb);
		break;
	case NET_EVENT_WIFI_DISCONNECT_RESULT:
		wifi_handle_disconnect_result(cb);
		break;
	default:
		break;
	}
}

void wifi_handle_connect_result(struct net_mgmt_event_callback *cb)
{
	const struct wifi_status *status =
		(const struct wifi_status *) cb->info;

	if (status->status) {
		LOG_ERR("Wi-Fi Connection request failed (%d)", status->status);
	} else {
#ifdef CONFIG_DEBUG_PRINT_WIFI_CONN_INFO
		LOG_INF("Connected");
#endif
		context.connected = true;
	}

	wifi_command_status();

	k_sem_give(&wait_for_next);
}

void wifi_handle_disconnect_result(struct net_mgmt_event_callback *cb)
{
#ifndef CONFIG_PRINTS_FOR_AUTOMATION
	const struct wifi_status *status = (const struct wifi_status *) cb->info;
#endif

	if (context.disconnect_requested) {
#ifndef CONFIG_PRINTS_FOR_AUTOMATION
		LOG_INF("Disconnection request %s (%d)", status->status ? "failed" : "done",
			status->status);
#endif
		context.disconnect_requested = false;
	} else {
#ifndef CONFIG_PRINTS_FOR_AUTOMATION
		LOG_INF("Disconnected");
#endif
		context.connected = false;
	}
	wifi_disconn_cnt_stability++;
#ifdef CONFIG_DEBUG_PRINT_WIFI_CONN_INFO
	wifi_command_status();
#endif
}

void print_dhcp_ip(struct net_mgmt_event_callback *cb)
{
	/* Get DHCP info from struct net_if_dhcpv4 and print */
	const struct net_if_dhcpv4 *dhcpv4 = cb->info;
	const struct in_addr *addr = &dhcpv4->requested_ip;
	char dhcp_info[128];

	net_addr_ntop(AF_INET, addr, dhcp_info, sizeof(dhcp_info));

#ifdef CONFIG_DEBUG_PRINT_WIFI_DHCP_INFO
	LOG_INF("IP address: %s", dhcp_info);
#endif
	k_sem_give(&wait_for_next);
}

int __wifi_args_to_params(struct wifi_connect_req_params *params)
{
	params->timeout = SYS_FOREVER_MS;

	/* SSID */
	params->ssid = CONFIG_STA_SSID;
	params->ssid_length = strlen(params->ssid);

#if defined(CONFIG_STA_KEY_MGMT_WPA2)
		params->security = 1;
#elif defined(CONFIG_STA_KEY_MGMT_WPA2_256)
		params->security = 2;
#elif defined(CONFIG_STA_KEY_MGMT_WPA3)
		params->security = 3;
#else
		params->security = 0;
#endif

#if !defined(CONFIG_STA_KEY_MGMT_NONE)
		params->psk = CONFIG_STA_PASSWORD;
		params->psk_length = strlen(params->psk);
#endif

	params->channel = WIFI_CHANNEL_ANY;

	/* MFP (optional) */
	params->mfp = WIFI_MFP_OPTIONAL;

	return 0;
}

int wifi_connect(void)
{
	struct net_if *iface = net_if_get_default();
	static struct wifi_connect_req_params cnx_params;

	/* LOG_INF("Connection requested"); */
	__wifi_args_to_params(&cnx_params);

	if (net_mgmt(NET_REQUEST_WIFI_CONNECT, iface,
			&cnx_params, sizeof(struct wifi_connect_req_params))) {
		LOG_ERR("Wi-Fi Connection request failed");
		return -ENOEXEC;
	}
	return 0;
}

int wifi_disconnect(void)
{
	struct net_if *iface = net_if_get_default();
	int status;

	context.disconnect_requested = true;

	status = net_mgmt(NET_REQUEST_WIFI_DISCONNECT, iface, NULL, 0);

	if (status) {
		context.disconnect_requested = false;

		if (status == -EALREADY) {
			/* LOG_ERR("Already disconnected"); */
			wifi_disconn_no_conn_cnt++;
		} else {
			/* LOG_ERR("Disconnect request failed"); */
			wifi_disconn_fail_cnt++;
			return -ENOEXEC;
		}
	} else {
		wifi_disconn_success_cnt++;
	}
	return 0;
}

int wifi_parse_ipv4_addr(char *host, struct sockaddr_in *addr)
{
	int ret;

	if (!host) {
		return -EINVAL;
	}
	ret = net_addr_pton(AF_INET, host, &addr->sin_addr);
	if (ret < 0) {
		LOG_ERR("Invalid IPv4 address %s", host);
		return -EINVAL;
	}
	LOG_INF("Wi-Fi peer IPv4 address %s", host);

	return 0;
}

int wait_for_next_event(const char *event_name, int timeout)
{
	int wait_result;

#ifdef CONFIG_DEBUG_PRINT_WIFI_CONN_INFO
	if (event_name) {
		LOG_INF("Waiting for %s", event_name);
	}
#endif
	wait_result = k_sem_take(&wait_for_next, K_SECONDS(timeout));
	if (wait_result) {
		LOG_ERR("Timeout waiting for %s -> %d", event_name, wait_result);
		return -1;
	}
#ifdef CONFIG_DEBUG_PRINT_WIFI_CONN_INFO
	LOG_INF("Got %s", event_name);
#endif
	k_sem_reset(&wait_for_next);

	return 0;
}

void wifi_tcp_upload_results_cb(enum zperf_status status, struct zperf_results *result,
		void *user_data)
{
	uint32_t client_rate_in_kbps;

	switch (status) {
	case ZPERF_SESSION_STARTED:
		LOG_INF("New TCP session started.\n");
		wait4_peer_wifi_client_to_start_tp_test = 1;
		break;

	case ZPERF_SESSION_FINISHED: {

		if (result->client_time_in_us != 0U) {
			client_rate_in_kbps = (uint32_t)
				(((uint64_t)result->nb_packets_sent *
				  (uint64_t)result->packet_size * (uint64_t)8 *
				  (uint64_t)USEC_PER_SEC) /
				 ((uint64_t)result->client_time_in_us * 1024U));
		} else {
			client_rate_in_kbps = 0U;
		}

		LOG_INF("Duration:\t%u", result->client_time_in_us);
		LOG_INF("Num packets:\t%u", result->nb_packets_sent);
		LOG_INF("Num errors:\t%u (retry or fail)\n",
						result->nb_packets_errors);
		LOG_INF("\nclient data rate = %u kbps", client_rate_in_kbps);
		k_sem_give(&udp_tcp_callback);
		break;
	}

	case ZPERF_SESSION_ERROR:
		LOG_INF("TCP upload failed\n");
		break;
	}
}

void wifi_tcp_download_results_cb(enum zperf_status status, struct zperf_results *result,
		void *user_data)
{
	uint32_t rate_in_kbps;

	switch (status) {
	case ZPERF_SESSION_STARTED:
		LOG_INF("New TCP session started.\n");
		wait4_peer_wifi_client_to_start_tp_test = 1;
		break;

	case ZPERF_SESSION_FINISHED: {

		/* Compute baud rate */
		if (result->time_in_us != 0U) {
			rate_in_kbps = (uint32_t)
				(((uint64_t)result->total_len * 8ULL *
				  (uint64_t)USEC_PER_SEC) /
				 ((uint64_t)result->time_in_us * 1024ULL));
		} else {
			rate_in_kbps = 0U;
		}

		LOG_INF("TCP session ended\n");
		LOG_INF("%u bytes in %u ms:", result->total_len,
					result->time_in_us/USEC_PER_MSEC);
		LOG_INF("\nThroughput:%u kbps", rate_in_kbps);
		LOG_INF("");
		k_sem_give(&udp_tcp_callback);
		break;
	}

	case ZPERF_SESSION_ERROR:
		LOG_INF("TCP session error.\n");
		break;
	}
}

void wifi_udp_upload_results_cb(enum zperf_status status, struct zperf_results *result,
		void *user_data)
{
	unsigned int client_rate_in_kbps;

	switch (status) {
	case ZPERF_SESSION_STARTED:
		LOG_INF("New UDP session started");
		wait4_peer_wifi_client_to_start_tp_test = 1;
		break;
	case ZPERF_SESSION_FINISHED:
		LOG_INF("Wi-Fi benchmark: Upload completed!");
		if (result->client_time_in_us != 0U) {
			client_rate_in_kbps = (uint32_t)
				(((uint64_t)result->nb_packets_sent *
				  (uint64_t)result->packet_size * (uint64_t)8 *
				  (uint64_t)USEC_PER_SEC) /
				 ((uint64_t)result->client_time_in_us * 1024U));
		} else {
			client_rate_in_kbps = 0U;
		}
		/* print results */
		LOG_INF("Upload results:");
		LOG_INF("%u bytes in %u ms",
				(result->nb_packets_sent * result->packet_size),
				(result->client_time_in_us / USEC_PER_MSEC));
		/**LOG_INF("%u packets sent", result->nb_packets_sent);
		 *LOG_INF("%u packets lost", result->nb_packets_lost);
		 *LOG_INF("%u packets received", result->nb_packets_rcvd);
		 */
		LOG_INF("client data rate = %u kbps", client_rate_in_kbps);
		k_sem_give(&udp_tcp_callback);
		break;
	case ZPERF_SESSION_ERROR:
		LOG_ERR("UDP session error");
		break;
	}
}

void wifi_udp_download_results_cb(enum zperf_status status, struct zperf_results *result,
		void *user_data)
{
	switch (status) {
	case ZPERF_SESSION_STARTED:
		LOG_INF("New session started.");
		wait4_peer_wifi_client_to_start_tp_test = 1;
		break;

	case ZPERF_SESSION_FINISHED: {
		uint32_t rate_in_kbps;

		/* Compute baud rate */
		if (result->time_in_us != 0U) {
			rate_in_kbps = (uint32_t)
				(((uint64_t)result->total_len * 8ULL *
				  (uint64_t)USEC_PER_SEC) /
				 ((uint64_t)result->time_in_us * 1024ULL));
		} else {
			rate_in_kbps = 0U;
		}

		LOG_INF("End of session!");

		LOG_INF("Download results:");
		LOG_INF("%u bytes in %u ms",
				(result->nb_packets_rcvd * result->packet_size),
				(result->time_in_us / USEC_PER_MSEC));
		/**
		 *LOG_INF(" received packets:\t%u",
		 *		  result->nb_packets_rcvd);
		 *LOG_INF(" nb packets lost:\t%u",
		 *		  result->nb_packets_lost);
		 *LOG_INF(" nb packets outorder:\t%u",
		 *		  result->nb_packets_outorder);
		 */
		LOG_INF("\nThroughput:%u kbps", rate_in_kbps);
		LOG_INF("");
		k_sem_give(&udp_tcp_callback);
		break;
	}

	case ZPERF_SESSION_ERROR:
		LOG_INF("UDP session error.");
		break;
	}
}

enum nrf_wifi_pta_wlan_op_band wifi_mgmt_to_pta_band(enum wifi_frequency_bands band)
{
	switch (band) {
	case WIFI_FREQ_BAND_2_4_GHZ:
		return NRF_WIFI_PTA_WLAN_OP_BAND_2_4_GHZ;
	case WIFI_FREQ_BAND_5_GHZ:
		return NRF_WIFI_PTA_WLAN_OP_BAND_5_GHZ;
	default:
		return NRF_WIFI_PTA_WLAN_OP_BAND_NONE;
	}
}

int wifi_run_tcp_traffic(void)
{
	int ret = 0;

#ifdef CONFIG_WIFI_ZPERF_SERVER
	struct zperf_download_params params = {0};

	params.port = CONFIG_NET_CONFIG_PEER_IPV4_PORT;

	ret = zperf_tcp_download(&params, wifi_tcp_download_results_cb, NULL);
	if (ret != 0) {
		LOG_ERR("Failed to start TCP server session: %d", ret);
		return ret;
	}
	LOG_INF("TCP server started on port %u\n", params.port);
#else
	struct zperf_upload_params params = {0};
	/* Start Wi-Fi TCP traffic */
	LOG_INF("Starting Wi-Fi benchmark: Zperf TCP client");
	params.duration_ms = CONFIG_COEX_TEST_DURATION;
	params.rate_kbps = CONFIG_WIFI_ZPERF_RATE;
	params.packet_size = CONFIG_WIFI_ZPERF_PKT_SIZE;
	wifi_parse_ipv4_addr(CONFIG_NET_CONFIG_PEER_IPV4_ADDR, &in4_addr_my);
	net_sprint_ipv4_addr(&in4_addr_my.sin_addr);

	memcpy(&params.peer_addr, &in4_addr_my, sizeof(in4_addr_my));

	ret = zperf_tcp_upload_async(&params, wifi_tcp_upload_results_cb, NULL);
	if (ret != 0) {
		LOG_ERR("Failed to start TCP session: %d", ret);
		return ret;
	}
#endif

	return 0;
}

int wifi_run_udp_traffic(void)
{
	int ret = 0;

#ifdef CONFIG_WIFI_ZPERF_SERVER
	struct zperf_download_params params = {0};

	params.port = CONFIG_NET_CONFIG_PEER_IPV4_PORT;

	ret = zperf_udp_download(&params, wifi_udp_download_results_cb, NULL);
	if (ret != 0) {
		LOG_ERR("Failed to start UDP server session: %d", ret);
		return ret;
	}
#else
	struct zperf_upload_params params = {0};

	/* Start Wi-Fi UDP traffic */
	LOG_INF("Starting Wi-Fi benchmark: Zperf UDP client");
	params.duration_ms = CONFIG_COEX_TEST_DURATION;
	params.rate_kbps = CONFIG_WIFI_ZPERF_RATE;
	params.packet_size = CONFIG_WIFI_ZPERF_PKT_SIZE;
	wifi_parse_ipv4_addr(CONFIG_NET_CONFIG_PEER_IPV4_ADDR, &in4_addr_my);
	net_sprint_ipv4_addr(&in4_addr_my.sin_addr);

	memcpy(&params.peer_addr, &in4_addr_my, sizeof(in4_addr_my));
	ret = zperf_udp_upload_async(&params, wifi_udp_upload_results_cb, NULL);
	if (ret != 0) {
		LOG_ERR("Failed to start Wi-Fi UDP benchmark: %d", ret);
		return ret;
	}
#endif

	return 0;
}

void wifi_check_traffic_status(void)
{
	/* Run Wi-Fi traffic */
	if (k_sem_take(&udp_tcp_callback, K_FOREVER) != 0) {
		LOG_ERR("Results are not ready");
	} else {
#ifdef CONFIG_WIFI_ZPERF_PROT_UDP
		LOG_INF("Wi-Fi UDP session finished");
#else
		LOG_INF("Wi-Fi TCP session finished");
#endif
	}
}

int wifi_connection(void)
{
	wifi_conn_attempt_cnt++;
	/* Wi-Fi connection */
	wifi_connect();

	if (wait_for_next_event("Wi-Fi Connection", WIFI_CONNECTION_TIMEOUT)) {
		wifi_conn_timeout_cnt++;
		wifi_conn_fail_cnt++;
		return -1;
	}

	if (wait_for_next_event("Wi-Fi DHCP", WIFI_DHCP_TIMEOUT)) {
		wifi_dhcp_timeout_cnt++;
		return -1;
	}
	wifi_conn_success_cnt++;
	return 0;
}

void wifi_disconnection(void)
{
	int ret = 0;

	wifi_disconn_attempt_cnt++;
	/* Wi-Fi disconnection */
	#ifdef CONFIG_DEBUG_PRINT_WIFI_CONN_INFO
		LOG_INF("Disconnecting Wi-Fi");
	#endif
	ret = wifi_disconnect();
	if (ret != 0) {
		LOG_INF("Disconnect failed");
	}
}

void thread_start_activity(void)
{

	k_thread_start(run_thread_traffic);

}

void thread_run_activity(void)
{

	k_thread_join(run_thread_traffic, K_FOREVER);

}

void thread_exit_throughput_test(void)
{
	/** This is called if role is client. Disconnection in the
	 *case of peripheral is taken care by the peer client
	 */
	thread_throughput_test_exit();
}

void thread_run_benchmark(void)
{
	thread_throughput_test_run();
}
int config_pta(bool is_ant_mode_sep, bool is_thread_client, bool is_wlan_server)
{
	int ret = 0;
	enum nrf_wifi_pta_wlan_op_band wlan_band = wifi_mgmt_to_pta_band(status.band);

	if (wlan_band == NRF_WIFI_PTA_WLAN_OP_BAND_NONE) {
		LOG_ERR("Invalid Wi-Fi band: %d", wlan_band);
		return -1;
	}

	/* Configure PTA registers of Coexistence Hardware */
	LOG_INF("Configuring PTA for %s", wifi_band_txt(status.band));
	ret = nrf_wifi_coex_config_pta(wlan_band, is_ant_mode_sep, is_thread_client,
			is_wlan_server);
	if (ret != 0) {
		LOG_ERR("Failed to configure PTA coex hardware: %d", ret);
		return -1;
	}
	return 0;
}



void print_common_test_params(bool is_ant_mode_sep, bool test_thread, bool test_wlan,
		bool is_thread_client)
{

	bool thread_coex_enable = IS_ENABLED(CONFIG_MPSL_CX);
	bool is_wifi_band_2pt4g = IS_ENABLED(CONFIG_WIFI_BAND_2PT4G);

	/* LOG_INF("-------------------------------- Test parameters"); */

	if (test_wlan && test_thread) {
		LOG_INF("Running Wi-Fi and Thread tests");
	} else {
		if (test_wlan) {
			LOG_INF("Running Wi-Fi only test");
		} else {
			LOG_INF("Running Thread only test");
		}
	}

	if (is_wifi_band_2pt4g) {
		LOG_INF("Wi-Fi operates in 2.4G band");
	} else {
		LOG_INF("Wi-Fi operates in 5G band");
	}

	if (is_thread_client) {
		LOG_INF("Thread role : Client");
	} else {
		LOG_INF("Thread role : Server");
	}
	if (thread_coex_enable) {
		LOG_INF("Thread posts requests to PTA");
	} else {
		LOG_INF("Thread doesn't post requests to PTA");
	}

	if (is_ant_mode_sep) {
		LOG_INF("Antenna mode: Separate antennas");
	} else {
		LOG_INF("Antenna mode: Shared antennas");
	}

	LOG_INF("Test duration in milliseconds: %d", CONFIG_COEX_TEST_DURATION);
	LOG_INF("--------------------------------");
}

int wifi_tput_thread_tput(bool test_wlan, bool is_ant_mode_sep,
	bool test_thread, bool is_thread_client, bool is_wlan_server, bool is_zperf_udp)
{
	int ret = 0;
	int64_t test_start_time = 0;

	LOG_INF("-------------------------------- Test parameters");
	LOG_INF("Test case: wifi_tput_thread_tput");
	if (is_wlan_server) {
		if (is_zperf_udp) {
			LOG_INF("Wi-Fi transport protocol, role: UDP, server");
		} else {
			LOG_INF("Wi-Fi transport protocol, role: TCP, server");
		}
	} else {
		if (is_zperf_udp) {
			LOG_INF("Wi-Fi transport protocol, role: UDP, client");
		} else {
			LOG_INF("Wi-Fi transport protocol, role: TCP, client");
		}
	}

	print_common_test_params(is_ant_mode_sep, test_thread, test_wlan, is_thread_client);

	if (test_wlan) {
		ret = wifi_connection();
		if (ret != 0) {
			LOG_ERR("Wi-Fi connection failed. Running the test");
			LOG_ERR("further is not meaningful. So, exiting the test");
			return ret;
		}

		#if defined(CONFIG_NRF700X_SR_COEX)
			config_pta(is_ant_mode_sep, is_thread_client, is_wlan_server);
		#endif/* CONFIG_NRF700X_SR_COEX */
	}

	if (test_thread) {
		if (!is_thread_client) {
			LOG_INF("Make sure peer Thread role is client");
			k_sleep(K_SECONDS(3));
		}
		ret = thread_throughput_test_init(is_thread_client);
		if (ret != 0) {
			LOG_ERR("Failed to Thread throughput init: %d", ret);
			return ret;
		}

		if (!is_wlan_server) {
			if (is_thread_client) {
				/* nothing */
			} else {
				if (test_wlan && test_thread) {
#ifdef CONFIG_PRINTS_FOR_AUTOMATION
					while (!wait4_peer_thread2_start_connection) {
						/* Peer Thread starts the the test. */
						LOG_INF("Run Thread client");
						k_sleep(K_SECONDS(1));
					}
					wait4_peer_thread2_start_connection = 0;
#endif
				}
			}
		}
	}
	if (!is_wlan_server) {
#ifdef DEMARCATE_TEST_START_END
		LOG_INF("-------------------------start");
#endif
	}
	if (!is_wlan_server) {
		test_start_time = k_uptime_get_32();
	}
	if (test_wlan) {
		if (is_zperf_udp) {
			ret = wifi_run_udp_traffic();
		} else {
			ret = wifi_run_tcp_traffic();
		}

		if (ret != 0) {
			LOG_ERR("Failed to start Wi-Fi throughput: %d", ret);
			return ret;
		}
		if (is_wlan_server) {
			while (!wait4_peer_wifi_client_to_start_tp_test) {
#ifdef CONFIG_PRINTS_FOR_AUTOMATION
				LOG_INF("start WiFi client on peer");
#endif
				k_sleep(K_SECONDS(1));
			}
			wait4_peer_wifi_client_to_start_tp_test = 0;
			test_start_time = k_uptime_get_32();
		}
	}
	if (is_wlan_server) {
		#ifdef DEMARCATE_TEST_START_END
		LOG_INF("-------------------------start");
		#endif
	}

	if (test_thread) {
		if (is_thread_client) {
			thread_start_activity();
		} else {
			/* If DUT Thread is peripheral then the peer starts the activity. */
			while (true) {
				if (k_uptime_get_32() - test_start_time >
					CONFIG_COEX_TEST_DURATION) {
					break;
				}
				k_sleep(KSLEEP_TEST_DUR_CHECK_1SEC);
			}
		}
	}

	if (test_wlan) {
		wifi_check_traffic_status();
	}

	if (test_thread) {
		if (is_thread_client) {
			/* run Thread activity and wait for the test duration */
			thread_run_activity();
		} else {
			/* Peer Thread that acts as client runs the traffic. */
		}
	}

	if (test_wlan) {
		wifi_disconnection();
	}

	if (test_thread) {
		if (is_thread_client) {
			thread_exit_throughput_test();
		}
	}

	#ifdef DEMARCATE_TEST_START_END
	LOG_INF("-------------------------end");
	#endif

	return 0;
}
```

## src/thread_coex_test_functions.h
```c
/*
 * Copyright (c) 2023 Nordic Semiconductor ASA
 *
 * SPDX-License-Identifier: LicenseRef-Nordic-5-Clause
 */

#ifndef THREAD_COEX_TEST_FUNCTIONS_
#define THREAD_COEX_TEST_FUNCTIONS_

#include <stdio.h>
#include <stdlib.h>
#include <string.h>

#include <zephyr/logging/log.h>
LOG_MODULE_REGISTER(thread_coex_test_func, CONFIG_LOG_DEFAULT_LEVEL);

#include <nrfx_clock.h>
#include <zephyr/kernel.h>
#include <zephyr/init.h>
#include <zephyr/device.h>
#include <zephyr/devicetree.h>
#include <zephyr/drivers/gpio.h>

#include <zephyr/shell/shell.h>
#include <zephyr/shell/shell_uart.h>

#include <zephyr/sys/byteorder.h>
#include <zephyr/net/zperf.h>
#include <zephyr/net/net_if.h>
#include <zephyr/net/wifi_mgmt.h>
#include <zephyr/net/net_event.h>
#include <zephyr/net/socket.h>

/* For net_sprint_ll_addr_buf */
#include "net_private.h"
#include <zephyr_coex.h>
#include <zephyr_coex_struct.h>
#include "thread_utils.h"
#include "zephyr_fmac_main.h"

#define WIFI_CONNECTION_TIMEOUT 30 /* in seconds */
#define WIFI_DHCP_TIMEOUT 10 /* in seconds */

#define DEMARCATE_TEST_START_END

#define RSSI_INIT_VALUE 127
#define KSLEEP_TEST_DUR_CHECK_1SEC K_SECONDS(1)

static uint32_t wifi_conn_attempt_cnt;
static uint32_t wifi_conn_success_cnt;
static uint32_t wifi_conn_fail_cnt;
static uint32_t wifi_conn_timeout_cnt;
static uint32_t wifi_dhcp_timeout_cnt;
static uint32_t wifi_disconn_attempt_cnt;
static uint32_t wifi_disconn_success_cnt;
static uint32_t wifi_disconn_fail_cnt;
static uint32_t wifi_disconn_no_conn_cnt;

static uint32_t wifi_disconn_cnt_stability;
uint8_t wait4_peer_thread2_start_connection;

static struct net_mgmt_event_callback wifi_sta_mgmt_cb;
static struct net_mgmt_event_callback net_addr_mgmt_cb;
static uint8_t wait4_peer_wifi_client_to_start_tp_test;

static struct sockaddr_in in4_addr_my = {
	.sin_family = AF_INET,
	.sin_port = htons(CONFIG_NET_CONFIG_PEER_IPV4_PORT),
};

#define WIFI_MGMT_EVENTS (NET_EVENT_WIFI_CONNECT_RESULT | NET_EVENT_WIFI_DISCONNECT_RESULT)

/**
 * @brief Handle net management callbacks
 *
 * @return No return value.
 */
void wifi_net_mgmt_callback_functions(void);

/**
 * @brief Handle net management events
 *
 * @return No return value.
 */
void net_mgmt_event_handler(struct net_mgmt_event_callback *cb, uint32_t mgmt_event,
		struct net_if *iface);

/**
 * @brief Handle Wi-Fi management events
 *
 * @return None
 */
void wifi_mgmt_event_handler(struct net_mgmt_event_callback *cb, uint32_t mgmt_event,
		struct net_if *iface);


/**
 * @brief Thread throughtput test run
 *
 * @return None
 */
void thread_run_benchmark(void);


/**
 * @brief Call Wi-Fi connection event
 *
 * @return Zero on success or (negative) error code otherwise.
 */
int wifi_connection(void);
/**
 * @brief configure PTA registers
 *
 * @return Zero on success or (negative) error code otherwise.
 */
int config_pta(bool is_ant_mode_sep, bool is_thread_client,
				bool is_wlan_server);
/**
 * @brief Start wi-fi traffic for zperf udp upload or configure
 * zperf traffic for udp download
 *
 * @return Zero on success or (negative) error code otherwise.
 */
int wifi_run_udp_traffic(void);

/**
 * @brief Start wi-fi traffic for zperf tcp upload or configure
 * zperf traffic for tcp download
 *
 * @return Zero on success or (negative) error code otherwise.
 */
int wifi_run_tcp_traffic(void);


/**
 * @brief start Thread activity
 *
 * @return None
 */
void thread_start_activity(void);

/**
 * @brief start Wi-Fi activity using thread start
 *
 * @return None
 */
void start_wifi_activity(void);
/**
 * @brief check if iperf traffic is complete
 *
 * @return None
 */
void wifi_check_traffic_status(void);
/**
 * @brief Run Thread traffic using thread join
 *
 * @return None
 */
void thread_run_activity(void);
/**
 * @brief Disconnect Wi-Fi
 *
 * @return None
 */
void wifi_disconnection(void);
/**
 * @brief Exit Thread throughput test
 *
 * @return None
 */
void thread_exit_throughput_test(void);

static struct {
	uint8_t connected :1;
	uint8_t disconnect_requested: 1;
	uint8_t _unused : 6;
} context;

K_SEM_DEFINE(wait_for_next, 0, 1);
K_SEM_DEFINE(udp_tcp_callback, 0, 1);

struct wifi_iface_status status = { 0 };

K_THREAD_DEFINE(run_thread_traffic,
	CONFIG_WIFI_THREAD_STACK_SIZE,
	thread_run_benchmark,
	NULL,
	NULL,
	NULL,
	CONFIG_WIFI_THREAD_PRIORITY,
	0,
	K_TICKS_FOREVER);

/**
 * @brief Print Wi-Fi command status
 *
 * @return Zero on success or (negative) error code otherwise.
 */
int wifi_command_status(void);

/**
 * @brief Initailise Wi-Fi arguments in variables
 *
 * @return Zero on success or (negative) error code otherwise.
 */
int __wifi_args_to_params(struct wifi_connect_req_params *params);

/**
 * @brief Request Wi-Fi connection
 *
 * @return Zero on success or (negative) error code otherwise.
 */
int wifi_connect(void);

/**
 * @brief Request Wi-Fi disconnection
 *
 * @return Zero on success or (negative) error code otherwise.
 */
int wifi_disconnect(void);

/**
 * @brief parse Wi-Fi IPv4 address
 *
 * @return Zero on success or (negative) error code otherwise.
 */
int wifi_parse_ipv4_addr(char *host, struct sockaddr_in *addr);

/**
 * @brief wait for next Wi-Fi event
 *
 * @return Zero on success or (negative) error code otherwise.
 */
int wait_for_next_event(const char *event_name, int timeout);

/**
 * @brief Callback for UDP download results
 *
 * @return None
 */
void wifi_udp_download_results_cb(enum zperf_status status,
							struct zperf_results *result,
							void *user_data);

/**
 * @brief Callback for UDP upload results
 *
 * @return None
 */
void wifi_udp_upload_results_cb(enum zperf_status status,
							struct zperf_results *result,
							void *user_data);

/**
 * @brief Callback for TCP download results
 *
 * @return None
 */
void wifi_tcp_download_results_cb(enum zperf_status status,
							struct zperf_results *result,
							void *user_data);

/**
 * @brief Callback for TCP upload results
 *
 * @return None
 */
void wifi_tcp_upload_results_cb(enum zperf_status status,
							struct zperf_results *result,
							void *user_data);

/**
 * @brief Callback for Wi-Fi DHCP IP address
 *
 * @return None
 */
void print_dhcp_ip(struct net_mgmt_event_callback *cb);

/**
 * @brief Callback for Wi-Fi connection result
 *
 * @return None
 */
void wifi_handle_connect_result(struct net_mgmt_event_callback *cb);

/**
 * @brief Callback for Wi-Fi disconnection result
 *
 * @return None
 */
void wifi_handle_disconnect_result(struct net_mgmt_event_callback *cb);


/**
 * @brief Print common test parameters info
 *
 * @return None
 */
void print_common_test_params(bool is_ant_mode_sep, bool test_ble, bool test_wlan,
	bool is_ble_central);
#endif /* THREAD_COEX_TEST_FUNCTIONS_ */
```

## src/thread_utils.c
```c
/*
 * Copyright (c) 2018 Nordic Semiconductor ASA
 *
 * SPDX-License-Identifier: LicenseRef-Nordic-5-Clause
 */

#include <assert.h>
#include <inttypes.h>
#include <string.h>
#include <stdlib.h>

#include "thread_utils.h"
#include "zephyr/net/openthread.h"

#include <zephyr/logging/log.h>

#include <openthread/config.h>
#include <openthread/cli.h>
#include <openthread/diag.h>
#include <openthread/error.h>
#include <openthread/link.h>
#include <openthread/platform/radio.h>
#include <openthread/tasklet.h>
#include <openthread/platform/logging.h>
#include <openthread/dataset_ftd.h>
#include <openthread/thread.h>

extern uint8_t is_ot_discovery_done;

static void setNetworkConfiguration(otInstance *aInstance)
{
	static char          aNetworkName[] = "TestNetwork";
    otOperationalDataset aDataset;

    memset(&aDataset, 0, sizeof(otOperationalDataset));

    /*
     * Fields that can be configured in otOperationDataset to override defaults:
     *     Network Name, Mesh Local Prefix, Extended PAN ID, PAN ID, Delay Timer,
     *     Channel, Channel Mask Page 0, Network Key, PSKc, Security Policy
     */
    aDataset.mActiveTimestamp.mSeconds             = 1;
    aDataset.mActiveTimestamp.mTicks               = 0;
    aDataset.mActiveTimestamp.mAuthoritative       = false;
    aDataset.mComponents.mIsActiveTimestampPresent = true;

    /* Set Channel */
    aDataset.mChannel                      = CONFIG_OT_CHANNEL;
    aDataset.mComponents.mIsChannelPresent = true;

    /* Set Pan ID */
    aDataset.mPanId                      = (otPanId)CONFIG_OT_PAN_ID;
    aDataset.mComponents.mIsPanIdPresent = true;

    /* Set Extended Pan ID */
    /* uint8_t extPanId[OT_EXT_PAN_ID_SIZE] = {0xC0, 0xDE, 0x1A, 0xB5, 0xC0, 0xDE, 0x1A, 0xB5}; */
    uint8_t extPanId[OT_EXT_PAN_ID_SIZE] = {0x11, 0x11, 0x11, 0x11, 0x11, 0x11, 0x11, 0x11};
    memcpy(aDataset.mExtendedPanId.m8, extPanId, sizeof(aDataset.mExtendedPanId));
    aDataset.mComponents.mIsExtendedPanIdPresent = true;

    /* Set network key */
    /* uint8_t key[OT_NETWORK_KEY_SIZE] = {0x12, 0x34, 0xC0, 0xDE, 0x1A, 0xB5, 0x12, 0x34, 0xC0, 0xDE, 0x1A, 0xB5, 0x12, 0x34, 0xC0, 0xDE}; */
    uint8_t key[OT_NETWORK_KEY_SIZE] = {0x11, 0x11, 0x11, 0x11, 0x11, 0x11, 0x11, 0x11, 0x11, 0x11, 0x11, 0x11, 0x11, 0x11, 0x11, 0x11};
    memcpy(aDataset.mNetworkKey.m8, key, sizeof(aDataset.mNetworkKey));
    aDataset.mComponents.mIsNetworkKeyPresent = true;

    /* Set Network Name */
    size_t length = strlen(aNetworkName);
    assert(length <= OT_NETWORK_NAME_MAX_SIZE);
    memcpy(aDataset.mNetworkName.m8, aNetworkName, length);
    aDataset.mComponents.mIsNetworkNamePresent = true;

    otDatasetSetActive(aInstance, &aDataset);
}

LOG_MODULE_REGISTER(thread_utils, CONFIG_LOG_DEFAULT_LEVEL);

#define DEVICE_NAME	CONFIG_BT_DEVICE_NAME
#define DEVICE_NAME_LEN (sizeof(DEVICE_NAME) - 1)

extern uint8_t wait4_peer_thread2_start_connection;

int thread_throughput_test_run(void)
{

	return 0;
}

void handle_active_scan_result(struct otActiveScanResult *result, void *context)
{
	if (!result) {
		return;
	}
	LOG_INF("----------------------------------");
	LOG_INF("Discovered Thread network details");
	LOG_INF("name: %-16s", result->mNetworkName.m8);
	LOG_INF("panid: %04x", result->mPanId);
	LOG_INF("channel: %2u", result->mChannel);
	LOG_INF("rssi: %3d", result->mRssi);
	LOG_INF("----------------------------------");
	
	is_ot_discovery_done = 1;
}

int thread_throughput_test_init(bool is_thread_client)
{
	struct openthread_context *context = openthread_get_default_context();
	otInstance *instance = openthread_get_default_instance();
	LOG_INF("Updating thread parameters");
	setNetworkConfiguration(instance);
	LOG_INF("Enabling thread");
	
	/* otIp6SetEnabled(instance, true); */ /* cli `ifconfig up` */
	/* otThreadSetEnabled(instance, true); */ /* cli `thread start` */	
	otError err = openthread_start(context);	// 'ifconfig up && thread start'
	if (err != OT_ERROR_NONE) {
		LOG_ERR("Starting openthread: %d (%s)", err, otThreadErrorToString(err));
	}

	otDeviceRole current_role = otThreadGetDeviceRole(instance);
	LOG_INF("Current role of Thread device: %s", otThreadDeviceRoleToString(current_role));

	LOG_INF("Performing Thread discover");
	openthread_api_mutex_lock(context);
	otThreadDiscover(openthread_get_default_instance(), 0 /* all channels */,
		OT_PANID_BROADCAST, false, false, handle_active_scan_result, NULL);
	openthread_api_mutex_unlock(openthread_get_default_context());

	return 0;
}



	
int thread_throughput_test_exit(void)
{
	openthread_api_mutex_lock(openthread_get_default_context());
	otThreadSetEnabled(openthread_get_default_instance(), false);
	otIp6SetEnabled(openthread_get_default_instance(), false);
	openthread_api_mutex_unlock(openthread_get_default_context());
	return 0;
}
const char* check_ot_state()
{
	otDeviceRole current_role = otThreadGetDeviceRole(openthread_get_default_instance());
	/* LOG_INF("Current state of thread device: %s", otThreadDeviceRoleToString(current_role)); */
	return(otThreadDeviceRoleToString(current_role));
}
```

## src/thread_utils.h
```c
/*
 * Copyright (c) 2023 Nordic Semiconductor ASA
 *
 * SPDX-License-Identifier: LicenseRef-Nordic-5-Clause
 */

#ifndef THREAD_UTILS_H_
#define THREAD_UTILS_H_


#include <stdbool.h>

/**
 * Initialize Thread throughput test
 *
 * @return Zero on success or (negative) error code otherwise.
 */
int thread_throughput_test_init(bool is_thread_client);

/**
 * @brief Run Thread throughput test
 *
 * @return Zero on success or (negative) error code otherwise.
 */
int thread_throughput_test_run(void);

/**
 * @brief Exit Thread throughput test
 *
 * @return Zero on success or (negative) error code otherwise.
 */
int thread_throughput_test_exit(void);

/**
 * @brief Check state of the thread device
 *
 * @return None.
 */
const char* check_ot_state(void);


#endif /* THREAD_UTILS_H_ */
```
