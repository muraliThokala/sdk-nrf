## CMakeLists.txt
```
#
# Copyright (c) 2026 Nordic Semiconductor ASA
#
# SPDX-License-Identifier: LicenseRef-Nordic-5-Clause
#

cmake_minimum_required(VERSION 3.20.0)

# The WICR LMAC/UMAC ROM patch addresses must point at the patch regions, or
# the RPU boots unpatched ROM, which has no CM2CD command handling. The dtsi
# must match the patch selected through WIFI_NRF71_PATCH_VERSION. Do not also
# pass a patch dtsi through EXTRA_DTC_OVERLAY_FILE.
list(APPEND EXTRA_DTC_OVERLAY_FILE
     ${CMAKE_CURRENT_LIST_DIR}/../../../../nrfxlib/nrf71_wifi/bins/0.1.0/nrf7120_wifi_patch.dtsi)

find_package(Zephyr REQUIRED HINTS $ENV{ZEPHYR_BASE})
project(nrf71_sr_coex)

target_sources(app PRIVATE
  src/main.c
  src/coex_tb_util.c
  src/coex_tb_params.c
  src/coex_tb_stats.c
  src/coex_tb_tests.c
)

# The coexistence driver application API is the public header
# <drivers/nrf71_sr_coex/nrf71_sr_coex.h>. The bench also drives the CD2CM command
# builders, COEXC programming, BLE channel mapping and statistics through the
# driver's internal header nrf71_sr_coex_internal.h. The Wi-Fi directories give
# access to the Wi-Fi firmware interface headers (CD2CM/CM2CD message types).
target_include_directories(app PRIVATE
  ${ZEPHYR_NRF_MODULE_DIR}/drivers/nrf71_sr_coex/src
  ${ZEPHYR_NRF_MODULE_DIR}/drivers/wifi/nrf71/inc
  ${ZEPHYR_NRF_MODULE_DIR}/drivers/wifi/nrf71/inc/common/fw_if
)
```

## prj.conf
```kconfig
# Copyright (c) 2026 Nordic Semiconductor ASA
#
# SPDX-License-Identifier: LicenseRef-Nordic-5-Clause
#

# The Wi-Fi and Short-Range coexistence driver under test.
CONFIG_NRF71_SR_COEX_DRIVER=y

# The coexistence driver sits between: the nRF71 Wi-Fi driver owns
# the FMAC transport that carries CD2CM commands to the RPU, and
# the Short-Range (for example, Bluetooth) side of the arbitration.
CONFIG_WIFI=y
CONFIG_WIFI_NM_WPA_SUPPLICANT=y
CONFIG_BT=y

# The Coexistence Manager command handling lives in the Wi-Fi ROM patch. The
# board overlay points WICR at the patch regions, so the patch must be merged
# into the flashed image.
CONFIG_WIFI_NRF71_PATCH=y

# bt_le_set_chan_map() returns -ENOTSUP unless the Controller is a central or a
# broadcaster, so the BLE bad-channel mapping test needs one of the two roles.
CONFIG_BT_CENTRAL=y

# Build the driver's BLE bad-channel mapping, which the BLE channel map test checks.
CONFIG_NRF71_SR_COEX_BLE_CHAN_MAP=y

# Networking (Wi-Fi driver build dependency).
CONFIG_NETWORKING=y
CONFIG_NET_L2_ETHERNET=y
CONFIG_NET_L2_ETHERNET_MGMT=y
CONFIG_NET_MGMT=y
CONFIG_NET_MGMT_EVENT=y

CONFIG_NET_PKT_RX_COUNT=16
CONFIG_NET_PKT_TX_COUNT=16
CONFIG_NET_BUF_RX_COUNT=16
CONFIG_NET_BUF_TX_COUNT=32
CONFIG_HEAP_MEM_POOL_SIZE=230000

# IPC transport to the RPU.
CONFIG_IPC_SERVICE_BACKEND_ICMSG_WQ_ENABLE=y
CONFIG_IPC_SERVICE_BACKEND_ICMSG_WQ_STACK_SIZE=5600

# Logging. Immediate mode keeps driver log lines interleaved with the test
# bench printk output in the right order, which matters when reading a failure.
CONFIG_LOG=y
CONFIG_LOG_MODE_IMMEDIATE=y
CONFIG_NRF71_SR_COEX_DRIVER_LOG_LEVEL_DBG=y

# Keep the Wi-Fi driver debug logging off so it does not bury the test bench output.
CONFIG_WIFI_NRF71_LOG_LEVEL_DBG=n

# Set to y to open an MPC override on the Wi-Fi debug register window
# (0x48000000) so a debugger can reach the LMAC/UMAC VPRs. Useful to tell "Wi-Fi
# core never started" apart from "core runs but the ipc0 ICMsg peer never binds",
# because nrf_wifi_fmac_ver_get() is stubbed and its "booted successfully" log
# line does not touch the RPU. Disabled by default.
CONFIG_SOC_NRF71_WIFI_DAP=n

CONFIG_MAIN_STACK_SIZE=8192
```

## src/main.c
```c
/*
 * Copyright (c) 2026 Nordic Semiconductor ASA
 *
 * SPDX-License-Identifier: LicenseRef-Nordic-5-Clause
 */

/** @file
 * @brief Host-side test bench for the nRF71 Wi-Fi and Short-Range (SR)
 *        Coexistence Driver (CD).
 */

#include <zephyr/kernel.h>
#include <zephyr/sys/printk.h>

#include "coex_tb.h"
#include "coex_tb_tests.h"
#include "coex_tb_util.h"

/**
 * Entry point of the coexistence driver test bench.
 *
 * Startup order:
 *   1. The coexistence driver initialises through SYS_INIT (COEXC tables, work
 *      queue, CM2CD event callback, Wi-Fi state notifier). It configures the CM
 *      by itself once the Wi-Fi interface is up.
 *   2. coex_tb_prepare() waits for a stable Wi-Fi FMAC transport, lets the
 *      RPU/VIF settle, and waits for the driver's CM configuration when a
 *      CM-dependent test is enabled (unless INIT_AND_ENABLE waits for it itself).
 *   3. Run the test steps. Every coex_cm_* call returns once the driver has
 *      finished, so this application only has to check return codes.
 *
 * @retval 0 Every enabled test step passed.
 * @retval 1 Preparation or a test step failed.
 */
int main(void)
{
	int ret;

	printk("nRF71 Wi-Fi and Short-Range (SR) coexistence driver test bench\n");

#ifdef COEX_TB_DUMP_WIFI_BRINGUP_STATE
	coex_tb_dump_wifi_bringup_state();
#endif

	ret = coex_tb_prepare();
	if (ret != 0) {
		printk("Coex TB: preparation failed (%s)\n", coex_tb_errstr(ret));
		return 1;
	}

	ret = coex_tb_run_all();

	return (ret == 0) ? 0 : 1;
}
```

## src/coex_tb.h
```c
/*
 * Copyright (c) 2026 Nordic Semiconductor ASA
 *
 * SPDX-License-Identifier: LicenseRef-Nordic-5-Clause
 */

/** @file
 * @brief nRF71 SR coexistence driver test bench configuration.
 *
 * The bench exercises the driver's interfaces:
 *
 *   1. The application API (nrf71_sr_coex_init()), which stores the coexistence
 *      configuration the driver applies to the CM every time Wi-Fi comes up.
 *   2. The CD2CM command builders of the driver (coex_cm_*, declared in the
 *      driver's nrf71_sr_coex_internal.h). Each one posts a CD2CM command and
 *      waits for its CM2CD completion event.
 *   3. The Wi-Fi state the driver learns from the Wi-Fi driver's state notifier:
 *      the bench takes the Wi-Fi network interface down and up to drive the
 *      driver's CM bring-up and teardown, and feeds connected-channel changes
 *      to the BLE bad-channel mapping (cd_ble_*).
 *   4. SR driver to CD notifications (nrf71_sr_coex_sr_power_notify) and the SR
 *      driver callbacks the SR driver registers through nrf71_sr_coex_sr_register().
 *   5. Direct COEXC hardware programming which is register access rather than messaging.
 *
 * TEST ORDER MATTERS
 * ------------------
 * The steps below are not independent. COEXC hardware must be programmed before
 * CM arbitration has any effect, and the CM must be configured before
 * CM-dependent steps run.
 *
 * CM bring-up: the driver configures the CM by itself as soon as the Wi-Fi
 * interface is up. coex_tb_prepare() waits for that configuration when any
 * CM-dependent test is enabled and COEX_TB_TEST_INIT_AND_ENABLE is not. Enable
 * COEX_TB_TEST_INIT_AND_ENABLE to wait for it as a test step and to also report
 * the SR radio as powered up.
 */

#ifndef COEX_TB_H__
#define COEX_TB_H__

#include <stdint.h>

#include <nrf71_coex_if.h>
#include <drivers/nrf71_sr_coex/nrf71_sr_coex.h>

/* Timing (all values in milliseconds) */
/** Pause after a command whose effect needs a moment to be observable. */
#define COEX_TB_CMD_WAIT_MS            500U

/** Final drain time before the verdict is printed. */
#define COEX_TB_FINAL_WAIT_MS          2000U

/** Interval between polls while waiting for the Wi-Fi FMAC transport. */
#define COEX_TB_POLL_INTERVAL_MS       100U

/** Consecutive ready polls required before the transport is trusted. */
#define COEX_TB_TRANSPORT_STABLE_POLLS 5U

/** Extra time after transport looks ready, before CM commands (RPU/VIF settle). */
#define COEX_TB_RPU_SETTLE_MS          3000U

/**
 * How long to wait for the driver to finish configuring the CM after Wi-Fi
 * comes up. The driver repeats a failed CM configuration itself
 * (CONFIG_NRF71_SR_COEX_CM_RETRY_MAX), so this covers those retries as well.
 */
#define COEX_TB_CM_BRINGUP_TIMEOUT_MS  30000U

/** Give up waiting for the Wi-Fi transport after this long. */
#define COEX_TB_TRANSPORT_TIMEOUT_MS   60000U

/*
 * ---------------------------------------------------------------------------
 * Buffer sizes and blob layout
 * ---------------------------------------------------------------------------
 */

/**
 * Size of the CD2CM_UPDATE_COEX_PARAMS blob buffer.
 *
 * Taken straight from the driver's advertised limit, NRF71_SR_COEX_PARAMS_MAX_LEN
 * in the public header drivers/nrf71_sr_coex/nrf71_sr_coex.h.
 */
#define COEX_TB_COEX_PARAMS_BLOB_MAX NRF71_SR_COEX_PARAMS_MAX_LEN

/**
 * Byte offset of the shared-LNA-switch control field inside the decoded
 * NRF_COEX_PARAMS blob.
 */
#define COEX_TB_BLOB_LNASW_OFFSET 44U

/**
 * Print the Wi-Fi core bring-up state (WICR words and ipc0 regions) before the test
 * run starts. Diagnostic for a Wi-Fi transport that never comes up. Comment out to
 * skip it.
 */
#define COEX_TB_DUMP_WIFI_BRINGUP_STATE

/*
 * ---------------------------------------------------------------------------
 * Test selection: comment out a line to skip that step
 * ---------------------------------------------------------------------------
 */

/** Program the COEXC registers (direct register writes, no CM command). */
#define COEX_TB_TEST_CONFIGURE_COEXC

/** Reject bad arguments without disturbing CM state. Runs early on purpose. */
#define COEX_TB_TEST_NEGATIVE_ARGS

/** Wait for the driver's CM configuration and report the SR radio as powered up. */
#define COEX_TB_TEST_INIT_AND_ENABLE

/**
 * Take the Wi-Fi interface down, store the priority ranges and user params
 * through nrf71_sr_coex_init(), bring the interface up, and check the bring-up
 * sent the stored values. Re-configures the CM, so it runs before the steps that
 * set their own values.
 */
#define COEX_TB_TEST_STORE_BEFORE_UP

/** Send Wi-Fi and SR PTI priority ranges. */
#define COEX_TB_TEST_SET_PRIORITY_RANGES

/** Send protection probabilities and the shared-antenna mode. */
#define COEX_TB_TEST_UPDATE_COEX_USER_PARAMS

/** Send the built-in coexistence parameter blob. */
#define COEX_TB_TEST_UPDATE_COEX_PARAMETERS

/** Toggle coexistence off and on in the CM. */
#define COEX_TB_TEST_ENABLE_COEXISTENCE

/**
 * Number of enable/disable iterations.
 *
 * Iteration 1 enables, iteration 2 disables, and so on. Use an even count to
 * exercise both directions; the test re-enables coexistence when it finishes
 * regardless, so later steps always start from a known state.
 */
#define COEX_TB_NUM_ENABLE_COEX_TESTS 1U

/** Walk the shared-antenna allocation modes (dynamic, static Wi-Fi, static SR). */
#define COEX_TB_TEST_FORCE_ANTENNA_ALLOC

/** Walk the shared-LNA-switch control modes. */
#define COEX_TB_TEST_FORCE_LNASW_ALLOC

/**
 * Map a connected-state Wi-Fi channel onto the BLE data-channel classification.
 * The driver only builds the BLE mapping with CONFIG_NRF71_SR_COEX_BLE_CHAN_MAP.
 */
#ifdef CONFIG_NRF71_SR_COEX_BLE_CHAN_MAP
#define COEX_TB_TEST_BLE_CHAN_MAP
#endif

/** Read the CM counters and cross-check them. Keep this last. */
#define COEX_TB_TEST_GET_CM_STATS

/*
 * At least one enabled step needs the CM over the Wi-Fi FMAC path.
 * coex_tb_prepare() waits for the driver's CM configuration before the test
 * runner unless COEX_TB_TEST_INIT_AND_ENABLE is enabled (that step waits itself).
 */
#if defined(COEX_TB_TEST_STORE_BEFORE_UP) ||                                            \
	defined(COEX_TB_TEST_SET_PRIORITY_RANGES) ||                                        \
	defined(COEX_TB_TEST_UPDATE_COEX_USER_PARAMS) ||                                    \
	defined(COEX_TB_TEST_UPDATE_COEX_PARAMETERS) ||                                     \
	defined(COEX_TB_TEST_ENABLE_COEXISTENCE) ||                                         \
	defined(COEX_TB_TEST_FORCE_ANTENNA_ALLOC) ||                                        \
	defined(COEX_TB_TEST_FORCE_LNASW_ALLOC) ||                                          \
	defined(COEX_TB_TEST_GET_CM_STATS)
#define COEX_TB_NEEDS_CM_BRINGUP
#endif

/*
 * ---------------------------------------------------------------------------
 * BLE bad-channel mapping test parameters
 * ---------------------------------------------------------------------------
 * The worked example from both specifications: Wi-Fi channel 6 at 20 MHz with a
 * 3 MHz guard band guards 2424 to 2450 MHz, which makes BLE data channels 10
 * through 22 bad and leaves the rest available.
 */

/** Octets in a BLE Host Channel Classification map. */
#define COEX_TB_BLE_CHAN_MAP_SIZE      5U

/**
 * Minimum interval the driver keeps between two bt_le_set_chan_map() calls, in
 * ms. The driver waits it out before applying a map.
 */
#define COEX_TB_BLE_CHAN_MAP_MIN_INTERVAL_MS 1000U

/** Wi-Fi channel 6 centre frequency, in MHz. */
#define COEX_TB_WIFI_CH6_CENTER_MHZ    2437U

/** Wi-Fi channel 6 bandwidth, in MHz. */
#define COEX_TB_WIFI_CH6_BANDWIDTH_MHZ 20U

/**
 * Guard band applied either side of channel 6, in MHz. The driver takes it from
 * CONFIG_NRF71_SR_COEX_BLE_GUARD_BAND_MHZ, which must match.
 */
#define COEX_TB_WIFI_CH6_GUARD_MHZ     3U

/** A 5 GHz centre frequency, which must leave every BLE data channel available. */
#define COEX_TB_WIFI_5G_CENTER_MHZ     5180U

/** Bandwidth used for the 5 GHz and 6 GHz cases, in MHz. */
#define COEX_TB_WIFI_5G_BANDWIDTH_MHZ  80U

/** A 6 GHz centre frequency. */
#define COEX_TB_WIFI_6G_CENTER_MHZ     5955U

/** A bandwidth wide enough to cover the whole BLE band, used to test rejection. */
#define COEX_TB_WIFI_TOO_WIDE_MHZ      200U

#endif /* COEX_TB_H__ */
```

## src/coex_tb_stats.c
```c
/*
 * Copyright (c) 2026 Nordic Semiconductor ASA
 *
 * SPDX-License-Identifier: LicenseRef-Nordic-5-Clause
 */

/** @file
 * @brief CM statistics printing and consistency checking.
 */

#include <stdbool.h>

#include <zephyr/sys/printk.h>

#include "coex_tb.h"
#include "coex_tb_stats.h"

/**
 * Print one consistency check and report whether it failed.
 *
 * @return 1 if the check failed, 0 if it passed, so callers can sum the result.
 */
static unsigned int tb_check(unsigned int *check_num, bool pass, const char *what)
{
	(*check_num)++;
	printk("  [CHECK %02u] %-56s %s\n", *check_num, what, pass ? "PASS" : "FAIL");

	return pass ? 0U : 1U;
}

/** Per-event counters that only patched CM firmware reports. */
static void coex_tb_print_patch_stats(const struct cm_fsm_patch_stats_t *p)
{
	printk("\n==================== Patch Command Counts (cm_fsm_patch.c)\n");
	printk("  cm_coex_process_cmd_cnt_patch:      %u\n", p->cm_coex_process_cmd_cnt_patch);
	printk("  cmd_update_coex_params_cnt_patch:   %u\n", p->cmd_update_coex_params_cnt_patch);
	printk("  cmd_update_user_params_cnt_patch:   %u\n", p->cmd_update_user_params_cnt_patch);
	printk("  cmd_enable_coex_cnt_patch:          %u\n", p->cmd_enable_coex_cnt_patch);
	printk("  cmd_allocate_ppw_cnt_patch:         %u\n", p->cmd_allocate_ppw_cnt_patch);
	printk("  cmd_set_pti_ranges_cnt_patch:       %u\n", p->cmd_set_pti_ranges_cnt_patch);
	printk("  cmd_get_stats_cnt_patch:            %u\n", p->cmd_get_stats_cnt_patch);
	printk("  cmd_wifi_sw_client_req_cnt_patch:   %u\n", p->cmd_wifi_sw_client_req_cnt_patch);
}

static void coex_tb_print_stats(const struct cm_stats_t *s,
				const struct cm_fsm_patch_stats_t *patch_stats)
{
	printk("\n==================== PPW Statistics\n");
	printk("  init_count:                %u\n", s->init_count);
	printk("  ppw_start_msgs_cnt:        %u\n", s->ppw_start_msgs_cnt);
	printk("  ppw_stop_msgs_cnt:         %u\n", s->ppw_stop_msgs_cnt);
	printk("  ppw_stop_timeout_cnt:      %u\n", s->ppw_stop_timeout_cnt);
	printk("  num_wifi_pti_windows:      %u\n", s->num_wifi_pti_windows);
	printk("  num_sr_pti_windows:        %u\n", s->num_sr_pti_windows);
	printk("  wifi_ccconf_wifi_window:   %u\n", s->wifi_ccconf_wifi_window);
	printk("  wifi_ccconf_sr_window:     %u\n", s->wifi_ccconf_sr_window);
	printk("  ppw_invalid_params_cnt:    %u\n", s->ppw_invalid_params_cnt);
	printk("  ppw_invalid_request_cnt:   %u\n", s->ppw_invalid_request_cnt);

	printk("\n==================== Band Select\n");
	printk("  cfg_band_sel_5g_cnt:       %u\n", s->cfg_band_sel_5g_cnt);
	printk("  cfg_band_sel_2pt4g_cnt:    %u\n", s->cfg_band_sel_2pt4g_cnt);

	printk("\n==================== Wi-Fi SW Client Aggregate\n");
	printk("  wifi_sw_client_req_cnt:                        %u\n", s->wifi_sw_client_req_cnt);
	printk("  wifi_sw_client_rel_cnt:                        %u\n", s->wifi_sw_client_rel_cnt);
	printk("  wifi_sw_client_gnt_cnt:                        %u\n", s->wifi_sw_client_gnt_cnt);
	printk("  wifi_sw_client_rel_timeout_cnt:                %u\n",
	       s->wifi_sw_client_rel_timeout_cnt);
	printk("  wifi_sw_client_req_non2pt4g_band_cnt:          %u\n",
	       s->wifi_sw_client_req_non2pt4g_band_cnt);
	printk("  wifi_sw_client_req_2pt4g_band_cnt:             %u\n",
	       s->wifi_sw_client_req_2pt4g_band_cnt);
	printk("  wifi_sw_client_decison_in_favour_cnt_2pt4g:    %u\n",
	       s->wifi_sw_client_decison_in_favour_cnt_2pt4g);
	printk("  wifi_sw_client_decison_not_in_favour_cnt_2pt4g:%u\n",
	       s->wifi_sw_client_decison_not_in_favour_cnt_2pt4g);
	printk("  wifi_sw_client_no_gnt_cnt_2pt4g:               %u\n",
	       s->wifi_sw_client_no_gnt_cnt_2pt4g);
	printk("  wifi_sw_client_no_gnt_cnt_non_2pt4g:           %u\n",
	       s->wifi_sw_client_no_gnt_cnt_non_2pt4g);
	printk("  wifi_sw_client_rel_cnt_2pt4g:                  %u\n",
	       s->wifi_sw_client_rel_cnt_2pt4g);
	printk("  wifi_sw_client_rel_cnt_non_2pt4g:              %u\n",
	       s->wifi_sw_client_rel_cnt_non_2pt4g);
	printk("  wifi_sw_client_gnt_cnt_2pt4g:                  %u\n",
	       s->wifi_sw_client_gnt_cnt_2pt4g);
	printk("  wifi_sw_client_gnt_cnt_non_2pt4g:              %u\n",
	       s->wifi_sw_client_gnt_cnt_non_2pt4g);

	printk("\n==================== Wi-Fi Per-Client Req/Rel/Gnt\n");
	printk("  wifi_beacon_rx_req_cnt:    %u\n", s->wifi_beacon_rx_req_cnt);
	printk("  wifi_conn_req_cnt:         %u\n", s->wifi_conn_req_cnt);
	printk("  wifi_calib_req_cnt:        %u\n", s->wifi_calib_req_cnt);
	printk("  wifi_scan_req_cnt:         %u\n", s->wifi_scan_req_cnt);
	printk("  wifi_beacon_rx_rel_cnt:    %u\n", s->wifi_beacon_rx_rel_cnt);
	printk("  wifi_conn_rel_cnt:         %u\n", s->wifi_conn_rel_cnt);
	printk("  wifi_calib_rel_cnt:        %u\n", s->wifi_calib_rel_cnt);
	printk("  wifi_scan_rel_cnt:         %u\n", s->wifi_scan_rel_cnt);
	printk("  wifi_beacon_rx_gnt_cnt:    %u\n", s->wifi_beacon_rx_gnt_cnt);
	printk("  wifi_conn_gnt_cnt:         %u\n", s->wifi_conn_gnt_cnt);
	printk("  wifi_calib_gnt_cnt:        %u\n", s->wifi_calib_gnt_cnt);
	printk("  wifi_scan_gnt_cnt:         %u\n", s->wifi_scan_gnt_cnt);
	printk("  wifi_beacon_rx_no_gnt_cnt: %u\n", s->wifi_beacon_rx_no_gnt_cnt);
	printk("  wifi_conn_no_gnt_cnt:      %u\n", s->wifi_conn_no_gnt_cnt);
	printk("  wifi_calib_no_gnt_cnt:     %u\n", s->wifi_calib_no_gnt_cnt);
	printk("  wifi_scan_no_gnt_cnt:      %u\n", s->wifi_scan_no_gnt_cnt);
	printk("  wifi_beacon_rx_rel_to_cnt: %u\n", s->wifi_beacon_rx_rel_to_cnt);
	printk("  wifi_conn_rel_to_cnt:      %u\n", s->wifi_conn_rel_to_cnt);
	printk("  wifi_calib_rel_to_cnt:     %u\n", s->wifi_calib_rel_to_cnt);
	printk("  wifi_scan_rel_to_cnt:      %u\n", s->wifi_scan_rel_to_cnt);

	printk("\n==================== SR Rx Protection\n");
	printk("  sr_rx_prot_success_cnt_2pt4g:                  %u\n",
	       s->sr_rx_prot_success_cnt_2pt4g);
	printk("  sr_rx_prot_fail_cnt_2pt4g:                     %u\n",
	       s->sr_rx_prot_fail_cnt_2pt4g);
	printk("  sr_rx_prot_success_cnt_non_2pt4g:              %u\n",
	       s->sr_rx_prot_success_cnt_non_2pt4g);
	printk("  sr_rx_prot_fail_cnt_non_2pt4g:                 %u\n",
	       s->sr_rx_prot_fail_cnt_non_2pt4g);
	printk("  sr_rx_prot_inact2listen_ps_cnt_2pt4g:          %u\n",
	       s->sr_rx_prot_inact2listen_ps_cnt_2pt4g);
	printk("  sr_rx_prot_listen2inact_ps_cnt_2pt4g:          %u\n",
	       s->sr_rx_prot_listen2inact_ps_cnt_2pt4g);
	printk("  sr_rx_prot_inact2listen_calib_cnt_2pt4g:       %u\n",
	       s->sr_rx_prot_inact2listen_calib_cnt_2pt4g);
	printk("  sr_rx_prot_listen2inact_calib_cnt_2pt4g:       %u\n",
	       s->sr_rx_prot_listen2inact_calib_cnt_2pt4g);
	printk("  sr_rx_prot_inact2listen_ps_cnt_non_2pt4g:      %u\n",
	       s->sr_rx_prot_inact2listen_ps_cnt_non_2pt4g);
	printk("  sr_rx_prot_listen2inact_ps_cnt_non_2pt4g:      %u\n",
	       s->sr_rx_prot_listen2inact_ps_cnt_non_2pt4g);
	printk("  sr_rx_prot_inact2listen_calib_cnt_non_2pt4g:   %u\n",
	       s->sr_rx_prot_inact2listen_calib_cnt_non_2pt4g);
	printk("  sr_rx_prot_listen2inact_calib_cnt_non_2pt4g:   %u\n",
	       s->sr_rx_prot_listen2inact_calib_cnt_non_2pt4g);
	printk("  sr_rx_prot_2pt4g_band_cnt:                     %u\n",
	       s->sr_rx_prot_2pt4g_band_cnt);
	printk("  sr_rx_prot_non2pt4g_band_cnt:                  %u\n",
	       s->sr_rx_prot_non2pt4g_band_cnt);
	printk("  sr_rx_prot_force_wifi_cnt_2pt4g:               %u\n",
	       s->sr_rx_prot_force_wifi_cnt_2pt4g);

	printk("\n==================== Coex Enable/Disable\n");
	printk("  coex_enable_cnt:           %u\n", s->coex_enable_cnt);
	printk("  coex_disable_cnt:          %u\n", s->coex_disable_cnt);

	printk("\n==================== ANTSWC Configuration\n");
	printk("  antswc_inhibit_cfg_cnt:          %u\n", s->antswc_inhibit_cfg_cnt);
	printk("  antswc_anten_override_cfg_cnt:   %u\n", s->antswc_anten_override_cfg_cnt);
	printk("  antswc_pa_override_cfg_cnt:      %u\n", s->antswc_pa_override_cfg_cnt);
	printk("  antswc_lnasw_override_cfg_cnt:   %u\n", s->antswc_lnasw_override_cfg_cnt);

	printk("\n==================== CCCONF\n");
	printk("  wifi_ccconf_save_cnt:      %u\n", s->wifi_ccconf_save_cnt);
	printk("  wifi_ccconf_restore_cnt:   %u\n", s->wifi_ccconf_restore_cnt);

	printk("\n==================== Command Counts\n");
	printk("  cmd_update_coex_params_cnt:   %u\n", s->cmd_update_coex_params_cnt);
	printk("  cmd_update_user_params_cnt:   %u\n", s->cmd_update_user_params_cnt);
	printk("  cmd_enable_coex_cnt:          %u\n", s->cmd_enable_coex_cnt);
	printk("  cmd_allocate_ppw_cnt:         %u\n", s->cmd_allocate_ppw_cnt);
	printk("  cmd_set_pti_ranges_cnt:       %u\n", s->cmd_set_pti_ranges_cnt);
	printk("  cmd_sw_client_req_cnt:        %u\n", s->cmd_sw_client_req_cnt);
	printk("  cmd_get_stats_cnt:            %u\n", s->cmd_get_stats_cnt);

	printk("\n==================== Events\n");
	printk("  stats_event_to_host_cnt:           %u\n", s->stats_event_to_host_cnt);
	if (patch_stats != NULL) {
		printk("  coex_params_event_to_host_cnt:     %u\n",
		       patch_stats->coex_params_event_to_host_cnt);
		printk("  user_params_event_to_host_cnt:     %u\n",
		       patch_stats->user_params_event_to_host_cnt);
		printk("  enable_coex_event_to_host_cnt:     %u\n",
		       patch_stats->enable_coex_event_to_host_cnt);
		printk("  allocate_ppw_event_to_host_cnt:    %u\n",
		       patch_stats->allocate_ppw_event_to_host_cnt);
		printk("  set_pti_ranges_event_to_host_cnt:  %u\n",
		       patch_stats->set_pti_ranges_event_to_host_cnt);
		printk("  wifi_sw_client_event_to_host_cnt:  %u\n",
		       patch_stats->wifi_sw_client_event_to_host_cnt);
	} else {
		printk("  sw_client_event_to_host_cnt:       %u\n",
		       s->sw_client_event_to_host_cnt);
		printk("  (patch per-event counters require cm_fsm_patch_stats_t payload)\n");
	}

	/*
	 * These should all be zero. A non-zero value means the CM rejected
	 * something the test bench (or the driver) sent it.
	 */
	printk("\n==================== Error Counts\n");
	printk("  cd2cm_null_cmd_buf_cnt:                  %u\n", s->cd2cm_null_cmd_buf_cnt);
	printk("  cd2cm_invalid_msg_id_cnt:                %u\n", s->cd2cm_invalid_msg_id_cnt);
	printk("  coex_params_buf_error:                   %u\n", s->coex_params_buf_error);
	printk("  user_params_buf_error:                   %u\n", s->user_params_buf_error);
	printk("  en_coex_buf_error:                       %u\n", s->en_coex_buf_error);
	printk("  ppw_buf_error:                           %u\n", s->ppw_buf_error);
	printk("  set_pti_ranges_buf_error:                %u\n", s->set_pti_ranges_buf_error);
	printk("  sw_client_req_buf_error:                 %u\n", s->sw_client_req_buf_error);
	printk("  event_buf_unavailable_cnt:               %u\n", s->event_buf_unavailable_cnt);
	printk("  unknown_event_to_host:                   %u\n", s->unknown_event_to_host);
	printk("  wifi_wrong_sw_client_id_cnt:             %u\n", s->wifi_wrong_sw_client_id_cnt);
	printk("  wifi_wrong_sw_client_request_type_cnt:   %u\n",
	       s->wifi_wrong_sw_client_request_type_cnt);
	printk("  wrong_antswc_ctrl_type_cnt:              %u\n", s->wrong_antswc_ctrl_type_cnt);
	printk("  wrong_wifi_hw_client_pti_level_cnt:      %u\n",
	       s->wrong_wifi_hw_client_pti_level_cnt);
	printk("  wrong_input_populate_pti_cnt:            %u\n", s->wrong_input_populate_pti_cnt);
	printk("  wrong_sr_rx_prot_scenario_cnt:           %u\n",
	       s->wrong_sr_rx_prot_scenario_cnt);
	printk("  wrong_sr_rx_prot_perc_prob_cnt:          %u\n",
	       s->wrong_sr_rx_prot_perc_prob_cnt);
	printk("  wrong_wifi_sw_client_id_cnt:             %u\n", s->wrong_wifi_sw_client_id_cnt);
	printk("  wrong_wifi_sw_client_perc_prob_cnt:      %u\n",
	       s->wrong_wifi_sw_client_perc_prob_cnt);
	printk("  zero_ppw_win_duration_cnt:               %u\n", s->zero_ppw_win_duration_cnt);
	printk("  zero_ppw_timeout_cnt:                    %u\n", s->zero_ppw_timeout_cnt);
}

/**
 * Cross-check the CM counters against each other.
 *
 * Every check here is an identity that must hold regardless of what the test
 * bench did, so a failure points at the CM's bookkeeping rather than at the
 * test sequence.
 *
 * @return Number of failed checks.
 */
static unsigned int coex_tb_validate_stats(const struct cm_stats_t *s)
{
	unsigned int check_num = 0U;
	unsigned int failures = 0U;

	printk("\n==================== Validation Checks\n");

	/* Every request eventually ends either in an explicit release or a timeout. */
	failures += tb_check(&check_num,
			     s->wifi_sw_client_req_cnt ==
				     s->wifi_sw_client_rel_cnt +
					     s->wifi_sw_client_rel_timeout_cnt,
			     "Wi-Fi SW req == rel + rel_timeout");

	/* Every request was counted in exactly one band bucket. */
	failures += tb_check(&check_num,
			     s->wifi_sw_client_req_cnt ==
				     s->wifi_sw_client_req_non2pt4g_band_cnt +
					     s->wifi_sw_client_req_2pt4g_band_cnt,
			     "Wi-Fi SW req == non2pt4g_band + 2pt4g_band");

	/* Every request was either granted or lost the 2.4 GHz arbitration. */
	failures += tb_check(&check_num,
			     s->wifi_sw_client_req_cnt ==
				     s->wifi_sw_client_gnt_cnt +
					     s->wifi_sw_client_decison_not_in_favour_cnt_2pt4g,
			     "Wi-Fi SW req == gnt + not_in_favour_2pt4g");

	/* Grants come from non-2.4 GHz (no contention) plus won 2.4 GHz decisions. */
	failures += tb_check(&check_num,
			     s->wifi_sw_client_gnt_cnt ==
				     s->wifi_sw_client_req_non2pt4g_band_cnt +
					     s->wifi_sw_client_decison_in_favour_cnt_2pt4g,
			     "Wi-Fi SW gnt == non2pt4g_band + in_favour_2pt4g");

	/* Aggregate counters must equal the sum over the four Wi-Fi client types. */
	failures += tb_check(&check_num,
			     s->wifi_sw_client_req_cnt ==
				     s->wifi_beacon_rx_req_cnt + s->wifi_conn_req_cnt +
					     s->wifi_calib_req_cnt + s->wifi_scan_req_cnt,
			     "Wi-Fi SW req == sum(per-client req)");

	failures += tb_check(&check_num,
			     s->wifi_sw_client_rel_cnt ==
				     s->wifi_beacon_rx_rel_cnt + s->wifi_conn_rel_cnt +
					     s->wifi_calib_rel_cnt + s->wifi_scan_rel_cnt,
			     "Wi-Fi SW rel == sum(per-client rel)");

	failures += tb_check(&check_num,
			     s->wifi_sw_client_gnt_cnt ==
				     s->wifi_beacon_rx_gnt_cnt + s->wifi_conn_gnt_cnt +
					     s->wifi_calib_gnt_cnt + s->wifi_scan_gnt_cnt,
			     "Wi-Fi SW gnt == sum(per-client gnt)");

	failures += tb_check(&check_num,
			     s->wifi_sw_client_rel_timeout_cnt ==
				     s->wifi_beacon_rx_rel_to_cnt + s->wifi_conn_rel_to_cnt +
					     s->wifi_calib_rel_to_cnt + s->wifi_scan_rel_to_cnt,
			     "Wi-Fi SW rel_timeout == sum(per-client rel_to)");

	/* The same request/grant and request/release identities, per client type. */
	failures += tb_check(&check_num,
			     s->wifi_beacon_rx_req_cnt ==
				     s->wifi_beacon_rx_gnt_cnt + s->wifi_beacon_rx_no_gnt_cnt,
			     "Wi-Fi beacon_rx: req == gnt + no_gnt");

	failures += tb_check(&check_num,
			     s->wifi_beacon_rx_req_cnt ==
				     s->wifi_beacon_rx_rel_cnt + s->wifi_beacon_rx_rel_to_cnt,
			     "Wi-Fi beacon_rx: req == rel + rel_to");

	failures += tb_check(&check_num,
			     s->wifi_conn_req_cnt ==
				     s->wifi_conn_gnt_cnt + s->wifi_conn_no_gnt_cnt,
			     "Wi-Fi conn: req == gnt + no_gnt");

	failures += tb_check(&check_num,
			     s->wifi_conn_req_cnt ==
				     s->wifi_conn_rel_cnt + s->wifi_conn_rel_to_cnt,
			     "Wi-Fi conn: req == rel + rel_to");

	failures += tb_check(&check_num,
			     s->wifi_calib_req_cnt ==
				     s->wifi_calib_gnt_cnt + s->wifi_calib_no_gnt_cnt,
			     "Wi-Fi calib: req == gnt + no_gnt");

	failures += tb_check(&check_num,
			     s->wifi_calib_req_cnt ==
				     s->wifi_calib_rel_cnt + s->wifi_calib_rel_to_cnt,
			     "Wi-Fi calib: req == rel + rel_to");

	failures += tb_check(&check_num,
			     s->wifi_scan_req_cnt ==
				     s->wifi_scan_gnt_cnt + s->wifi_scan_no_gnt_cnt,
			     "Wi-Fi scan: req == gnt + no_gnt");

	failures += tb_check(&check_num,
			     s->wifi_scan_req_cnt ==
				     s->wifi_scan_rel_cnt + s->wifi_scan_rel_to_cnt,
			     "Wi-Fi scan: req == rel + rel_to");

	/* Every SR Rx protection attempt either succeeded or failed. */
	failures += tb_check(&check_num,
			     s->sr_rx_prot_2pt4g_band_cnt ==
				     s->sr_rx_prot_success_cnt_2pt4g +
					     s->sr_rx_prot_fail_cnt_2pt4g,
			     "SR Rx prot 2.4G: band == success + fail");

	failures += tb_check(&check_num,
			     s->sr_rx_prot_non2pt4g_band_cnt ==
				     s->sr_rx_prot_success_cnt_non_2pt4g +
					     s->sr_rx_prot_fail_cnt_non_2pt4g,
			     "SR Rx prot non-2.4G: band == success + fail");

	/* ... and was attributed to exactly one of the four protection scenarios. */
	failures += tb_check(&check_num,
			     s->sr_rx_prot_2pt4g_band_cnt ==
				     s->sr_rx_prot_inact2listen_ps_cnt_2pt4g +
					     s->sr_rx_prot_listen2inact_ps_cnt_2pt4g +
					     s->sr_rx_prot_inact2listen_calib_cnt_2pt4g +
					     s->sr_rx_prot_listen2inact_calib_cnt_2pt4g,
			     "SR Rx prot 2.4G: band == sum(scenario counts)");

	failures += tb_check(&check_num,
			     s->sr_rx_prot_non2pt4g_band_cnt ==
				     s->sr_rx_prot_inact2listen_ps_cnt_non_2pt4g +
					     s->sr_rx_prot_listen2inact_ps_cnt_non_2pt4g +
					     s->sr_rx_prot_inact2listen_calib_cnt_non_2pt4g +
					     s->sr_rx_prot_listen2inact_calib_cnt_non_2pt4g,
			     "SR Rx prot non-2.4G: band == sum(scenario counts)");

	/* Each coex-params command reprograms the ANTSWC inhibit/PA/LNA overrides. */
	failures += tb_check(&check_num,
			     s->antswc_inhibit_cfg_cnt == s->cmd_update_coex_params_cnt,
			     "ANTSWC inhibit_cfg == cmd_update_coex_params");

	/* Each user-params command reprograms the antenna override. */
	failures += tb_check(&check_num,
			     s->antswc_anten_override_cfg_cnt == s->cmd_update_user_params_cnt,
			     "ANTSWC anten_override_cfg == cmd_update_user_params");

	failures += tb_check(&check_num,
			     s->antswc_pa_override_cfg_cnt == s->cmd_update_coex_params_cnt,
			     "ANTSWC pa_override_cfg == cmd_update_coex_params");

	failures += tb_check(&check_num,
			     s->antswc_lnasw_override_cfg_cnt == s->cmd_update_coex_params_cnt,
			     "ANTSWC lnasw_override_cfg == cmd_update_coex_params");

	/* Wi-Fi CCCONF is saved before an SR window and restored after it. */
	failures += tb_check(&check_num,
			     s->wifi_ccconf_save_cnt == s->wifi_ccconf_restore_cnt,
			     "Wi-Fi CCCONF save == restore");

	/* Every PPW command was either a start or a stop. */
	failures += tb_check(&check_num,
			     s->cmd_allocate_ppw_cnt ==
				     s->ppw_start_msgs_cnt + s->ppw_stop_msgs_cnt,
			     "cmd_allocate_ppw == ppw_start + ppw_stop");

	printk("\n============ End of Validation: %u checks, %u failed ============\n\n",
	       check_num, failures);

	return failures;
}

unsigned int coex_tb_print_and_validate_stats(const struct cm_stats_t *stats,
					      const struct cm_fsm_patch_stats_t *patch_stats)
{
	unsigned int failures;

	if (stats == NULL) {
		printk("Coex TB stats: no statistics payload to validate\n");
		return 1U;
	}

	coex_tb_print_stats(stats, patch_stats);
	failures = coex_tb_validate_stats(stats);

	if (patch_stats != NULL) {
		coex_tb_print_patch_stats(patch_stats);
	} else {
		/* Unpatched CM firmware: informational, not a failure. */
		printk("\nPatch command counters not available in this CM2CD event payload.\n");
	}

	return failures;
}
```

## src/coex_tb_util.h
```c
/*
 * Copyright (c) 2026 Nordic Semiconductor ASA
 *
 * SPDX-License-Identifier: LicenseRef-Nordic-5-Clause
 */

/** @file
 * @brief Test bench utilities: transport readiness and timing helpers.
 *
 * The test bench never waits for CM2CD events itself, because the coexistence
 * driver already does that inside every coex_cm_* call. The waiting done here is
 * for the Wi-Fi transport to come up at startup, for the RPU to settle, and for
 * the driver's CM configuration before CM-dependent test steps run.
 */

#ifndef COEX_TB_UTIL_H__
#define COEX_TB_UTIL_H__

#include <stdbool.h>
#include <stdint.h>

#ifdef COEX_TB_DUMP_WIFI_BRINGUP_STATE
/**
 * Print the Wi-Fi core bring-up state: WICR contents against the values
 * devicetree expects, and the ipc0 shared-memory regions.
 *
 * Diagnostic for a transport that never comes up. The Wi-Fi driver's
 * "Firmware booted successfully" line reports a stubbed constant and proves
 * nothing, so this reads the two things that do carry evidence: whether the
 * WICR words (LMAC/UMAC entry points and IPC mailbox descriptors) actually
 * took, and whether the ICMsg magic appeared in each direction. Magic in the
 * host TX region but not in RX means the Wi-Fi core never ran its IPC init.
 *
 * Safe to call before the transport is up; it only reads memory.
 */
void coex_tb_dump_wifi_bringup_state(void);
#endif /* COEX_TB_DUMP_WIFI_BRINGUP_STATE */

/**
 * Block until the Wi-Fi FMAC coexistence transport is ready.
 *
 * Coexistence commands travel to the RPU over the Wi-Fi driver's control path,
 * so nothing can be tested until the Wi-Fi driver has booted the RPU.
 *
 * @param timeout_ms Give up after this long.
 *
 * @retval 0           Transport is ready.
 * @retval -ETIMEDOUT  Still not ready after timeout_ms.
 */
int coex_tb_wait_transport_ready(uint32_t timeout_ms);

/** True when the driver reports the CM configuration as active. */
bool coex_tb_cm_is_active(void);

/**
 * Wait until the driver has configured the CM.
 *
 * The driver configures the CM by itself every time the Wi-Fi interface comes
 * up, and retries a failed configuration.
 *
 * @retval 0          The CM configuration is active.
 * @retval -EIO       The driver gave up on the CM configuration.
 * @retval -ETIMEDOUT Still not active after timeout_ms.
 */
int coex_tb_wait_cm_active(uint32_t timeout_ms);

/**
 * Take the Wi-Fi network interface administratively down.
 *
 * The Wi-Fi driver reports the last interface going down to the coexistence
 * driver before the interface is torn down, which ends the CM session.
 */
int coex_tb_wifi_iface_down(void);

/**
 * Bring the Wi-Fi network interface administratively up again.
 *
 * The Wi-Fi driver reports the interface coming up to the coexistence driver,
 * which then configures the CM from scratch in the background.
 */
int coex_tb_wifi_iface_up(void);

/**
 * Prepare the test bench environment before running test steps.
 *
 * Waits for a stable transport, pauses for RPU/VIF settle time, and waits for
 * the driver's CM configuration when a CM-dependent test is enabled and
 * COEX_TB_TEST_INIT_AND_ENABLE is not.
 *
 * @retval 0           Preparation succeeded.
 * @retval -ETIMEDOUT  Transport or CM configuration not ready in time.
 * @retval -EIO        CM configuration failed.
 */
int coex_tb_prepare(void);

/** Sleep between test steps, letting the CM act on what was just sent. */
void coex_tb_wait_ms(uint32_t wait_ms);

/**
 * Human-readable description of a return code.
 *
 * Negative values are interpreted as errno codes (for example -22 is "EINVAL").
 * Zero returns "success". Positive values are described as a Bluetooth or
 * driver-specific status code.
 */
const char *coex_tb_errstr(int err);

#endif /* COEX_TB_UTIL_H__ */
```
