## CMakeLists.txt
```
#
# Copyright (c) 2026 Nordic Semiconductor ASA
#
# SPDX-License-Identifier: LicenseRef-Nordic-5-Clause
#

cmake_minimum_required(VERSION 3.20.0)

# The WICR LMAC/UMAC ROM patch addresses must point at the patch regions, or
# the RPU boots unpatched ROM, which has no CM2CD command handling. The dtsi
# must match the patch selected through WIFI_NRF71_PATCH_VERSION. Do not also
# pass a patch dtsi through EXTRA_DTC_OVERLAY_FILE.
list(APPEND EXTRA_DTC_OVERLAY_FILE
     ${CMAKE_CURRENT_LIST_DIR}/../../../../nrfxlib/nrf71_wifi/bins/0.1.0/nrf7120_wifi_patch.dtsi)

find_package(Zephyr REQUIRED HINTS $ENV{ZEPHYR_BASE})
project(nrf71_sr_coex)

target_sources(app PRIVATE
  src/main.c
  src/coex_tb_util.c
  src/coex_tb_params.c
  src/coex_tb_stats.c
  src/coex_tb_tests.c
)

# With the mock enabled the linker sends every bt_le_set_chan_map() call, the
# coexistence driver's included, to __wrap_bt_le_set_chan_map() in
# src/coex_tb_bt_mock.c, so the BLE channel map test does not depend on what the
# Bluetooth Controller supports.
if(CONFIG_COEX_TB_MOCK_BT_CHAN_MAP)
  target_sources(app PRIVATE src/coex_tb_bt_mock.c)
  zephyr_ld_options(-Wl,--wrap=bt_le_set_chan_map)
endif()

# The coexistence driver application API is the public header
# <drivers/nrf71_sr_coex/nrf71_sr_coex.h>. The bench also drives the CD2CM command
# builders, COEXC programming, BLE channel mapping and statistics through the
# driver's internal header nrf71_sr_coex_internal.h. The Wi-Fi directories give
# access to the Wi-Fi firmware interface headers (CD2CM/CM2CD message types).
target_include_directories(app PRIVATE
  ${ZEPHYR_NRF_MODULE_DIR}/drivers/nrf71_sr_coex/src
  ${ZEPHYR_NRF_MODULE_DIR}/drivers/wifi/nrf71/inc
  ${ZEPHYR_NRF_MODULE_DIR}/drivers/wifi/nrf71/inc/common/fw_if
)
```

## Kconfig
```
# Copyright (c) 2026 Nordic Semiconductor ASA
#
# SPDX-License-Identifier: LicenseRef-Nordic-5-Clause
#

mainmenu "nRF71 SR coexistence driver full test bench"

config COEX_TB_MOCK_BT_CHAN_MAP
	bool "Mock bt_le_set_chan_map() in the BLE channel map test"
	default y
	help
	  The Bluetooth Controller on the board may not support the Set Host
	  Channel Classification command, in which case the Bluetooth host
	  rejects every channel map with -ENOTSUP before any HCI command is sent.
	  The coexistence driver cannot be blamed for that, but the test then
	  cannot show that the driver hands the right map to the Controller.

	  When enabled, the linker redirects bt_le_set_chan_map() to a mock in
	  the test bench. The mock records every map the driver offers and can
	  reject the first attempt, so the test checks the map content, the retry,
	  the newest-wins ordering and the restore of the default map.

	  Disable it to run against the real Bluetooth Controller. The test then
	  skips the checks that need the Controller if it rejects the map.

source "Kconfig.zephyr"
```

## prj.conf
```kconfig
# Copyright (c) 2026 Nordic Semiconductor ASA
#
# SPDX-License-Identifier: LicenseRef-Nordic-5-Clause
#

# The Wi-Fi and Short-Range coexistence driver under test.
CONFIG_NRF71_SR_COEX_DRIVER=y

# The coexistence driver sits between: the nRF71 Wi-Fi driver owns
# the FMAC transport that carries CD2CM commands to the RPU, and
# the Short-Range (for example, Bluetooth) side of the arbitration.
CONFIG_WIFI=y
CONFIG_WIFI_NM_WPA_SUPPLICANT=y
CONFIG_BT=y

# The Coexistence Manager command handling lives in the Wi-Fi ROM patch. The
# board overlay points WICR at the patch regions, so the patch must be merged
# into the flashed image.
CONFIG_WIFI_NRF71_PATCH=y

# bt_le_set_chan_map() returns -ENOTSUP unless the Controller is a central or a
# broadcaster, so the BLE bad-channel mapping test needs one of the two roles.
CONFIG_BT_CENTRAL=y

# Build the driver's BLE bad-channel mapping, which the BLE channel map test checks.
CONFIG_NRF71_SR_COEX_BLE_CHAN_MAP=y

# Replace bt_le_set_chan_map() with a recording mock in the BLE channel map test.
# The Controller may not support Set Host Channel Classification (the host then
# returns -ENOTSUP without sending anything), which hides the driver behaviour.
# Set to n to run against the real Controller.
CONFIG_COEX_TB_MOCK_BT_CHAN_MAP=y

# Networking (Wi-Fi driver build dependency).
CONFIG_NETWORKING=y
CONFIG_NET_L2_ETHERNET=y
CONFIG_NET_L2_ETHERNET_MGMT=y
CONFIG_NET_MGMT=y
CONFIG_NET_MGMT_EVENT=y

CONFIG_NET_PKT_RX_COUNT=16
CONFIG_NET_PKT_TX_COUNT=16
CONFIG_NET_BUF_RX_COUNT=16
CONFIG_NET_BUF_TX_COUNT=32
CONFIG_HEAP_MEM_POOL_SIZE=230000

# IPC transport to the RPU.
CONFIG_IPC_SERVICE_BACKEND_ICMSG_WQ_ENABLE=y
CONFIG_IPC_SERVICE_BACKEND_ICMSG_WQ_STACK_SIZE=5600

# Logging. Immediate mode keeps driver log lines interleaved with the test
# bench printk output in the right order, which matters when reading a failure.
CONFIG_LOG=y
CONFIG_LOG_MODE_IMMEDIATE=y
CONFIG_NRF71_SR_COEX_DRIVER_LOG_LEVEL_DBG=y

# Keep the Wi-Fi driver debug logging off so it does not bury the test bench output.
CONFIG_WIFI_NRF71_LOG_LEVEL_DBG=n

# Set to y to open an MPC override on the Wi-Fi debug register window
# (0x48000000) so a debugger can reach the LMAC/UMAC VPRs. Useful to tell "Wi-Fi
# core never started" apart from "core runs but the ipc0 ICMsg peer never binds",
# because nrf_wifi_fmac_ver_get() is stubbed and its "booted successfully" log
# line does not touch the RPU. Disabled by default.
CONFIG_SOC_NRF71_WIFI_DAP=n

CONFIG_MAIN_STACK_SIZE=8192
```

## src/coex_tb_bt_mock.c
```c
/*
 * Copyright (c) 2026 Nordic Semiconductor ASA
 *
 * SPDX-License-Identifier: LicenseRef-Nordic-5-Clause
 */

/** @file
 * @brief Mock of bt_le_set_chan_map(), see coex_tb_bt_mock.h.
 *
 * The test CMakeLists.txt passes -Wl,--wrap=bt_le_set_chan_map, which makes the
 * linker resolve every reference to bt_le_set_chan_map() to
 * __wrap_bt_le_set_chan_map() below. The real function is not called.
 */

#include <string.h>

#include <zephyr/kernel.h>
#include <zephyr/spinlock.h>
#include <zephyr/sys/printk.h>

#include "coex_tb_bt_mock.h"

#define MOCK_POLL_MS 20

static struct k_spinlock mock_lock;
static unsigned int mock_calls;
static unsigned int mock_accepted;
static unsigned int mock_fail_left;
static int mock_fail_err;
static uint8_t mock_last_map[COEX_TB_BT_MOCK_MAP_SIZE];

/** Linker-wrapped replacement for bt_le_set_chan_map(). */
int __wrap_bt_le_set_chan_map(uint8_t chan_map[COEX_TB_BT_MOCK_MAP_SIZE]);

int __wrap_bt_le_set_chan_map(uint8_t chan_map[COEX_TB_BT_MOCK_MAP_SIZE])
{
	k_spinlock_key_t key;
	int ret = 0;

	key = k_spin_lock(&mock_lock);
	mock_calls++;
	if (mock_fail_left > 0U) {
		mock_fail_left--;
		ret = mock_fail_err;
	} else {
		mock_accepted++;
		memcpy(mock_last_map, chan_map, sizeof(mock_last_map));
	}
	k_spin_unlock(&mock_lock, key);

	printk("  [BT mock] bt_le_set_chan_map(%02x %02x %02x %02x %02x) -> %d (%s)\n",
	       chan_map[0], chan_map[1], chan_map[2], chan_map[3], chan_map[4], ret,
	       (ret == 0) ? "accepted" : "rejected");

	return ret;
}

void coex_tb_bt_mock_reset(void)
{
	k_spinlock_key_t key = k_spin_lock(&mock_lock);

	mock_calls = 0U;
	mock_accepted = 0U;
	mock_fail_left = 0U;
	mock_fail_err = 0;
	memset(mock_last_map, 0, sizeof(mock_last_map));
	k_spin_unlock(&mock_lock, key);
}

void coex_tb_bt_mock_fail_next(unsigned int count, int err)
{
	k_spinlock_key_t key = k_spin_lock(&mock_lock);

	mock_fail_left = count;
	mock_fail_err = err;
	k_spin_unlock(&mock_lock, key);
}

unsigned int coex_tb_bt_mock_calls(void)
{
	k_spinlock_key_t key = k_spin_lock(&mock_lock);
	unsigned int calls = mock_calls;

	k_spin_unlock(&mock_lock, key);

	return calls;
}

unsigned int coex_tb_bt_mock_accepted(void)
{
	k_spinlock_key_t key = k_spin_lock(&mock_lock);
	unsigned int accepted = mock_accepted;

	k_spin_unlock(&mock_lock, key);

	return accepted;
}

bool coex_tb_bt_mock_last_accepted(uint8_t map[COEX_TB_BT_MOCK_MAP_SIZE])
{
	k_spinlock_key_t key = k_spin_lock(&mock_lock);
	bool have_map = (mock_accepted > 0U);

	if (have_map) {
		memcpy(map, mock_last_map, sizeof(mock_last_map));
	}
	k_spin_unlock(&mock_lock, key);

	return have_map;
}

bool coex_tb_bt_mock_wait_accepted(unsigned int count, uint32_t timeout_ms)
{
	int64_t deadline = k_uptime_get() + (int64_t)timeout_ms;

	while (coex_tb_bt_mock_accepted() < count) {
		if (k_uptime_get() >= deadline) {
			return false;
		}
		k_msleep(MOCK_POLL_MS);
	}

	return true;
}
```

## src/coex_tb_bt_mock.h
```c
/*
 * Copyright (c) 2026 Nordic Semiconductor ASA
 *
 * SPDX-License-Identifier: LicenseRef-Nordic-5-Clause
 */

/** @file
 * @brief Mock of bt_le_set_chan_map() for the BLE channel map test.
 *
 * Built only when CONFIG_COEX_TB_MOCK_BT_CHAN_MAP is set. The linker redirects
 * every call to bt_le_set_chan_map(), including the one in the coexistence
 * driver, to the mock, so the test can see exactly what the driver hands to the
 * Bluetooth Controller without depending on what that Controller supports.
 */

#ifndef COEX_TB_BT_MOCK_H__
#define COEX_TB_BT_MOCK_H__

#include <stdbool.h>
#include <stdint.h>

/** Number of octets in a BLE channel map. */
#define COEX_TB_BT_MOCK_MAP_SIZE 5U

/** Forget all recorded calls and any pending rejection. */
void coex_tb_bt_mock_reset(void);

/**
 * Reject the next calls instead of accepting them.
 *
 * @param count Number of calls to reject.
 * @param err   Value the mock returns for each of them.
 */
void coex_tb_bt_mock_fail_next(unsigned int count, int err);

/** Calls seen since the last reset, accepted or not. */
unsigned int coex_tb_bt_mock_calls(void);

/** Calls the mock accepted since the last reset. */
unsigned int coex_tb_bt_mock_accepted(void);

/**
 * Copy out the map of the most recent accepted call.
 *
 * @retval true  A map was accepted since the last reset and has been copied.
 * @retval false Nothing was accepted yet.
 */
bool coex_tb_bt_mock_last_accepted(uint8_t map[COEX_TB_BT_MOCK_MAP_SIZE]);

/**
 * Wait until at least @p count calls have been accepted.
 *
 * @retval true  The count was reached.
 * @retval false Timed out first.
 */
bool coex_tb_bt_mock_wait_accepted(unsigned int count, uint32_t timeout_ms);

#endif /* COEX_TB_BT_MOCK_H__ */
```

## src/coex_tb_params.c
```c
/*
 * Copyright (c) 2026 Nordic Semiconductor ASA
 *
 * SPDX-License-Identifier: LicenseRef-Nordic-5-Clause
 */

/** @file
 * @brief Parameter builders for the coexistence driver APIs under test.
 */

#include <errno.h>
#include <string.h>

#include <zephyr/sys/util.h>

#include "coex_tb.h"
#include "coex_tb_params.h"

void coex_tb_params_priority_ranges(struct coex_wifi_priority_range_t *wifi_range,
				    struct coex_sr_priority_range_t *sr_range)
{
	if (wifi_range != NULL) {
		/* Wi-Fi has four hardware clients plus a software-request range. */
		*wifi_range = (struct coex_wifi_priority_range_t){
			.sw_request_priority_range = {10, 5, 1},
			.client0_ccconf_pti_range = {20, 15, 1},   /* high-prio Wi-Fi Rx */
			.client1_ccconf_pti_range = {25, 20, 1},   /* high-prio Wi-Fi Tx */
			.client2_ccconf_pti_range = {140, 120, 3}, /* low-prio Wi-Fi Rx */
			.client3_ccconf_pti_range = {160, 145, 3}, /* low-prio Wi-Fi Tx */
			.hw_client_priority_level = 5,
		};
	}

	if (sr_range != NULL) {
		/*
		 * SR has a normal and a "critical" range for both Rx and Tx.
		 * The critical ranges sit at lower PTI numbers than the Wi-Fi ranges
		 * so that time-critical SR traffic can win the antenna.
		 */
		*sr_range = (struct coex_sr_priority_range_t){
			.sr_rx_client_ccconf_pti_range = {30, 25, 1},
			.sr_tx_client_ccconf_pti_range = {40, 30, 2},
			.client_priority_level = 5,
			.sr_rx_client_critical_ccconf_pti_range = {5, 0, 1},
			.sr_tx_client_critical_ccconf_pti_range = {5, 0, 1},
		};
	}
}

void coex_tb_params_user_params(struct coex_user_params_t *user_params)
{
	/* Dynamic antenna allocation, matching the coexistence driver default. */
	coex_tb_params_user_params_ant_alloc(user_params, ANT_ALLOC_DYNAMIC);
}

void coex_tb_params_user_params_ant_alloc(struct coex_user_params_t *user_params,
					  enum antenna_allocation_t ant_mode)
{
	if (user_params == NULL) {
		return;
	}

	/*
	 * All probabilities are percentages. 100 means "always protect this
	 * activity". message_id is part of the payload as well as the command
	 * header, so it is set here too.
	 */
	*user_params = (struct coex_user_params_t){
		.message_id = CD2CM_UPDATE_COEX_USER_PARAMS,
		.listen2inactive_sr_rx_prot_prob_ps = 100,
		.inactive2listen_sr_rx_prot_prob_ps = 100,
		.inactive2listen_sr_rx_prot_prob_calib = 100,
		.listen2inactive_sr_rx_prot_prob_calib = 100,
		.wifi_scan_puncture_info = {.wifi_scan_prot_prob = 100},
		.wifi_beacon_prot_prob = 100,
		.wifi_conn_prot_prob = 100,
		.wifi_calib_prot_prob = 100,
		.shared_ant_control = ant_mode,
	};
}

void coex_tb_params_prio(struct nrf71_sr_coex_prio *prio)
{
	if (prio == NULL) {
		return;
	}

	*prio = (struct nrf71_sr_coex_prio){
		.wifi = {
			.sw_request = {10, 5, 1},
			.hp_rx = {20, 15, 1},
			.hp_tx = {25, 20, 1},
			.lp_rx = {140, 120, 3},
			.lp_tx = {160, 145, 3},
			.level = 5,
		},
		.sr = {
			.rx = {30, 25, 1},
			.tx = {40, 30, 2},
			.rx_critical = {5, 0, 1},
			.tx_critical = {5, 0, 1},
			.level = 5,
		},
	};
}

void coex_tb_params_user(struct nrf71_sr_coex_user_params *user)
{
	if (user == NULL) {
		return;
	}

	*user = (struct nrf71_sr_coex_user_params){
		.sr_rx_prot_ps_listen2inactive = 100,
		.sr_rx_prot_ps_inactive2listen = 100,
		.sr_rx_prot_calib_listen2inactive = 100,
		.sr_rx_prot_calib_inactive2listen = 100,
		.wifi_scan_prot = 100,
		.wifi_beacon_prot = 100,
		.wifi_conn_prot = 100,
		.wifi_calib_prot = 100,
		.ant_alloc = NRF71_SR_COEX_ANT_ALLOC_DYNAMIC,
	};
}

int coex_tb_params_default_coex_blob(uint8_t *blob, size_t blob_size, size_t *out_len)
{
	size_t decoded;

	if ((blob == NULL) || (out_len == NULL)) {
		return -EINVAL;
	}

	/*
	 * hex2bin() returns the number of bytes written, or 0 if the string is
	 * malformed or does not fit in blob_size. The return type is unsigned,
	 * so 0 is the only failure indication.
	 */
	decoded = hex2bin(NRF_COEX_PARAMS, strlen(NRF_COEX_PARAMS), blob, blob_size);
	if (decoded == 0U) {
		return -EINVAL;
	}

	*out_len = decoded;
	return 0;
}

int coex_tb_params_coex_blob_lna(uint8_t lna_control, uint8_t *blob, size_t blob_size,
				 size_t *out_len, uint8_t *out_original)
{
	int ret;

	ret = coex_tb_params_default_coex_blob(blob, blob_size, out_len);
	if (ret != 0) {
		return ret;
	}

	/* Offset must be inside the decoded blob, not just inside the buffer. */
	if (*out_len <= COEX_TB_BLOB_LNASW_OFFSET) {
		return -EINVAL;
	}

	if (out_original != NULL) {
		*out_original = blob[COEX_TB_BLOB_LNASW_OFFSET];
	}

	blob[COEX_TB_BLOB_LNASW_OFFSET] = lna_control;
	return 0;
}
```

## src/coex_tb_params.h
```c
/*
 * Copyright (c) 2026 Nordic Semiconductor ASA
 *
 * SPDX-License-Identifier: LicenseRef-Nordic-5-Clause
 */

/** @file
 * @brief Parameter builders for the Coexistence Driver (CD) APIs under test.
 */

#ifndef COEX_TB_PARAMS_H__
#define COEX_TB_PARAMS_H__

#include <stddef.h>
#include <stdint.h>

#include <nrf71_coex_if.h>
#include <drivers/nrf71_sr_coex/nrf71_sr_coex.h>

/**
 * Fill in Wi-Fi and SR priority ranges, in the CD2CM wire format.
 *
 * A "PTI range" is {start, end, step}. Lower numbers mean higher priority, so
 * start is the lowest-priority value of the range and end the highest. The CM
 * uses these to decide which radio wins when both want the antenna.
 */
void coex_tb_params_priority_ranges(struct coex_wifi_priority_range_t *wifi_range,
				    struct coex_sr_priority_range_t *sr_range);

/** Fill in the default user parameters, in the CD2CM wire format. */
void coex_tb_params_user_params(struct coex_user_params_t *user_params);

/**
 * Same as coex_tb_params_user_params() but with an explicit shared-antenna mode.
 *
 * @param ant_mode ANT_ALLOC_DYNAMIC lets the CM arbitrate; ANT_ALLOC_STATIC_WIFI
 *                 and ANT_ALLOC_STATIC_SR pin the antenna to one radio.
 */
void coex_tb_params_user_params_ant_alloc(struct coex_user_params_t *user_params,
					  enum antenna_allocation_t ant_mode);

/**
 * Fill in the same priority ranges as coex_tb_params_priority_ranges(), in the
 * form nrf71_sr_coex_init() takes.
 */
void coex_tb_params_prio(struct nrf71_sr_coex_prio *prio);

/**
 * Fill in the same user parameters as coex_tb_params_user_params(), in the form
 * nrf71_sr_coex_init() takes.
 */
void coex_tb_params_user(struct nrf71_sr_coex_user_params *user);

/**
 * Decode the built-in NRF_COEX_PARAMS hex string into a binary blob.
 *
 * NRF_COEX_PARAMS is a compile-time hex string of CM tuning values. The CM
 * wants the binary form, so it is decoded here.
 *
 * @param blob      Destination buffer.
 * @param blob_size Size of blob; must be at least half the hex string length.
 * @param out_len   Out: number of decoded bytes.
 *
 * @retval 0       Decoded successfully.
 * @retval -EINVAL NULL argument, or the hex string did not fit / was malformed.
 */
int coex_tb_params_default_coex_blob(uint8_t *blob, size_t blob_size, size_t *out_len);

/**
 * Build a coex-params blob with the shared-LNA-switch control byte replaced.
 *
 * Starts from the default blob and patches one byte at
 * COEX_TB_BLOB_LNASW_OFFSET.
 *
 * @param lna_control  0 = dynamic, 1 = statically enabled, 2 = statically disabled.
 * @param out_original Out: byte value before patching, for logging. May be NULL.
 *
 * @retval 0       Blob built.
 * @retval -EINVAL NULL argument, or the blob is too short to hold the offset.
 */
int coex_tb_params_coex_blob_lna(uint8_t lna_control, uint8_t *blob, size_t blob_size,
				 size_t *out_len, uint8_t *out_original);

#endif /* COEX_TB_PARAMS_H__ */
```

## src/coex_tb_stats.h
```c
/*
 * Copyright (c) 2026 Nordic Semiconductor ASA
 *
 * SPDX-License-Identifier: LicenseRef-Nordic-5-Clause
 */

/** @file
 * @brief Coexistence Manager (CM) statistics printing and consistency checking.
 *
 * The counters belong to the CM, but they are used here as evidence about the
 * driver: how many commands of each type the driver actually emitted, and how
 * the CM reacted to them. That makes them the closest thing available to an
 * external observation of the driver's outgoing traffic.
 *
 * The CM keeps a large set of counters: how many requests it saw, how
 * many it granted, how many commands of each type arrived, and so on. Reading
 * them back through cd_stats_fetch() confirms that the commands the driver
 * sent on the bench's behalf arrived and were understood.
 *
 * Two payloads can arrive with a statistics event:
 *   cm_stats_t            - always present, the ROM counters
 *   cm_fsm_patch_stats_t  - only with patched CM firmware, adds per-event counters
 */

#ifndef COEX_TB_STATS_H__
#define COEX_TB_STATS_H__

#include <nrf71_coex_if.h>

/**
 * Print the CM counters and run consistency checks over them.
 *
 * @param stats       ROM counters. NULL is reported as one failure.
 * @param patch_stats Patch counters, or NULL if the firmware did not send them.
 *                    Absence is reported but is not counted as a failure.
 *
 * @return Number of failed checks. Zero means everything was consistent.
 */
unsigned int coex_tb_print_and_validate_stats(const struct cm_stats_t *stats,
					      const struct cm_fsm_patch_stats_t *patch_stats);

#endif /* COEX_TB_STATS_H__ */
```

## src/coex_tb_util.c
```c
/*
 * Copyright (c) 2026 Nordic Semiconductor ASA
 *
 * SPDX-License-Identifier: LicenseRef-Nordic-5-Clause
 */

/** @file
 * @brief Test bench utilities.
 */

#include <errno.h>
#include <stdbool.h>
#include <string.h>

#include <zephyr/devicetree.h>
#include <zephyr/kernel.h>
#include <zephyr/net/net_if.h>
#include <zephyr/sys/printk.h>
#include <zephyr/sys/util.h>

#include <drivers/wifi/nrf71/nrf71_wifi_coex.h>
#include <nrf71_coex_if.h>

#include "nrf71_sr_coex_internal.h"

#include "coex_tb.h"
#include "coex_tb_util.h"

/* CM configuration state names reported by cd_wifi_state_name(). */
#define COEX_TB_CM_STATE_ACTIVE "active"
#define COEX_TB_CM_STATE_FAILED "failed"

const char *coex_tb_errstr(int err)
{
	if (err == 0) {
		return "success";
	}

	if (err < 0) {
		return strerror(-err);
	}

	return "positive status code";
}

#ifdef COEX_TB_DUMP_WIFI_BRINGUP_STATE
#define WICR_NODE DT_NODELABEL(wicr)
#define IPC_NODE  DT_NODELABEL(ipc0)

#define WICR_REG(off) (*(volatile uint32_t *)(DT_REG_ADDR(WICR_NODE) + (off)))

/*
 * Must match the magic in subsys/ipc/ipc_service/lib/icmsg.c: each side writes
 * it into its own TX region during endpoint setup and treats the endpoint as
 * bound once it shows up in the RX region.
 */
static const uint8_t icmsg_magic[] = {0x45, 0x6d, 0x31, 0x6c, 0x31, 0x4b,
				      0x30, 0x72, 0x6e, 0x33, 0x6c, 0x69, 0x34};

/* Wide enough to cover the pbuf header that precedes the magic in shared RAM. */
#define ICMSG_MAGIC_SEARCH_LEN 64U
#define REGION_DUMP_LEN        32U

struct wicr_expect {
	const char *name;
	uint16_t offset;
	uint32_t expect;
};

/* Offsets and expected values mirror wicr_words[] in soc/nordic/nrf71/wicr_setup.c. */
static const struct wicr_expect wicr_expected[] = {
	{"LMACINITPC", 0x000, DT_REG_ADDR(DT_PHANDLE(WICR_NODE, firmware_lmacinitpc))},
	{"UMACINITPC", 0x004, DT_REG_ADDR(DT_PHANDLE(WICR_NODE, firmware_umacinitpc))},
	{"LMACPATCH", 0x008, DT_REG_ADDR(DT_PHANDLE(WICR_NODE, firmware_lmacrompatchaddr))},
	{"UMACPATCH", 0x00C, DT_REG_ADDR(DT_PHANDLE(WICR_NODE, firmware_umacrompatchaddr))},
	{"CMDMBOX addr", 0x080, DT_REG_ADDR(DT_PHANDLE(WICR_NODE, ipcconfig_commandmbox))},
	{"CMDMBOX size", 0x084, DT_REG_SIZE(DT_PHANDLE(WICR_NODE, ipcconfig_commandmbox))},
	{"EVTMBOX addr", 0x088, DT_REG_ADDR(DT_PHANDLE(WICR_NODE, ipcconfig_eventmbox))},
	{"EVTMBOX size", 0x08C, DT_REG_SIZE(DT_PHANDLE(WICR_NODE, ipcconfig_eventmbox))},
	{"SPARE addr", 0x090, DT_REG_ADDR(DT_PHANDLE(WICR_NODE, ipcconfig_sparembox))},
	{"SPARE size", 0x094, DT_REG_SIZE(DT_PHANDLE(WICR_NODE, ipcconfig_sparembox))},
};

static bool region_has_icmsg_magic(uintptr_t base)
{
	const volatile uint8_t *region = (const volatile uint8_t *)base;

	for (size_t off = 0U; off + sizeof(icmsg_magic) <= ICMSG_MAGIC_SEARCH_LEN; off++) {
		size_t i;

		for (i = 0U; i < sizeof(icmsg_magic); i++) {
			if (region[off + i] != icmsg_magic[i]) {
				break;
			}
		}

		if (i == sizeof(icmsg_magic)) {
			return true;
		}
	}

	return false;
}

static void dump_region(const char *name, uintptr_t base)
{
	const volatile uint8_t *region = (const volatile uint8_t *)base;

	printk("Coex TB: %s @ 0x%08lx:", name, (unsigned long)base);

	for (size_t i = 0U; i < REGION_DUMP_LEN; i++) {
		printk(" %02x", region[i]);
	}

	printk("\n");
}

void coex_tb_dump_wifi_bringup_state(void)
{
	uintptr_t tx = DT_REG_ADDR(DT_PHANDLE(IPC_NODE, tx_region));
	uintptr_t rx = DT_REG_ADDR(DT_PHANDLE(IPC_NODE, rx_region));

	printk("\n=================== Wi-Fi bring-up state\n");

	for (size_t i = 0U; i < ARRAY_SIZE(wicr_expected); i++) {
		uint32_t actual = WICR_REG(wicr_expected[i].offset);

		printk("Coex TB: WICR 0x%03x %-12s = 0x%08x (expected 0x%08x)%s\n",
		       (unsigned int)wicr_expected[i].offset, wicr_expected[i].name, actual,
		       wicr_expected[i].expect,
		       (actual == wicr_expected[i].expect) ? "" : "   <-- MISMATCH");
	}

	dump_region("ipc0 tx host->UMAC", tx);
	dump_region("ipc0 rx UMAC->host", rx);

	printk("Coex TB: ICMsg magic present: host tx %s, host rx %s\n",
	       region_has_icmsg_magic(tx) ? "yes" : "no",
	       region_has_icmsg_magic(rx) ? "yes" : "no");
}
#endif /* COEX_TB_DUMP_WIFI_BRINGUP_STATE */

/** Poll until the Wi-Fi FMAC coexistence transport reports ready. */
int coex_tb_wait_transport_ready(uint32_t timeout_ms)
{
	uint32_t elapsed_ms = 0U;
	unsigned int stable_polls = 0U;

	while (stable_polls < COEX_TB_TRANSPORT_STABLE_POLLS) {
		if (elapsed_ms >= timeout_ms) {
			printk("Coex TB: transport not ready after %u ms (%s)\n", timeout_ms,
			       coex_tb_errstr(-ETIMEDOUT));
			return -ETIMEDOUT;
		}

		if (nrf71_wifi_coex_is_ready()) {
			stable_polls++;
		} else {
			stable_polls = 0U;
		}

		k_msleep(COEX_TB_POLL_INTERVAL_MS);
		elapsed_ms += COEX_TB_POLL_INTERVAL_MS;
	}

	printk("Coex TB: transport stable after %u ms\n", elapsed_ms);

	return 0;
}

static struct net_if *coex_tb_wifi_iface(void)
{
	struct net_if *iface = net_if_get_first_wifi();

	return (iface != NULL) ? iface : net_if_get_default();
}

/*
 * Waits for administrative up only. The nRF71 driver marks the interface
 * dormant until a Wi-Fi association, so net_if_is_up() (operational up) stays
 * false for the whole unassociated test run.
 */
static int coex_tb_wait_net_if_up(uint32_t timeout_ms)
{
	uint32_t elapsed_ms = 0U;

	while (elapsed_ms < timeout_ms) {
		struct net_if *iface = coex_tb_wifi_iface();

		if ((iface != NULL) && net_if_is_admin_up(iface)) {
			printk("Coex TB: network interface admin up after %u ms\n", elapsed_ms);
			return 0;
		}

		k_msleep(COEX_TB_POLL_INTERVAL_MS);
		elapsed_ms += COEX_TB_POLL_INTERVAL_MS;
	}

	printk("Coex TB: network interface not admin up after %u ms (%s)\n", timeout_ms,
	       coex_tb_errstr(-ETIMEDOUT));

	return -ETIMEDOUT;
}

bool coex_tb_cm_is_active(void)
{
	return strcmp(cd_wifi_state_name(), COEX_TB_CM_STATE_ACTIVE) == 0;
}

int coex_tb_wait_cm_active(uint32_t timeout_ms)
{
	uint32_t elapsed_ms = 0U;

	while (elapsed_ms < timeout_ms) {
		const char *state = cd_wifi_state_name();

		if (strcmp(state, COEX_TB_CM_STATE_ACTIVE) == 0) {
			printk("Coex TB: CM configuration active after %u ms\n", elapsed_ms);
			return 0;
		}

		if (strcmp(state, COEX_TB_CM_STATE_FAILED) == 0) {
			printk("Coex TB: driver gave up on the CM configuration (%s)\n",
			       coex_tb_errstr(-EIO));
			return -EIO;
		}

		k_msleep(COEX_TB_POLL_INTERVAL_MS);
		elapsed_ms += COEX_TB_POLL_INTERVAL_MS;
	}

	printk("Coex TB: CM configuration still \"%s\" after %u ms (%s)\n",
	       cd_wifi_state_name(), timeout_ms, coex_tb_errstr(-ETIMEDOUT));

	return -ETIMEDOUT;
}

int coex_tb_wifi_iface_down(void)
{
	struct net_if *iface = coex_tb_wifi_iface();
	int ret;

	if (iface == NULL) {
		return -ENODEV;
	}

	ret = net_if_down(iface);
	if (ret != 0) {
		printk("Coex TB: Wi-Fi interface down failed: %s (%d)\n", coex_tb_errstr(ret),
		       ret);
	}

	return ret;
}

int coex_tb_wifi_iface_up(void)
{
	struct net_if *iface = coex_tb_wifi_iface();
	int ret;

	if (iface == NULL) {
		return -ENODEV;
	}

	ret = net_if_up(iface);
	if (ret != 0) {
		printk("Coex TB: Wi-Fi interface up failed: %s (%d)\n", coex_tb_errstr(ret), ret);
	}

	return ret;
}

/**
 * Wait for transport, let the RPU/VIF settle, and ensure CM bring-up completed.
 */
int coex_tb_prepare(void)
{
	int ret;

	ret = coex_tb_wait_transport_ready(COEX_TB_TRANSPORT_TIMEOUT_MS);
	if (ret != 0) {
		return ret;
	}

	ret = coex_tb_wait_net_if_up(COEX_TB_TRANSPORT_TIMEOUT_MS);
	if (ret != 0) {
		return ret;
	}

	printk("Coex TB: waiting %u ms for RPU/VIF settle\n", COEX_TB_RPU_SETTLE_MS);
	k_msleep(COEX_TB_RPU_SETTLE_MS);

#if defined(COEX_TB_NEEDS_CM_BRINGUP) && !defined(COEX_TB_TEST_INIT_AND_ENABLE)
	ret = coex_tb_wait_cm_active(COEX_TB_CM_BRINGUP_TIMEOUT_MS);
	if (ret != 0) {
		printk("Coex TB: driver CM bring-up not done: %s (%d)\n", coex_tb_errstr(ret),
		       ret);
		return ret;
	}
#endif /* COEX_TB_NEEDS_CM_BRINGUP && !COEX_TB_TEST_INIT_AND_ENABLE */

	return 0;
}

/** Sleep for the requested interval between test steps. */
void coex_tb_wait_ms(uint32_t wait_ms)
{
	k_msleep(wait_ms);
}
```
