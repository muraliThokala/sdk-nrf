## CMakeLists.txt
```
# SPDX-License-Identifier: LicenseRef-Nordic-5-Clause

cmake_minimum_required(VERSION 3.20.0)
find_package(Zephyr REQUIRED HINTS $ENV{ZEPHYR_BASE})
project(nrf71_sr_coex_sr_client_req)

target_sources(app PRIVATE
  src/main.c
  src/coex_tb_util.c
  src/coex_tb_params.c
  src/coex_tb_stats.c
  src/coex_tb_tests.c
)

# Coexistence driver public API (coex_cd_*).
target_include_directories(app PRIVATE
  ${ZEPHYR_NRF_MODULE_DIR}/drivers/nrf71_sr_coex_sr_client_req/include
  ${ZEPHYR_NRF_MODULE_DIR}/drivers/wifi/nrf71/fw_if
  ${ZEPHYR_NRF_MODULE_DIR}/drivers/wifi/nrf71/osal/hw_if/hal/inc
)
```

## prj.conf
```kconfig
# Copyright (c) 2026 Nordic Semiconductor ASA
#
# SPDX-License-Identifier: LicenseRef-Nordic-5-Clause
#

# SR SW client request variant of the nRF71 coexistence driver under test.
CONFIG_NRF71_SR_COEX_DRIVER=y

# The coexistence driver depends on both radios: the nRF71 Wi-Fi driver
# (FMAC coex transport) and Bluetooth (the Short-Range radio).
CONFIG_WIFI=y
CONFIG_WIFI_NM_WPA_SUPPLICANT=y
CONFIG_BT=y

# Entropy required by the Wi-Fi stack.
CONFIG_ENTROPY_GENERATOR=y
CONFIG_TEST_RANDOM_GENERATOR=y

# Networking (Wi-Fi driver build dependency).
CONFIG_NETWORKING=y
CONFIG_NET_L2_ETHERNET=y
CONFIG_NET_L2_ETHERNET_MGMT=y
CONFIG_NET_MGMT=y
CONFIG_NET_MGMT_EVENT=y

CONFIG_NET_PKT_RX_COUNT=16
CONFIG_NET_PKT_TX_COUNT=16
CONFIG_NET_BUF_RX_COUNT=16
CONFIG_NET_BUF_TX_COUNT=16
CONFIG_HEAP_MEM_POOL_SIZE=230000

CONFIG_IPC_SERVICE_BACKEND_ICMSG_WQ_ENABLE=y
CONFIG_IPC_SERVICE_BACKEND_ICMSG_WQ_STACK_SIZE=5600

# Logging.
CONFIG_LOG=y
# Avoid pulling in nRF RPC at runtime (same as samples/wifi/ble_coex).
CONFIG_NRF_RPC=n
CONFIG_NRF_RPC_CBOR=n
CONFIG_LOG_MODE_IMMEDIATE=y
CONFIG_NRF71_SR_COEX_DRIVER_LOG_LEVEL_DBG=y

CONFIG_MAIN_STACK_SIZE=8192
```

## src/main.c
```c
/* main.c - Host-side Coexistence Manager test bench (SR SW client variant) */

/*
 * Copyright (c) 2026 Nordic Semiconductor ASA
 *
 * SPDX-License-Identifier: LicenseRef-Nordic-5-Clause
 */

#include <errno.h>

#include <zephyr/kernel.h>
#include <zephyr/sys/printk.h>

#include "coex_tb.h"
#include "coex_tb_tests.h"
#include "coex_tb_util.h"

int main(void)
{
	int ret;

	printk("nRF71 SR coexistence driver CM test bench (SR SW client variant)\n");

	ret = coex_tb_wait_transport_ready(COEX_TB_TRANSPORT_TIMEOUT_MS);
	if (ret != 0) {
		printk("FMAC transport not ready; aborting tests\n");
		return 1;
	}

	coex_tb_run_all();

	return 0;
}
```

## src/coex_tb.h
```c
/*
 * Copyright (c) 2026 Nordic Semiconductor ASA
 *
 * SPDX-License-Identifier: LicenseRef-Nordic-5-Clause
 */

/** @file
 * @brief Coexistence Manager test bench configuration (SR SW client variant).
 *
 * Tests call coex_cd_* APIs; the driver posts each CD2CM command and waits for
 * the matching CM2CD completion event before returning to the test bench.
 *
 * Includes CD2CM_SR_SW_CLIENT_REQUEST / CM2CD_SR_SW_CLIENT_STATUS_EVENT via
 * coex_cd_sr_software_client_request().
 */

#ifndef COEX_TB_H__
#define COEX_TB_H__

#include <stdint.h>

/* Timing (milliseconds). Host tests use shorter waits than the viper emulator TB. */
#define COEX_TB_CMD_WAIT_MS          500U
#define COEX_TB_PPW_TOTAL_DURATION_MS 5000U
#define COEX_TB_PPW_POST_WAIT_MS     1000U
#define COEX_TB_FINAL_WAIT_MS        2000U
#define COEX_TB_STATS_POLL_MS        100U
#define COEX_TB_TRANSPORT_TIMEOUT_MS 60000U

/* Test cases to run (enable/disable individually). */
#define COEX_TB_TEST_CONFIGURE_ENABLE_COEXC
#define COEX_TB_TEST_INIT_AND_ENABLE
#define COEX_TB_TEST_SET_PRIORITY_RANGES
#define COEX_TB_TEST_UPDATE_COEX_USER_PARAMS
#define COEX_TB_TEST_UPDATE_COEX_PARAMETERS
#define COEX_TB_TEST_ENABLE_COEXISTENCE
#define COEX_TB_NUM_ENABLE_COEX_TESTS  1U
#define COEX_TB_TEST_FORCE_ANTENNA_ALLOC
#define COEX_TB_TEST_FORCE_LNASW_ALLOC
#define COEX_TB_TEST_GENERATE_PPW
#define COEX_TB_TEST_WIFI_SW_CLIENT_REQUEST
#define COEX_TB_TEST_WIFI_SW_CLIENT_TIMEOUT
#define COEX_TB_TEST_SR_SW_CLIENT_REQUEST
#define COEX_TB_NUM_SR_SW_CLIENT_TESTS   1U
#define COEX_TB_TEST_GET_CM_STATS

#endif /* COEX_TB_H__ */
```

## src/coex_tb_params.c
```c
/*
 * Copyright (c) 2026 Nordic Semiconductor ASA
 *
 * SPDX-License-Identifier: LicenseRef-Nordic-5-Clause
 */

#include <errno.h>
#include <string.h>

#include <zephyr/sys/util.h>

#include "coex_tb_params.h"

void coex_tb_params_priority_ranges(struct coex_wifi_priority_range_t *wifi_range,
				    struct coex_sr_priority_range_t *sr_range)
{
	if (wifi_range != NULL) {
		*wifi_range = (struct coex_wifi_priority_range_t){
			.sw_request_priority_range = {10, 5, 1},
			.client0_ccconf_pti_range = {20, 15, 1},
			.client1_ccconf_pti_range = {25, 20, 1},
			.client2_ccconf_pti_range = {140, 120, 3},
			.client3_ccconf_pti_range = {160, 145, 3},
			.hw_client_priority_level = 5,
		};
	}

	if (sr_range != NULL) {
		*sr_range = (struct coex_sr_priority_range_t){
			.sr_rx_client_ccconf_pti_range = {30, 25, 1},
			.sr_tx_client_ccconf_pti_range = {40, 30, 2},
			.sr_rx_client_critical_ccconf_pti_range = {20, 15, 1},
			.sr_tx_client_critical_ccconf_pti_range = {25, 20, 1},
			.client_priority_level = 5,
		};
	}
}

void coex_tb_params_user_params(struct coex_user_params_t *user_params)
{
	coex_tb_params_user_params_ant_alloc(user_params, ANT_ALLOC_STATIC_WIFI);
}

void coex_tb_params_user_params_ant_alloc(struct coex_user_params_t *user_params,
					  enum antenna_allocation_t ant_mode)
{
	if (user_params == NULL) {
		return;
	}

	*user_params = (struct coex_user_params_t){
		.message_id = CD2CM_UPDATE_COEX_USER_PARAMS,
		.listen2inactive_sr_rx_prot_prob_ps = 100,
		.inactive2listen_sr_rx_prot_prob_ps = 100,
		.inactive2listen_sr_rx_prot_prob_calib = 100,
		.listen2inactive_sr_rx_prot_prob_calib = 100,
		.wifi_scan_puncture_info = {.wifi_scan_prot_prob = 100},
		.wifi_beacon_prot_prob = 100,
		.wifi_conn_prot_prob = 100,
		.wifi_calib_prot_prob = 100,
		.shared_ant_control = ant_mode,
	};
}

void coex_tb_params_user_params_wifi_prob(struct coex_user_params_t *user_params,
					  uint32_t prob_percent)
{
	if (user_params == NULL) {
		return;
	}

	coex_tb_params_user_params(user_params);
	user_params->wifi_scan_puncture_info.wifi_scan_prot_prob = prob_percent;
	user_params->wifi_beacon_prot_prob = prob_percent;
	user_params->wifi_conn_prot_prob = prob_percent;
	user_params->wifi_calib_prot_prob = prob_percent;
}

void coex_tb_params_user_params_sr_sw_client_test(struct coex_user_params_t *user_params)
{
	if (user_params == NULL) {
		return;
	}

	/*
	 * Mirror firmware TB: Wi-Fi client protection at 0 % for SR SW client tests.
	 * SR-specific user params (sr_conn_prot_prob, etc.) are not in the ROM 1.0
	 * host @c coex_user_params_t yet; firmware applies SR defaults internally.
	 */
	coex_tb_params_user_params_wifi_prob(user_params, 0U);
}

int coex_tb_params_default_coex_blob(uint8_t *blob, size_t blob_size, size_t *out_len)
{
	ssize_t decoded;

	if ((blob == NULL) || (out_len == NULL)) {
		return -EINVAL;
	}

	decoded = hex2bin(NRF_COEX_PARAMS, strlen(NRF_COEX_PARAMS), blob, blob_size);
	if (decoded <= 0) {
		return -EINVAL;
	}

	*out_len = (size_t)decoded;
	return 0;
}

int coex_tb_params_coex_blob_lna(uint8_t lna_control, uint8_t *blob, size_t blob_size,
				 size_t *out_len)
{
	int ret;

	ret = coex_tb_params_default_coex_blob(blob, blob_size, out_len);
	if (ret != 0) {
		return ret;
	}

	/* shared_lnasw_control is byte index 8 in the decoded NRF_COEX_PARAMS blob. */
	if (*out_len <= 8U) {
		return -EINVAL;
	}

	blob[8] = lna_control;
	return 0;
}

void coex_tb_params_enable(bool enable, enum coex_en_or_dis_t *coex_en_or_dis)
{
	if (coex_en_or_dis != NULL) {
		*coex_en_or_dis = enable ? COEX_ENABLE : COEX_DISABLE;
	}
}

void coex_tb_params_ppw_start(struct coex_ppw_parameters_t *ppw, bool first_window_wifi)
{
	if (ppw == NULL) {
		return;
	}

	if (first_window_wifi) {
		*ppw = (struct coex_ppw_parameters_t){
			.start_or_stop_ppw = START_ALLOC_WINDOWS,
			.first_window_to_wifi_or_sr = WIFI_RADIO,
			.wifi_pti_window_duration = 10,
			.sr_pti_window_duration = 20,
			.ppws_timeout = 30U * 1000U,
		};
	} else {
		*ppw = (struct coex_ppw_parameters_t){
			.start_or_stop_ppw = START_ALLOC_WINDOWS,
			.first_window_to_wifi_or_sr = SR_RADIO,
			.wifi_pti_window_duration = 30,
			.sr_pti_window_duration = 15,
			.ppws_timeout = 50U * 1000U,
		};
	}
}

void coex_tb_params_ppw_stop(struct coex_ppw_parameters_t *ppw)
{
	if (ppw == NULL) {
		return;
	}

	ppw->start_or_stop_ppw = STOP_ALLOC_WINDOWS;
}

void coex_tb_params_wifi_sw_client(struct coex_sw_client_params_t *params,
				   enum coex_wifi_sw_client_req_type_t req_type,
				   uint32_t timeout_ms,
				   unsigned int wifi_operating_band)
{
	if (params == NULL) {
		return;
	}

	*params = (struct coex_sw_client_params_t){
		.sw_client_request = req_type,
		.sw_client_pti_level = WIFI_SW_CLIENT_REQ_PTI_LOW,
		.sw_client_type = WIFI_CONNECTION,
		.request_timeout_in_ms = timeout_ms,
		.wifi_operating_band = wifi_operating_band,
	};
}

void coex_tb_params_sr_sw_client(struct coex_sr_sw_client_params_t *params,
				  enum coex_sr_sw_client_req_type_t req_type,
				  uint32_t timeout_ms,
				  enum sr_rf_freq_band_t band)
{
	if (params == NULL) {
		return;
	}

	*params = (struct coex_sr_sw_client_params_t){
		.sw_client_request = req_type,
		.sw_client_pti_level = SR_SW_CLIENT_REQ_PTI_LOW,
		.sw_client_type = SR_CONNECTION,
		.request_timeout_in_ms = timeout_ms,
		.sr_operating_band = band,
	};
}
```

## src/coex_tb_params.h
```c
/*
 * Copyright (c) 2026 Nordic Semiconductor ASA
 *
 * SPDX-License-Identifier: LicenseRef-Nordic-5-Clause
 */

/** @file
 * @brief Parameter initializers for each CD2CM command.
 */

#ifndef COEX_TB_PARAMS_H__
#define COEX_TB_PARAMS_H__

#include <stddef.h>
#include <stdint.h>

#include <nrf71_coex_if.h>
#include <nrf71_cd_sr_if.h>

/** Fill Wi-Fi and SR priority ranges. */
void coex_tb_params_priority_ranges(struct coex_wifi_priority_range_t *wifi_range,
				    struct coex_sr_priority_range_t *sr_range);

/** Fill default user coexistence parameters. */
void coex_tb_params_user_params(struct coex_user_params_t *user_params);

/** Fill user params with a specific shared-antenna allocation mode. */
void coex_tb_params_user_params_ant_alloc(struct coex_user_params_t *user_params,
					  enum antenna_allocation_t ant_mode);

/** Fill user params with a Wi-Fi client protection probability (0-100). */
void coex_tb_params_user_params_wifi_prob(struct coex_user_params_t *user_params,
					  uint32_t prob_percent);

/** Fill user params for SR SW client tests (Wi-Fi protection at 0 %). */
void coex_tb_params_user_params_sr_sw_client_test(struct coex_user_params_t *user_params);

/** Decode @c NRF_COEX_PARAMS into a binary blob for CD2CM_UPDATE_COEX_PARAMS. */
int coex_tb_params_default_coex_blob(uint8_t *blob, size_t blob_size, size_t *out_len);

/** Build a coex-params blob with shared LNA control byte patched (test index 8). */
int coex_tb_params_coex_blob_lna(uint8_t lna_control, uint8_t *blob, size_t blob_size,
				 size_t *out_len);

/** Fill enable/disable coexistence command parameters. */
void coex_tb_params_enable(bool enable, enum coex_en_or_dis_t *coex_en_or_dis);

/** Fill PPW start parameters (first window Wi-Fi or SR). */
void coex_tb_params_ppw_start(struct coex_ppw_parameters_t *ppw, bool first_window_wifi);

/** Fill PPW stop parameters. */
void coex_tb_params_ppw_stop(struct coex_ppw_parameters_t *ppw);

/** Fill Wi-Fi SW client request/release parameters. */
void coex_tb_params_wifi_sw_client(struct coex_sw_client_params_t *params,
				   enum coex_wifi_sw_client_req_type_t req_type,
				   uint32_t timeout_ms,
				   unsigned int wifi_operating_band);

/** Fill SR SW client request/release parameters. */
void coex_tb_params_sr_sw_client(struct coex_sr_sw_client_params_t *params,
				  enum coex_sr_sw_client_req_type_t req_type,
				  uint32_t timeout_ms,
				  enum sr_rf_freq_band_t band);

#endif /* COEX_TB_PARAMS_H__ */
```

## src/coex_tb_sr_patch_if.h
```c
/*
 * Copyright (c) 2026 Nordic Semiconductor ASA
 *
 * SPDX-License-Identifier: LicenseRef-Nordic-5-Clause
 */

/** @file
 * @brief SR SW client patch definitions for the host test bench.
 *
 * Matches @c cm_fsm_patch_stats.h from the ROM 1.0 SR SW client firmware patch.
 */

#ifndef COEX_TB_SR_PATCH_IF_H__
#define COEX_TB_SR_PATCH_IF_H__

#include <nrf71_coex_if.h>

/**
 * Patch statistics trailer with SR SW client counters.
 *
 * Appended after @ref cm_stats_t in @c CM2CD_STATISTICS_EVENT payloads when the
 * SR SW client patch is active.
 */
struct cm_fsm_patch_stats_sr_t {
	/** CD2CM command entry counts */
	unsigned int cmd_update_coex_params_cnt_patch;
	unsigned int cmd_update_user_params_cnt_patch;
	unsigned int cmd_enable_coex_cnt_patch;
	unsigned int cmd_allocate_ppw_cnt_patch;
	unsigned int cmd_set_pti_ranges_cnt_patch;
	unsigned int cmd_get_stats_cnt_patch;
	unsigned int cmd_wifi_sw_client_req_cnt_patch;
	unsigned int cmd_sr_sw_client_req_cnt_patch;
	unsigned int cm_coex_process_cmd_cnt_patch;
	/** CM2CD event counters */
	unsigned int wifi_sw_client_event_to_host_cnt;
	unsigned int sr_sw_client_event_to_host_cnt;
	unsigned int coex_params_event_to_host_cnt;
	unsigned int user_params_event_to_host_cnt;
	unsigned int enable_coex_event_to_host_cnt;
	unsigned int allocate_ppw_event_to_host_cnt;
	unsigned int set_pti_ranges_event_to_host_cnt;
} __NRF_WIFI_PKD;

#endif /* COEX_TB_SR_PATCH_IF_H__ */
```

## src/coex_tb_stats.c
```c
/*
 * Copyright (c) 2026 Nordic Semiconductor ASA
 *
 * SPDX-License-Identifier: LicenseRef-Nordic-5-Clause
 */

#include <stdbool.h>

#include <zephyr/sys/printk.h>

#include "coex_tb_stats.h"
#include "coex_tb_sr_patch_if.h"

static void coex_tb_print_patch_stats(const struct cm_fsm_patch_stats_sr_t *p)
{
	printk("\n==================== Patch Command Counts (cm_fsm_patch.c) ====================\n");
	printk("  cm_coex_process_cmd_cnt_patch:      %u\n", p->cm_coex_process_cmd_cnt_patch);
	printk("  cmd_update_coex_params_cnt_patch:   %u\n", p->cmd_update_coex_params_cnt_patch);
	printk("  cmd_update_user_params_cnt_patch:   %u\n", p->cmd_update_user_params_cnt_patch);
	printk("  cmd_enable_coex_cnt_patch:          %u\n", p->cmd_enable_coex_cnt_patch);
	printk("  cmd_allocate_ppw_cnt_patch:         %u\n", p->cmd_allocate_ppw_cnt_patch);
	printk("  cmd_set_pti_ranges_cnt_patch:       %u\n", p->cmd_set_pti_ranges_cnt_patch);
	printk("  cmd_get_stats_cnt_patch:            %u\n", p->cmd_get_stats_cnt_patch);
	printk("  cmd_wifi_sw_client_req_cnt_patch:   %u\n", p->cmd_wifi_sw_client_req_cnt_patch);
	printk("  cmd_sr_sw_client_req_cnt_patch:     %u\n", p->cmd_sr_sw_client_req_cnt_patch);
}

static void coex_tb_print_stats(const struct cm_stats_t *s,
				const struct cm_fsm_patch_stats_sr_t *patch_stats)
{
	printk("\n==================== PPW Statistics (ROM 1.0) ====================\n");
	printk("  init_count:                %u\n", s->init_count);
	printk("  ppw_start_msgs_cnt:        %u\n", s->ppw_start_msgs_cnt);
	printk("  ppw_stop_msgs_cnt:         %u\n", s->ppw_stop_msgs_cnt);
	printk("  ppw_stop_timeout_cnt:      %u\n", s->ppw_stop_timeout_cnt);
	printk("  num_wifi_pti_windows:      %u\n", s->num_wifi_pti_windows);
	printk("  num_sr_pti_windows:        %u\n", s->num_sr_pti_windows);
	printk("  wifi_ccconf_wifi_window:   %u\n", s->wifi_ccconf_wifi_window);
	printk("  wifi_ccconf_sr_window:     %u\n", s->wifi_ccconf_sr_window);
	printk("  ppw_invalid_params_cnt:    %u\n", s->ppw_invalid_params_cnt);
	printk("  ppw_invalid_request_cnt:   %u\n", s->ppw_invalid_request_cnt);

	printk("\n==================== Band Select (ROM 1.0) ====================\n");
	printk("  cfg_band_sel_5g_cnt:       %u\n", s->cfg_band_sel_5g_cnt);
	printk("  cfg_band_sel_2pt4g_cnt:    %u\n", s->cfg_band_sel_2pt4g_cnt);

	printk("\n==================== Wi-Fi SW Client Aggregate (ROM 1.0) ====================\n");
	printk("  wifi_sw_client_req_cnt:                        %u\n", s->wifi_sw_client_req_cnt);
	printk("  wifi_sw_client_rel_cnt:                        %u\n", s->wifi_sw_client_rel_cnt);
	printk("  wifi_sw_client_gnt_cnt:                        %u\n", s->wifi_sw_client_gnt_cnt);
	printk("  wifi_sw_client_rel_timeout_cnt:                %u\n", s->wifi_sw_client_rel_timeout_cnt);
	printk("  wifi_sw_client_req_non2pt4g_band_cnt:          %u\n",
	       s->wifi_sw_client_req_non2pt4g_band_cnt);
	printk("  wifi_sw_client_req_2pt4g_band_cnt:             %u\n",
	       s->wifi_sw_client_req_2pt4g_band_cnt);
	printk("  wifi_sw_client_decison_in_favour_cnt_2pt4g:    %u\n",
	       s->wifi_sw_client_decison_in_favour_cnt_2pt4g);
	printk("  wifi_sw_client_decison_not_in_favour_cnt_2pt4g:%u\n",
	       s->wifi_sw_client_decison_not_in_favour_cnt_2pt4g);
	printk("  wifi_sw_client_no_gnt_cnt_2pt4g:               %u\n",
	       s->wifi_sw_client_no_gnt_cnt_2pt4g);
	printk("  wifi_sw_client_no_gnt_cnt_non_2pt4g:           %u\n",
	       s->wifi_sw_client_no_gnt_cnt_non_2pt4g);
	printk("  wifi_sw_client_rel_cnt_2pt4g:                  %u\n", s->wifi_sw_client_rel_cnt_2pt4g);
	printk("  wifi_sw_client_rel_cnt_non_2pt4g:              %u\n",
	       s->wifi_sw_client_rel_cnt_non_2pt4g);
	printk("  wifi_sw_client_gnt_cnt_2pt4g:                  %u\n", s->wifi_sw_client_gnt_cnt_2pt4g);
	printk("  wifi_sw_client_gnt_cnt_non_2pt4g:              %u\n",
	       s->wifi_sw_client_gnt_cnt_non_2pt4g);

	printk("\n==================== Wi-Fi Per-Client Req/Rel/Gnt (ROM 1.0) ====================\n");
	printk("  wifi_beacon_rx_req_cnt:    %u\n", s->wifi_beacon_rx_req_cnt);
	printk("  wifi_conn_req_cnt:         %u\n", s->wifi_conn_req_cnt);
	printk("  wifi_calib_req_cnt:        %u\n", s->wifi_calib_req_cnt);
	printk("  wifi_scan_req_cnt:         %u\n", s->wifi_scan_req_cnt);
	printk("  wifi_beacon_rx_rel_cnt:    %u\n", s->wifi_beacon_rx_rel_cnt);
	printk("  wifi_conn_rel_cnt:         %u\n", s->wifi_conn_rel_cnt);
	printk("  wifi_calib_rel_cnt:        %u\n", s->wifi_calib_rel_cnt);
	printk("  wifi_scan_rel_cnt:         %u\n", s->wifi_scan_rel_cnt);
	printk("  wifi_beacon_rx_gnt_cnt:    %u\n", s->wifi_beacon_rx_gnt_cnt);
	printk("  wifi_conn_gnt_cnt:         %u\n", s->wifi_conn_gnt_cnt);
	printk("  wifi_calib_gnt_cnt:        %u\n", s->wifi_calib_gnt_cnt);
	printk("  wifi_scan_gnt_cnt:         %u\n", s->wifi_scan_gnt_cnt);
	printk("  wifi_beacon_rx_no_gnt_cnt: %u\n", s->wifi_beacon_rx_no_gnt_cnt);
	printk("  wifi_conn_no_gnt_cnt:      %u\n", s->wifi_conn_no_gnt_cnt);
	printk("  wifi_calib_no_gnt_cnt:     %u\n", s->wifi_calib_no_gnt_cnt);
	printk("  wifi_scan_no_gnt_cnt:      %u\n", s->wifi_scan_no_gnt_cnt);
	printk("  wifi_beacon_rx_rel_to_cnt: %u\n", s->wifi_beacon_rx_rel_to_cnt);
	printk("  wifi_conn_rel_to_cnt:      %u\n", s->wifi_conn_rel_to_cnt);
	printk("  wifi_calib_rel_to_cnt:     %u\n", s->wifi_calib_rel_to_cnt);
	printk("  wifi_scan_rel_to_cnt:      %u\n", s->wifi_scan_rel_to_cnt);

	printk("\n==================== SR Rx Protection (ROM 1.0) ====================\n");
	printk("  sr_rx_prot_success_cnt_2pt4g:                  %u\n",
	       s->sr_rx_prot_success_cnt_2pt4g);
	printk("  sr_rx_prot_fail_cnt_2pt4g:                     %u\n",
	       s->sr_rx_prot_fail_cnt_2pt4g);
	printk("  sr_rx_prot_success_cnt_non_2pt4g:              %u\n",
	       s->sr_rx_prot_success_cnt_non_2pt4g);
	printk("  sr_rx_prot_fail_cnt_non_2pt4g:                 %u\n",
	       s->sr_rx_prot_fail_cnt_non_2pt4g);
	printk("  sr_rx_prot_inact2listen_ps_cnt_2pt4g:          %u\n",
	       s->sr_rx_prot_inact2listen_ps_cnt_2pt4g);
	printk("  sr_rx_prot_listen2inact_ps_cnt_2pt4g:          %u\n",
	       s->sr_rx_prot_listen2inact_ps_cnt_2pt4g);
	printk("  sr_rx_prot_inact2listen_calib_cnt_2pt4g:       %u\n",
	       s->sr_rx_prot_inact2listen_calib_cnt_2pt4g);
	printk("  sr_rx_prot_listen2inact_calib_cnt_2pt4g:       %u\n",
	       s->sr_rx_prot_listen2inact_calib_cnt_2pt4g);
	printk("  sr_rx_prot_inact2listen_ps_cnt_non_2pt4g:      %u\n",
	       s->sr_rx_prot_inact2listen_ps_cnt_non_2pt4g);
	printk("  sr_rx_prot_listen2inact_ps_cnt_non_2pt4g:      %u\n",
	       s->sr_rx_prot_listen2inact_ps_cnt_non_2pt4g);
	printk("  sr_rx_prot_inact2listen_calib_cnt_non_2pt4g:   %u\n",
	       s->sr_rx_prot_inact2listen_calib_cnt_non_2pt4g);
	printk("  sr_rx_prot_listen2inact_calib_cnt_non_2pt4g:   %u\n",
	       s->sr_rx_prot_listen2inact_calib_cnt_non_2pt4g);
	printk("  sr_rx_prot_2pt4g_band_cnt:                     %u\n", s->sr_rx_prot_2pt4g_band_cnt);
	printk("  sr_rx_prot_non2pt4g_band_cnt:                  %u\n",
	       s->sr_rx_prot_non2pt4g_band_cnt);
	printk("  sr_rx_prot_force_wifi_cnt_2pt4g:               %u\n",
	       s->sr_rx_prot_force_wifi_cnt_2pt4g);

	printk("\n==================== Coex Enable/Disable (ROM 1.0) ====================\n");
	printk("  coex_enable_cnt:           %u\n", s->coex_enable_cnt);
	printk("  coex_disable_cnt:          %u\n", s->coex_disable_cnt);

	printk("\n==================== ANTSWC Configuration (ROM 1.0) ====================\n");
	printk("  antswc_inhibit_cfg_cnt:          %u\n", s->antswc_inhibit_cfg_cnt);
	printk("  antswc_anten_override_cfg_cnt:   %u\n", s->antswc_anten_override_cfg_cnt);
	printk("  antswc_pa_override_cfg_cnt:      %u\n", s->antswc_pa_override_cfg_cnt);
	printk("  antswc_lnasw_override_cfg_cnt:   %u\n", s->antswc_lnasw_override_cfg_cnt);

	printk("\n==================== CCCONF (ROM 1.0) ====================\n");
	printk("  wifi_ccconf_save_cnt:      %u\n", s->wifi_ccconf_save_cnt);
	printk("  wifi_ccconf_restore_cnt:   %u\n", s->wifi_ccconf_restore_cnt);

	printk("\n==================== Command Counts (ROM 1.0) ====================\n");
	printk("  cmd_update_coex_params_cnt:   %u\n", s->cmd_update_coex_params_cnt);
	printk("  cmd_update_user_params_cnt:   %u\n", s->cmd_update_user_params_cnt);
	printk("  cmd_enable_coex_cnt:          %u\n", s->cmd_enable_coex_cnt);
	printk("  cmd_allocate_ppw_cnt:         %u\n", s->cmd_allocate_ppw_cnt);
	printk("  cmd_set_pti_ranges_cnt:       %u\n", s->cmd_set_pti_ranges_cnt);
	printk("  cmd_get_stats_cnt:            %u\n", s->cmd_get_stats_cnt);
	printk("  cmd_sw_client_req_cnt:        %u\n", s->cmd_sw_client_req_cnt);

	printk("\n==================== Events (ROM 1.0 / patch) ====================\n");
	printk("  stats_event_to_host_cnt:           %u\n", s->stats_event_to_host_cnt);
	if (patch_stats != NULL) {
		printk("  wifi_sw_client_event_to_host_cnt:  %u\n",
		       patch_stats->wifi_sw_client_event_to_host_cnt);
		printk("  sr_sw_client_event_to_host_cnt:    %u\n",
		       patch_stats->sr_sw_client_event_to_host_cnt);
		printk("  coex_params_event_to_host_cnt:     %u\n",
		       patch_stats->coex_params_event_to_host_cnt);
		printk("  user_params_event_to_host_cnt:     %u\n",
		       patch_stats->user_params_event_to_host_cnt);
		printk("  enable_coex_event_to_host_cnt:     %u\n",
		       patch_stats->enable_coex_event_to_host_cnt);
		printk("  allocate_ppw_event_to_host_cnt:    %u\n",
		       patch_stats->allocate_ppw_event_to_host_cnt);
		printk("  set_pti_ranges_event_to_host_cnt:  %u\n",
		       patch_stats->set_pti_ranges_event_to_host_cnt);
	} else {
		printk("  sw_client_event_to_host_cnt:       %u\n", s->sw_client_event_to_host_cnt);
		printk("  (patch per-event counters require cm_fsm_patch_stats_t payload)\n");
	}

	printk("\n==================== Error Counts (ROM 1.0) ====================\n");
	printk("  cd2cm_null_cmd_buf_cnt:                  %u\n", s->cd2cm_null_cmd_buf_cnt);
	printk("  cd2cm_invalid_msg_id_cnt:                %u\n", s->cd2cm_invalid_msg_id_cnt);
	printk("  coex_params_buf_error:                   %u\n", s->coex_params_buf_error);
	printk("  user_params_buf_error:                   %u\n", s->user_params_buf_error);
	printk("  en_coex_buf_error:                       %u\n", s->en_coex_buf_error);
	printk("  ppw_buf_error:                           %u\n", s->ppw_buf_error);
	printk("  set_pti_ranges_buf_error:                %u\n", s->set_pti_ranges_buf_error);
	printk("  sw_client_req_buf_error:                 %u\n", s->sw_client_req_buf_error);
	printk("  event_buf_unavailable_cnt:               %u\n", s->event_buf_unavailable_cnt);
	printk("  unknown_event_to_host:                   %u\n", s->unknown_event_to_host);
	printk("  wifi_wrong_sw_client_id_cnt:             %u\n", s->wifi_wrong_sw_client_id_cnt);
	printk("  wifi_wrong_sw_client_request_type_cnt:   %u\n",
	       s->wifi_wrong_sw_client_request_type_cnt);
	printk("  wrong_antswc_ctrl_type_cnt:              %u\n", s->wrong_antswc_ctrl_type_cnt);
	printk("  wrong_wifi_hw_client_pti_level_cnt:      %u\n",
	       s->wrong_wifi_hw_client_pti_level_cnt);
	printk("  wrong_input_populate_pti_cnt:            %u\n", s->wrong_input_populate_pti_cnt);
	printk("  wrong_sr_rx_prot_scenario_cnt:           %u\n", s->wrong_sr_rx_prot_scenario_cnt);
	printk("  wrong_sr_rx_prot_perc_prob_cnt:          %u\n", s->wrong_sr_rx_prot_perc_prob_cnt);
	printk("  wrong_wifi_sw_client_id_cnt:             %u\n", s->wrong_wifi_sw_client_id_cnt);
	printk("  wrong_wifi_sw_client_perc_prob_cnt:      %u\n", s->wrong_wifi_sw_client_perc_prob_cnt);
	printk("  zero_ppw_win_duration_cnt:               %u\n", s->zero_ppw_win_duration_cnt);
	printk("  zero_ppw_timeout_cnt:                    %u\n", s->zero_ppw_timeout_cnt);
}

static void coex_tb_validate_stats(const struct cm_stats_t *s)
{
	unsigned int check_num = 0U;
	bool pass;

	printk("\n==================== Validation Checks (ROM 1.0) ====================\n");

	check_num++;
	pass = (s->wifi_sw_client_req_cnt ==
		s->wifi_sw_client_rel_cnt + s->wifi_sw_client_rel_timeout_cnt);
	printk("  [CHECK %02u] Wi-Fi SW req == rel + rel_timeout: %s\n", check_num,
	       pass ? "PASS" : "FAIL");

	check_num++;
	pass = (s->wifi_sw_client_req_cnt ==
		s->wifi_sw_client_req_non2pt4g_band_cnt + s->wifi_sw_client_req_2pt4g_band_cnt);
	printk("  [CHECK %02u] Wi-Fi SW req == non2pt4g_band + 2pt4g_band: %s\n", check_num,
	       pass ? "PASS" : "FAIL");

	check_num++;
	pass = (s->wifi_sw_client_req_cnt ==
		s->wifi_sw_client_gnt_cnt + s->wifi_sw_client_decison_not_in_favour_cnt_2pt4g);
	printk("  [CHECK %02u] Wi-Fi SW req == gnt + not_in_favour_2pt4g: %s\n", check_num,
	       pass ? "PASS" : "FAIL");

	check_num++;
	pass = (s->wifi_sw_client_gnt_cnt ==
		s->wifi_sw_client_req_non2pt4g_band_cnt +
			s->wifi_sw_client_decison_in_favour_cnt_2pt4g);
	printk("  [CHECK %02u] Wi-Fi SW gnt == non2pt4g_band + in_favour_2pt4g: %s\n", check_num,
	       pass ? "PASS" : "FAIL");

	check_num++;
	{
		unsigned int sum_req = s->wifi_beacon_rx_req_cnt + s->wifi_conn_req_cnt +
				       s->wifi_calib_req_cnt + s->wifi_scan_req_cnt;

		pass = (s->wifi_sw_client_req_cnt == sum_req);
		printk("  [CHECK %02u] Wi-Fi SW req == sum(per-client req): %s\n", check_num,
		       pass ? "PASS" : "FAIL");
	}

	check_num++;
	{
		unsigned int sum_rel = s->wifi_beacon_rx_rel_cnt + s->wifi_conn_rel_cnt +
				       s->wifi_calib_rel_cnt + s->wifi_scan_rel_cnt;

		pass = (s->wifi_sw_client_rel_cnt == sum_rel);
		printk("  [CHECK %02u] Wi-Fi SW rel == sum(per-client rel): %s\n", check_num,
		       pass ? "PASS" : "FAIL");
	}

	check_num++;
	{
		unsigned int sum_gnt = s->wifi_beacon_rx_gnt_cnt + s->wifi_conn_gnt_cnt +
				       s->wifi_calib_gnt_cnt + s->wifi_scan_gnt_cnt;

		pass = (s->wifi_sw_client_gnt_cnt == sum_gnt);
		printk("  [CHECK %02u] Wi-Fi SW gnt == sum(per-client gnt): %s\n", check_num,
		       pass ? "PASS" : "FAIL");
	}

	check_num++;
	{
		unsigned int sum_to = s->wifi_beacon_rx_rel_to_cnt + s->wifi_conn_rel_to_cnt +
				      s->wifi_calib_rel_to_cnt + s->wifi_scan_rel_to_cnt;

		pass = (s->wifi_sw_client_rel_timeout_cnt == sum_to);
		printk("  [CHECK %02u] Wi-Fi SW rel_timeout == sum(per-client rel_to): %s\n",
		       check_num, pass ? "PASS" : "FAIL");
	}

	check_num++;
	pass = (s->wifi_beacon_rx_req_cnt ==
		s->wifi_beacon_rx_gnt_cnt + s->wifi_beacon_rx_no_gnt_cnt);
	printk("  [CHECK %02u] Wi-Fi beacon_rx: req == gnt + no_gnt: %s\n", check_num,
	       pass ? "PASS" : "FAIL");

	check_num++;
	pass = (s->wifi_beacon_rx_req_cnt ==
		s->wifi_beacon_rx_rel_cnt + s->wifi_beacon_rx_rel_to_cnt);
	printk("  [CHECK %02u] Wi-Fi beacon_rx: req == rel + rel_to: %s\n", check_num,
	       pass ? "PASS" : "FAIL");

	check_num++;
	pass = (s->wifi_conn_req_cnt == s->wifi_conn_gnt_cnt + s->wifi_conn_no_gnt_cnt);
	printk("  [CHECK %02u] Wi-Fi conn: req == gnt + no_gnt: %s\n", check_num,
	       pass ? "PASS" : "FAIL");

	check_num++;
	pass = (s->wifi_conn_req_cnt == s->wifi_conn_rel_cnt + s->wifi_conn_rel_to_cnt);
	printk("  [CHECK %02u] Wi-Fi conn: req == rel + rel_to: %s\n", check_num,
	       pass ? "PASS" : "FAIL");

	check_num++;
	pass = (s->wifi_calib_req_cnt == s->wifi_calib_gnt_cnt + s->wifi_calib_no_gnt_cnt);
	printk("  [CHECK %02u] Wi-Fi calib: req == gnt + no_gnt: %s\n", check_num,
	       pass ? "PASS" : "FAIL");

	check_num++;
	pass = (s->wifi_calib_req_cnt == s->wifi_calib_rel_cnt + s->wifi_calib_rel_to_cnt);
	printk("  [CHECK %02u] Wi-Fi calib: req == rel + rel_to: %s\n", check_num,
	       pass ? "PASS" : "FAIL");

	check_num++;
	pass = (s->wifi_scan_req_cnt == s->wifi_scan_gnt_cnt + s->wifi_scan_no_gnt_cnt);
	printk("  [CHECK %02u] Wi-Fi scan: req == gnt + no_gnt: %s\n", check_num,
	       pass ? "PASS" : "FAIL");

	check_num++;
	pass = (s->wifi_scan_req_cnt == s->wifi_scan_rel_cnt + s->wifi_scan_rel_to_cnt);
	printk("  [CHECK %02u] Wi-Fi scan: req == rel + rel_to: %s\n", check_num,
	       pass ? "PASS" : "FAIL");

	check_num++;
	pass = (s->sr_rx_prot_2pt4g_band_cnt ==
		s->sr_rx_prot_success_cnt_2pt4g + s->sr_rx_prot_fail_cnt_2pt4g);
	printk("  [CHECK %02u] SR Rx prot 2.4G: band == success + fail: %s\n", check_num,
	       pass ? "PASS" : "FAIL");

	check_num++;
	pass = (s->sr_rx_prot_non2pt4g_band_cnt ==
		s->sr_rx_prot_success_cnt_non_2pt4g + s->sr_rx_prot_fail_cnt_non_2pt4g);
	printk("  [CHECK %02u] SR Rx prot non-2.4G: band == success + fail: %s\n", check_num,
	       pass ? "PASS" : "FAIL");

	check_num++;
	{
		unsigned int sum_2g = s->sr_rx_prot_inact2listen_ps_cnt_2pt4g +
				      s->sr_rx_prot_listen2inact_ps_cnt_2pt4g +
				      s->sr_rx_prot_inact2listen_calib_cnt_2pt4g +
				      s->sr_rx_prot_listen2inact_calib_cnt_2pt4g;

		pass = (s->sr_rx_prot_2pt4g_band_cnt == sum_2g);
		printk("  [CHECK %02u] SR Rx prot 2.4G: band == sum(scenario counts): %s\n",
		       check_num, pass ? "PASS" : "FAIL");
	}

	check_num++;
	{
		unsigned int sum_non2g = s->sr_rx_prot_inact2listen_ps_cnt_non_2pt4g +
				       s->sr_rx_prot_listen2inact_ps_cnt_non_2pt4g +
				       s->sr_rx_prot_inact2listen_calib_cnt_non_2pt4g +
				       s->sr_rx_prot_listen2inact_calib_cnt_non_2pt4g;

		pass = (s->sr_rx_prot_non2pt4g_band_cnt == sum_non2g);
		printk("  [CHECK %02u] SR Rx prot non-2.4G: band == sum(scenario counts): %s\n",
		       check_num, pass ? "PASS" : "FAIL");
	}

	check_num++;
	pass = (s->antswc_inhibit_cfg_cnt == s->cmd_update_coex_params_cnt);
	printk("  [CHECK %02u] ANTSWC inhibit_cfg == cmd_update_coex_params: %s\n", check_num,
	       pass ? "PASS" : "FAIL");

	check_num++;
	pass = (s->antswc_anten_override_cfg_cnt == s->cmd_update_user_params_cnt);
	printk("  [CHECK %02u] ANTSWC anten_override_cfg == cmd_update_user_params: %s\n",
	       check_num, pass ? "PASS" : "FAIL");

	check_num++;
	pass = (s->antswc_pa_override_cfg_cnt == s->cmd_update_coex_params_cnt);
	printk("  [CHECK %02u] ANTSWC pa_override_cfg == cmd_update_coex_params: %s\n", check_num,
	       pass ? "PASS" : "FAIL");

	check_num++;
	pass = (s->antswc_lnasw_override_cfg_cnt == s->cmd_update_coex_params_cnt);
	printk("  [CHECK %02u] ANTSWC lnasw_override_cfg == cmd_update_coex_params: %s\n",
	       check_num, pass ? "PASS" : "FAIL");

	check_num++;
	pass = (s->wifi_ccconf_save_cnt == s->wifi_ccconf_restore_cnt);
	printk("  [CHECK %02u] Wi-Fi CCCONF save == restore: %s\n", check_num,
	       pass ? "PASS" : "FAIL");

	check_num++;
	pass = (s->cmd_allocate_ppw_cnt == s->ppw_start_msgs_cnt + s->ppw_stop_msgs_cnt);
	printk("  [CHECK %02u] cmd_allocate_ppw == ppw_start + ppw_stop: %s\n", check_num,
	       pass ? "PASS" : "FAIL");

	printk("\n==================== End of Validation (%u checks) ====================\n\n",
	       check_num);
}

void coex_tb_print_and_validate_stats(const struct cm_stats_t *stats,
				      const struct cm_fsm_patch_stats_sr_t *patch_stats)
{
	if (stats == NULL) {
		printk("Coex TB stats: no statistics payload\n");
		return;
	}

	coex_tb_print_stats(stats, patch_stats);
	coex_tb_validate_stats(stats);

	if (patch_stats != NULL) {
		coex_tb_print_patch_stats(patch_stats);

		printk("\n==================== Patch Stats Checks ====================\n");
		printk("  SR SW client patch cmd count:     %u\n",
		       patch_stats->cmd_sr_sw_client_req_cnt_patch);
		printk("  SR SW client patch event count:   %u\n",
		       patch_stats->sr_sw_client_event_to_host_cnt);
	} else {
		printk("\nPatch command counters not available in this CM2CD event payload.\n");
	}
}
```

## src/coex_tb_stats.h
```c
/*
 * Copyright (c) 2026 Nordic Semiconductor ASA
 *
 * SPDX-License-Identifier: LicenseRef-Nordic-5-Clause
 */

/** @file
 * @brief CM statistics validation (ROM 1.0 + SR SW client patch stats).
 */

#ifndef COEX_TB_STATS_H__
#define COEX_TB_STATS_H__

#include <nrf71_coex_if.h>

#include "coex_tb_sr_patch_if.h"

/** Print and run consistency checks on ROM CM statistics and SR patch stats. */
void coex_tb_print_and_validate_stats(const struct cm_stats_t *stats,
				      const struct cm_fsm_patch_stats_sr_t *patch_stats);

#endif /* COEX_TB_STATS_H__ */
```

## src/coex_tb_tests.c
```c
/*
 * Copyright (c) 2026 Nordic Semiconductor ASA
 *
 * SPDX-License-Identifier: LicenseRef-Nordic-5-Clause
 */

#include <errno.h>

#include <zephyr/sys/printk.h>
#include <zephyr/sys/util.h>

#include <nrf71_coex_if.h>
#include <nrf71_coex_hw_regs.h>
#include <nrf71_cd_sr_if.h>
#include <nrf71_sr_coex_api.h>

#include "coex_tb.h"
#include "coex_tb_params.h"
#include "coex_tb_stats.h"
#include "coex_tb_tests.h"
#include "coex_tb_util.h"

/** Configure COEXC hardware (not a CD2CM command). */
static int tb_configure_enable_coexc(void)
{
	uint32_t ccmallow;
	int ret;

	printk("\n=================== configure and enable COEXC\n");

	ret = coex_cd_coexc_configure_and_enable(COEX_SHARED_ANT_CFG);
	if (ret != 0) {
		printk("Coex TB: COEXC configure/enable failed (%d)\n", ret);
		return ret;
	}

	ret = coex_cd_coexc_verify_configured(COEX_SHARED_ANT_CFG, &ccmallow);
	if (ret != 0) {
		printk("Coex TB: COEXC verify failed (%d)\n", ret);
		return ret;
	}

	printk("Coex TB: COEXC OK (CCMALLOW[0][0]=0x%08x)\n", ccmallow);
	return 0;
}

/**
 * Re-apply CM configuration after Wi-Fi power-up (CD2CM_SET_PRIORITY_RANGES,
 * CD2CM_UPDATE_COEX_USER_PARAMS, CD2CM_UPDATE_COEX_PARAMS,
 * CD2CM_ENABLE_COEXISTENCE and their CM2CD completion events).
 */
static int tb_init_and_enable(void)
{
	int ret;

	printk("\n=================== init: Wi-Fi and SR power notify\n");

	ret = coex_cd_wifi_power_notify(COEX_WIFI_POWERED_UP_READY);
	if (ret != 0) {
		printk("Coex TB: Wi-Fi power notify failed (%d)\n", ret);
		return ret;
	}

	ret = coex_cd_sr_power_notify(COEX_SR_POWERED_UP_READY);
	if (ret != 0) {
		printk("Coex TB: SR power notify failed (%d)\n", ret);
		return ret;
	}

	printk("Coex TB: radios reported ready\n");
	return 0;
}

/** Post CD2CM_SET_PRIORITY_RANGES and wait for CM2CD_SET_PRIORITY_RANGES_EVENT. */
static int tb_set_priority_ranges(void)
{
	struct coex_wifi_priority_range_t wifi_range;
	struct coex_sr_priority_range_t sr_range;

	printk("\n============================================= set priority ranges\n");
	coex_tb_params_priority_ranges(&wifi_range, &sr_range);

	return coex_cd_set_priority_ranges(&wifi_range, &sr_range);
}

/** Post CD2CM_UPDATE_COEX_USER_PARAMS and wait for CM2CD_UPDATE_COEX_USER_PARAMS_EVENT. */
static int tb_update_coex_user_parameters(void)
{
	struct coex_user_params_t user_params;

	printk("\n================================================== update coex user params\n");
	coex_tb_params_user_params(&user_params);

	return coex_cd_update_user_params(&user_params);
}

/** Post CD2CM_UPDATE_COEX_PARAMS and wait for CM2CD_UPDATE_COEX_PARAMS_EVENT. */
static int tb_update_coex_parameters(void)
{
	printk("\n================================================== update coex params\n");

	return coex_cd_update_coex_params();
}

/** Post CD2CM_ENABLE_COEXISTENCE and wait for CM2CD_ENABLE_COEXISTENCE_EVENT. */
static int tb_enable_disable_coex(uint32_t num_tests)
{
	int ret;

	printk("\n========================== enable/disable coexistence (%u iterations)\n",
	       num_tests);

	for (uint32_t test = 1U; test <= num_tests; test++) {
		bool enable = ((test % 2U) == 0U);

		printk("\n--- COEX %s test %u ---\n", enable ? "ENABLE" : "DISABLE", test);
		ret = coex_cd_enable(enable);
		if (ret != 0) {
			return ret;
		}
	}

	return 0;
}

/** Post CD2CM_UPDATE_COEX_USER_PARAMS and wait for CM2CD_UPDATE_COEX_USER_PARAMS_EVENT. */
static int tb_force_antenna_allocation(void)
{
	static const enum antenna_allocation_t modes[] = {
		ANT_ALLOC_DYNAMIC,
		ANT_ALLOC_STATIC_WIFI,
		ANT_ALLOC_STATIC_SR,
	};
	static const char *labels[] = {"DYNAMIC", "STATIC_WIFI", "STATIC_SR"};
	struct coex_user_params_t user_params;
	int ret;

	printk("\n========================== force shared antenna allocation\n");

	for (size_t i = 0U; i < ARRAY_SIZE(modes); i++) {
		printk("--- FORCE_ANTENNA_ALLOC: %s ---\n", labels[i]);
		coex_tb_params_user_params_ant_alloc(&user_params, modes[i]);
		ret = coex_cd_update_user_params(&user_params);
		if (ret != 0) {
			return ret;
		}
	}

	return 0;
}

/** Post CD2CM_UPDATE_COEX_PARAMS and wait for CM2CD_UPDATE_COEX_PARAMS_EVENT. */
static int tb_control_shared_lna(void)
{
	static const uint8_t lna_modes[] = {0U, 1U, 2U};
	static const char *labels[] = {"SHA_LNA_DYNAMIC", "SHA_LNA_STATIC_EN",
				       "SHA_LNA_STATIC_DIS"};
	uint8_t blob[128];
	size_t blob_len;
	int ret;

	printk("\n============================ force shared LNA switch\n");

	for (size_t i = 0U; i < ARRAY_SIZE(lna_modes); i++) {
		printk("--- FORCE_LNASW: %s ---\n", labels[i]);

		ret = coex_tb_params_coex_blob_lna(lna_modes[i], blob, sizeof(blob), &blob_len);
		if (ret != 0) {
			return ret;
		}

		ret = coex_cd_update_coex_params_blob(blob, blob_len);
		if (ret != 0) {
			return ret;
		}
	}

	return 0;
}

/** Post CD2CM_ALLOCATE_PPW and wait for CM2CD_ALLOCATE_PPW_EVENT. */
static int tb_generate_ppws(void)
{
	struct coex_ppw_parameters_t ppw;
	int ret;

	printk("\n================================================== generate PPWs\n");

	for (uint32_t case_idx = 0U; case_idx < 2U; case_idx++) {
		bool first_wifi = (case_idx == 0U);

		printk("--- PPW start (%s first window) ---\n",
		       first_wifi ? "Wi-Fi" : "SR");
		coex_tb_params_ppw_start(&ppw, first_wifi);

		ret = coex_cd_allocate_ppw(&ppw);
		if (ret != 0) {
			return ret;
		}

		coex_tb_wait_ms(COEX_TB_PPW_TOTAL_DURATION_MS);

		printk("--- PPW stop ---\n");
		coex_tb_params_ppw_stop(&ppw);

		ret = coex_cd_allocate_ppw(&ppw);
		if (ret != 0) {
			return ret;
		}

		coex_tb_wait_ms(COEX_TB_PPW_POST_WAIT_MS);
	}

	return 0;
}

/**
 * Post CD2CM_WIFI_SW_CLIENT_REQUEST and wait for CM2CD_WIFI_SW_CLIENT_STATUS_EVENT
 * (request and release).
 */
static int tb_wifi_sw_client_request(void)
{
	struct coex_wifi_priority_range_t wifi_range;
	struct coex_sr_priority_range_t sr_range;
	struct coex_user_params_t user_params;
	struct coex_sw_client_params_t sw_params;
	int ret;

	printk("\n================= Wi-Fi SW client request/release\n");

	ret = coex_cd_enable(true);
	if (ret != 0) {
		return ret;
	}

	coex_tb_params_priority_ranges(&wifi_range, &sr_range);
	ret = coex_cd_set_priority_ranges(&wifi_range, &sr_range);
	if (ret != 0) {
		return ret;
	}

	for (uint32_t iter = 1U; iter <= 2U; iter++) {
		uint32_t prob = ((iter % 2U) == 1U) ? 100U : 0U;

		printk("--- Wi-Fi SW client iteration %u (prob=%u%%) ---\n", iter, prob);
		coex_tb_params_user_params_wifi_prob(&user_params, prob);

		ret = coex_cd_update_user_params(&user_params);
		if (ret != 0) {
			return ret;
		}

		coex_tb_params_wifi_sw_client(&sw_params, WIFI_SW_CLIENT_REQUEST,
					      30U * 1000U, 0U);
		ret = coex_cd_wifi_sw_client_request(&sw_params);
		if (ret != 0) {
			return ret;
		}

		coex_tb_params_wifi_sw_client(&sw_params, WIFI_SW_CLIENT_RELEASE, 0U, 0U);
		ret = coex_cd_wifi_sw_client_request(&sw_params);
		if (ret != 0) {
			return ret;
		}
	}

	return 0;
}

/**
 * Post CD2CM_WIFI_SW_CLIENT_REQUEST and wait for CM2CD_WIFI_SW_CLIENT_STATUS_EVENT
 * with short timeout on 2.4G and 5G bands.
 */
static int tb_wifi_sw_client_timeout(void)
{
	struct coex_wifi_priority_range_t wifi_range;
	struct coex_sr_priority_range_t sr_range;
	struct coex_user_params_t user_params;
	struct coex_sw_client_params_t sw_params;
	int ret;

	printk("\n================================= Wi-Fi SW client timeout test\n");

	ret = coex_cd_enable(true);
	if (ret != 0) {
		return ret;
	}

	coex_tb_params_priority_ranges(&wifi_range, &sr_range);
	ret = coex_cd_set_priority_ranges(&wifi_range, &sr_range);
	if (ret != 0) {
		return ret;
	}

	coex_tb_params_user_params(&user_params);
	ret = coex_cd_update_user_params(&user_params);
	if (ret != 0) {
		return ret;
	}

	for (uint32_t iter = 1U; iter <= 4U; iter++) {
		unsigned int band = ((iter % 2U) == 1U) ? COEXC_MODE_WIFI_2PT4G :
							    COEXC_MODE_WIFI_5G;

		printk("--- Wi-Fi SW client timeout iteration %u (band=%u, timeout=50 ms) ---\n",
		       iter, band);

		coex_tb_params_wifi_sw_client(&sw_params, WIFI_SW_CLIENT_REQUEST, 50U, band);
		ret = coex_cd_wifi_sw_client_request(&sw_params);
		if (ret != 0) {
			return ret;
		}

		coex_tb_wait_ms(COEX_TB_CMD_WAIT_MS);
	}

	coex_tb_wait_ms(COEX_TB_PPW_POST_WAIT_MS);

	return 0;
}

/**
 * Post CD2CM_SR_SW_CLIENT_REQUEST and wait for CM2CD_SR_SW_CLIENT_STATUS_EVENT
 * (request and release).
 */
static int tb_sr_sw_client_request(void)
{
	struct coex_wifi_priority_range_t wifi_range;
	struct coex_sr_priority_range_t sr_range;
	struct coex_user_params_t user_params;
	struct coex_sr_sw_client_params_t sw_params;
	enum coex_sr_sw_client_req_status_t grant_status;
	int ret;

	printk("\n============================================= SR SW client request/release\n");

	coex_tb_wait_ms(COEX_TB_STATS_POLL_MS);

	ret = coex_cd_enable(true);
	if (ret != 0) {
		return ret;
	}

	coex_tb_params_priority_ranges(&wifi_range, &sr_range);
	ret = coex_cd_set_priority_ranges(&wifi_range, &sr_range);
	if (ret != 0) {
		return ret;
	}

	coex_tb_params_user_params_sr_sw_client_test(&user_params);

	for (uint32_t iter = 1U; iter <= COEX_TB_NUM_SR_SW_CLIENT_TESTS; iter++) {
		printk("--- SR SW client iteration %u ---\n", iter);

		coex_tb_wait_ms(COEX_TB_STATS_POLL_MS);

		ret = coex_cd_update_user_params(&user_params);
		if (ret != 0) {
			return ret;
		}

		coex_tb_wait_ms(COEX_TB_STATS_POLL_MS);

		printk("--- Post SR SW client REQUEST ---\n");
		coex_tb_params_sr_sw_client(&sw_params, SR_SW_CLIENT_REQUEST, 30U * 1000U,
					    SR_BAND_2PT4G);
		ret = coex_cd_sr_software_client_request(&sw_params, &grant_status);
		if (ret != 0) {
			return ret;
		}

		printk("Coex TB: SR SW client REQUEST grant/status=%u\n", grant_status);

		coex_tb_wait_ms(COEX_TB_STATS_POLL_MS);

		printk("--- Post SR SW client RELEASE ---\n");
		coex_tb_params_sr_sw_client(&sw_params, SR_SW_CLIENT_RELEASE, 0U, SR_BAND_2PT4G);
		ret = coex_cd_sr_software_client_request(&sw_params, &grant_status);
		if (ret != 0) {
			return ret;
		}

		printk("Coex TB: SR SW client RELEASE grant/status=%u\n", grant_status);
	}

	coex_tb_wait_ms(COEX_TB_CMD_WAIT_MS);
	coex_tb_wait_ms(COEX_TB_STATS_POLL_MS);

	return 0;
}

/** Post CD2CM_GET_STATS, wait for CM2CD_STATISTICS_EVENT, and validate stats. */
static int tb_get_coex_manager_stats(void)
{
	int ret;

	printk("\n========================================================== get CM stats\n");

	ret = coex_cd_get_stats();
	if (ret != 0) {
		return ret;
	}

	coex_tb_print_and_validate_stats(coex_cd_get_last_stats(),
					 coex_cd_get_last_patch_stats());
	return 0;
}

/** Run all enabled coexistence test bench cases in sequence. */
void coex_tb_run_all(void)
{
	int ret = 0;

	printk("\n\n========== Coexistence Manager host test bench start ==========\n");

#ifdef COEX_TB_TEST_CONFIGURE_ENABLE_COEXC
	if (ret == 0) {
		ret = tb_configure_enable_coexc();
	}
#endif

#ifdef COEX_TB_TEST_INIT_AND_ENABLE
	if (ret == 0) {
		ret = tb_init_and_enable();
	}
#endif

#ifdef COEX_TB_TEST_SET_PRIORITY_RANGES
	if (ret == 0) {
		ret = tb_set_priority_ranges();
	}
#endif

#ifdef COEX_TB_TEST_UPDATE_COEX_USER_PARAMS
	if (ret == 0) {
		ret = tb_update_coex_user_parameters();
	}
#endif

#ifdef COEX_TB_TEST_UPDATE_COEX_PARAMETERS
	if (ret == 0) {
		ret = tb_update_coex_parameters();
	}
#endif

#ifdef COEX_TB_TEST_ENABLE_COEXISTENCE
	if (ret == 0) {
		ret = tb_enable_disable_coex(COEX_TB_NUM_ENABLE_COEX_TESTS);
	}
#endif

#ifdef COEX_TB_TEST_FORCE_ANTENNA_ALLOC
	if (ret == 0) {
		ret = tb_force_antenna_allocation();
	}
#endif

#ifdef COEX_TB_TEST_FORCE_LNASW_ALLOC
	if (ret == 0) {
		ret = tb_control_shared_lna();
	}
#endif

#ifdef COEX_TB_TEST_GENERATE_PPW
	if (ret == 0) {
		ret = tb_generate_ppws();
	}
#endif

#ifdef COEX_TB_TEST_WIFI_SW_CLIENT_REQUEST
	if (ret == 0) {
		ret = tb_wifi_sw_client_request();
	}
#endif

#ifdef COEX_TB_TEST_WIFI_SW_CLIENT_TIMEOUT
	if (ret == 0) {
		ret = tb_wifi_sw_client_timeout();
	}
#endif

#ifdef COEX_TB_TEST_SR_SW_CLIENT_REQUEST
	if (ret == 0) {
		ret = tb_sr_sw_client_request();
	}
#endif

#ifdef COEX_TB_TEST_GET_CM_STATS
	if (ret == 0) {
		ret = tb_get_coex_manager_stats();
	}
#endif

	coex_tb_wait_ms(COEX_TB_FINAL_WAIT_MS);

	if (ret == 0) {
		printk("\n========== Coexistence Manager host test bench PASS ==========\n");
	} else {
		printk("\n========== Coexistence Manager host test bench FAIL (%d) ==========\n",
		       ret);
	}
}
```

## src/coex_tb_util.c
```c
/*
 * Copyright (c) 2026 Nordic Semiconductor ASA
 *
 * SPDX-License-Identifier: LicenseRef-Nordic-5-Clause
 */

#include <errno.h>

#include <zephyr/kernel.h>
#include <zephyr/sys/printk.h>

#include <drivers/wifi/nrf71/nrf71_wifi_coex.h>

#include "coex_tb.h"
#include "coex_tb_util.h"

int coex_tb_wait_transport_ready(uint32_t timeout_ms)
{
	uint32_t elapsed_ms = 0U;

	while (!nrf71_wifi_coex_is_ready()) {
		if (elapsed_ms >= timeout_ms) {
			printk("Coex TB: transport not ready after %u ms\n", timeout_ms);
			return -ETIMEDOUT;
		}

		k_msleep(100);
		elapsed_ms += 100U;
	}

	return 0;
}

void coex_tb_wait_ms(uint32_t wait_ms)
{
	k_msleep(wait_ms);
}
```

## src/coex_tb_util.h
```c
/*
 * Copyright (c) 2026 Nordic Semiconductor ASA
 *
 * SPDX-License-Identifier: LicenseRef-Nordic-5-Clause
 */

/** @file
 * @brief Coexistence test bench utilities (transport wait and timing helpers).
 */

#ifndef COEX_TB_UTIL_H__
#define COEX_TB_UTIL_H__

#include <stdint.h>

int coex_tb_wait_transport_ready(uint32_t timeout_ms);

void coex_tb_wait_ms(uint32_t wait_ms);

#endif /* COEX_TB_UTIL_H__ */
```
