## boards/shields/nrf70_54l15_module/Kconfig.shield
```kconfig
# Copyright (c) 2024 Nordic Semiconductor ASA
# SPDX-License-Identifier: Apache-2.0

config SHIELD_NRF70_54L15_MODULE
	def_bool $(shields_list_contains,nrf70_54l15_module)
```

## samples/wifi/sr_coex/test/Kconfig
```kconfig
#
# Copyright (c) 2022 Nordic Semiconductor
#
# SPDX-License-Identifier: LicenseRef-Nordic-5-Clause
#

menu "Nordic Coex sample - test"

config WIFI_SCAN_BLE_CON_CENTRAL
	bool "Indicates test is to be run or not"
	default n

config WIFI_SCAN_BLE_CON_PERIPH
	bool "Indicates test is to be run or not"
	default n

config WIFI_SCAN_BLE_TP_CENTRAL
	bool "Indicates test is to be run or not"
	default n

config WIFI_SCAN_BLE_TP_PERIPH
	bool "Indicates test is to be run or not"
	default n

config WIFI_CON_SCAN_BLE_CON_CENTRAL
	bool "Indicates test is to be run or not"
	default n

config WIFI_CON_SCAN_BLE_CON_PERIPH
	bool "Indicates test is to be run or not"
	default n

config WIFI_CON_SCAN_BLE_TP_CENTRAL
	bool "Indicates test is to be run or not"
	default n

config WIFI_CON_SCAN_BLE_TP_PERIPH
	bool "Indicates test is to be run or not"
	default n

config WIFI_CON_BLE_CON_CENTRAL
	bool "Indicates test is to be run or not"
	default n

config WIFI_CON_BLE_CON_PERIPH
	bool "Indicates test is to be run or not"
	default n

config WIFI_CON_BLE_TP_CENTRAL
	bool "Indicates test is to be run or not"
	default n

config WIFI_CON_BLE_TP_PERIPH
	bool "Indicates test is to be run or not"
	default n

config WIFI_TP_CLIENT_BLE_CON_CENTRAL
	bool "Indicates test is to be run or not"
	default n

config WIFI_TP_CLIENT_BLE_CON_PERIPH
	bool "Indicates test is to be run or not"
	default n

config WIFI_TP_CLIENT_BLE_TP_CENTRAL
	bool "Indicates test is to be run or not"
	default n

config WIFI_TP_CLIENT_BLE_TP_PERIPH
	bool "Indicates test is to be run or not"
	default n

config WIFI_TP_SERVER_BLE_CON_CENTRAL
	bool "Indicates test is to be run or not"
	default y

config WIFI_TP_SERVER_BLE_CON_PERIPH
	bool "Indicates test is to be run or not"
	default n

config WIFI_TP_SERVER_BLE_TP_CENTRAL
	bool "Indicates test is to be run or not"
	default n

config WIFI_TP_SERVER_BLE_TP_PERIPH
	bool "Indicates test is to be run or not"
	default n

endmenu
```

## samples/wifi/thread_coex/test/Kconfig
```kconfig
#
# Copyright (c) 2023 Nordic Semiconductor
#
# SPDX-License-Identifier: LicenseRef-Nordic-5-Clause
#

menu "Nordic Coex sample - test"

# Wi-Fi TWT configurations
config CONNECTION_IDLE_TIMEOUT
	int "Time to be waited for a station to connect"
	default 30

config TWT_TRIGGER_ENABLE
	bool "Enable trigger mode"
	help
	  STA expects AP to send triggers for start of every service period.
	default y

config TWT_ANNOUNCED_MODE
	bool "Enable announced mode"
	help
	  STA announces its wakeup to AP for every service period start.
	default y

config TWT_WAKE_INTERVAL
	int "TWT awake interval"
	help
	  The period where STA is awake and does data transfer, interval should be in us.
	default 256000

config TWT_INTERVAL
	int "TWT service interval"
	help
	  The period for TWT that includes both wake and sleep durations, interval should be in us.
	  Please note higher intervals can be rejected by AP or cause interoperability issues.
	default 524000

config TWT_ENABLE
	bool "Indicates test is to be run or not"
	default n

# test parameters

config OT_EXTERNAL_ANTENNA
	bool "Indicates if external antenna used for Thread"
	default n

config DEBUG_PRINT_WIFI_SCAN_INFO
	bool "Print Wi-Fi Scan info for debug purpose"
	default n

config DEBUG_PRINT_WIFI_DHCP_INFO
	bool "Print Wi-Fi DHCP info for debug purpose"
	default n

config DEBUG_PRINT_WIFI_CONN_INFO
	bool "Print Wi-Fi Connection info for debug purpose"
	default n

config PRINTS_FOR_AUTOMATION
	bool "Print info required for automation"
	default y

# system performance tests
config WIFI_SCAN_OT_DISCOV
	bool "Indicates test is to be run or not"
	default n

config WIFI_SCAN_OT_CONNECTION
	bool "Indicates test is to be run or not"
	default n

config WIFI_SCAN_OT_TP_UDP_CLIENT
	bool "Indicates test is to be run or not"
	default n

config WIFI_SCAN_OT_TP_UDP_SERVER
	bool "Indicates test is to be run or not"
	default n

config WIFI_SCAN_OT_TP_TCP_CLIENT
	bool "Indicates test is to be run or not"
	default n

config WIFI_SCAN_OT_TP_TCP_SERVER
	bool "Indicates test is to be run or not"
	default n

config WIFI_CON_SCAN_OT_DISCOV
	bool "Indicates test is to be run or not"
	default n

config WIFI_CON_SCAN_OT_CONNECTION
	bool "Indicates test is to be run or not"
	default n

config WIFI_CON_SCAN_OT_TP_UDP_CLIENT
	bool "Indicates test is to be run or not"
	default n

config WIFI_CON_SCAN_OT_TP_UDP_SERVER
	bool "Indicates test is to be run or not"
	default n

config WIFI_CON_SCAN_OT_TP_TCP_CLIENT
	bool "Indicates test is to be run or not"
	default n

config WIFI_CON_SCAN_OT_TP_TCP_SERVER
	bool "Indicates test is to be run or not"
	default n

config WIFI_CON_OT_DISCOV
	bool "Indicates test is to be run or not"
	default n

config WIFI_CON_OT_TP_UDP_CLIENT
	bool "Indicates test is to be run or not"
	default n

config WIFI_CON_OT_TP_UDP_SERVER
	bool "Indicates test is to be run or not"
	default n

config WIFI_CON_OT_TP_TCP_CLIENT
	bool "Indicates test is to be run or not"
	default n

config WIFI_CON_OT_TP_TCP_SERVER
	bool "Indicates test is to be run or not"
	default n

config WIFI_TP_UDP_CLIENT_OT_DISCOV
	bool "Indicates test is to be run or not"
	default n

config WIFI_TP_UDP_CLIENT_OT_CONNECTION
	bool "Indicates test is to be run or not"
	default n

config WIFI_TP_UDP_CLIENT_OT_TP_UDP_CLIENT
	bool "Indicates test is to be run or not"
	default n

config WIFI_TP_UDP_CLIENT_OT_TP_UDP_SERVER
	bool "Indicates test is to be run or not"
	default n

config WIFI_TP_UDP_CLIENT_OT_TP_TCP_CLIENT
	bool "Indicates test is to be run or not"
	default n

config WIFI_TP_UDP_CLIENT_OT_TP_TCP_SERVER
	bool "Indicates test is to be run or not"
	default n

config WIFI_TP_UDP_SERVER_OT_DISCOV
	bool "Indicates test is to be run or not"
	default n
	
config WIFI_TP_UDP_SERVER_OT_CONNECTION
	bool "Indicates test is to be run or not"
	default n

config WIFI_TP_UDP_SERVER_OT_TP_UDP_CLIENT
	bool "Indicates test is to be run or not"
	default n

config WIFI_TP_UDP_SERVER_OT_TP_UDP_SERVER
	bool "Indicates test is to be run or not"
	default n

config WIFI_TP_UDP_SERVER_OT_TP_TCP_CLIENT
	bool "Indicates test is to be run or not"
	default n

config WIFI_TP_UDP_SERVER_OT_TP_TCP_SERVER
	bool "Indicates test is to be run or not"
	default n

config WIFI_TP_TCP_CLIENT_OT_DISCOV
	bool "Indicates test is to be run or not"
	default n

config WIFI_TP_TCP_CLIENT_OT_CONNECTION
	bool "Indicates test is to be run or not"
	default n

config WIFI_TP_TCP_CLIENT_OT_TP_UDP_CLIENT
	bool "Indicates test is to be run or not"
	default n

config WIFI_TP_TCP_CLIENT_OT_TP_UDP_SERVER
	bool "Indicates test is to be run or not"
	default n

config WIFI_TP_TCP_CLIENT_OT_TP_TCP_CLIENT
	bool "Indicates test is to be run or not"
	default n

config WIFI_TP_TCP_CLIENT_OT_TP_TCP_SERVER
	bool "Indicates test is to be run or not"
	default n

config WIFI_TP_TCP_SERVER_OT_DISCOV
	bool "Indicates test is to be run or not"
	default n

config WIFI_TP_TCP_SERVER_OT_CONNECTION
	bool "Indicates test is to be run or not"
	default n

config WIFI_TP_TCP_SERVER_OT_TP_UDP_CLIENT
	bool "Indicates test is to be run or not"
	default n

config WIFI_TP_TCP_SERVER_OT_TP_UDP_SERVER
	bool "Indicates test is to be run or not"
	default n

config WIFI_TP_TCP_SERVER_OT_TP_TCP_CLIENT
	bool "Indicates test is to be run or not"
	default n

config WIFI_TP_TCP_SERVER_OT_TP_TCP_SERVER
	bool "Indicates test is to be run or not"
	default n

# Wi-Fi connection stability tests
config WIFI_CON_STABILITY_OT_DISC_INTERFERENCE
	bool "Indicates test is to be run or not"
	default n

config WIFI_CON_STABILITY_OT_TP_UDP_CLIENT_INTERFERENCE
	bool "Indicates test is to be run or not"
	default n

config WIFI_CON_STABILITY_OT_TP_UDP_SERVER_INTERFERENCE
	bool "Indicates test is to be run or not"
	default n

config WIFI_CON_STABILITY_OT_TP_TCP_CLIENT_INTERFERENCE
	bool "Indicates test is to be run or not"
	default n

config WIFI_CON_STABILITY_OT_TP_TCP_SERVER_INTERFERENCE
	bool "Indicates test is to be run or not"
	default n

# Thread connection stability tests
config OT_CON_STABILITY_WIFI_SCAN_INTERFERENCE
	bool "Indicates test is to be run or not"
	default n
config OT_CON_STABILITY_WIFI_CON_SCAN_INTERFERENCE
	bool "Indicates test is to be run or not"
	default n
config OT_CON_STABILITY_WIFI_TP_UDP_CLIENT_INTERFERENCE
	bool "Indicates test is to be run or not"
	default n
config OT_CON_STABILITY_WIFI_TP_UDP_SERVER_INTERFERENCE
	bool "Indicates test is to be run or not"
	default n
config OT_CON_STABILITY_WIFI_TP_TCP_CLIENT_INTERFERENCE
	bool "Indicates test is to be run or not"
	default n
config OT_CON_STABILITY_WIFI_TP_TCP_SERVER_INTERFERENCE
	bool "Indicates test is to be run or not"
	default n

# Wi-Fi shutdown tests
config WIFI_SHUTDOWN_OT_DISCOV
	bool "Indicates test is to be run or not"
	default n
config WIFI_SHUTDOWN_OT_CONNECTION
	bool "Indicates test is to be run or not"
	default n
config WIFI_SHUTDOWN_OT_TP_UDP_CLIENT
	bool "Indicates test is to be run or not"
	default n
config WIFI_SHUTDOWN_OT_TP_UDP_SERVER
	bool "Indicates test is to be run or not"
	default n
config WIFI_SHUTDOWN_OT_TP_TCP_CLIENT
	bool "Indicates test is to be run or not"
	default n
config WIFI_SHUTDOWN_OT_TP_TCP_SERVER
	bool "Indicates test is to be run or not"
	default n
endmenu
```

## samples/wifi/thread_coex_comm_join/Kconfig
```kconfig
#
# Copyright (c) 2023 Nordic Semiconductor
#
# SPDX-License-Identifier: LicenseRef-Nordic-5-Clause
#

source "Kconfig.zephyr"

menu "Nordic Coex sample"

#------------------------------ Wi-Fi configurations
config STA_SSID
	string "SSID"
	default "wifi_sr_coex_24"
	help
	  Specify the SSID to connect

choice  STA_KEY_MGMT_SELECT
	prompt "Security Option"
	default STA_KEY_MGMT_NONE

config STA_KEY_MGMT_NONE
	bool "Open Security"
	help
	  Enable for Open Security

config STA_KEY_MGMT_WPA2
	bool "WPA2 Security"
	help
	  Enable for WPA2 Security

config STA_KEY_MGMT_WPA2_256
	bool "WPA2 SHA 256 Security"
	help
	  Enable for WPA2-PSK-256 Security

config STA_KEY_MGMT_WPA3
	bool "WPA3 Security"
	help
	  Enable for WPA3 Security
endchoice

config STA_PASSWORD
	string "Passphrase (WPA2) or password (WPA3)"
	help
	  Specify the Password to connect

config NET_CONFIG_PEER_IPV4_ADDR
	string "Peer IPv4 address"
	default "192.168.1.253"

config NET_CONFIG_PEER_IPV4_PORT
	int "Peer IPv4 port"
	default 5001

config WIFI_THREAD_STACK_SIZE
	int "Wi-Fi thread stack size"
	default 4096

config WIFI_THREAD_PRIORITY
	int "Wi-Fi thread priority"
	default 5

config WIFI_ZPERF_SERVER
	bool "Zperf role: server or client"
	default n

config WIFI_ZPERF_PROT_UDP
	bool "UDP or TCP"
	default y

config WIFI_ZPERF_PKT_SIZE
	int "packet size"
	default 1024

config WIFI_ZPERF_RATE
	int "rate in kbps"
	default 15000

config WIFI_BAND_2PT4G
	bool "Indicates if WLAN operating band is 2.4GHz or 5GHz"
	default y

#------------------------------ Thread configurations
config THREAD_ROLE_CLIENT
	bool "Thread device role"
	default y

config OT_CHANNEL
	int "Open thread operating channel"
	default 18

config OT_PAN_ID
	int "Open thread PAN ID"
	default 1

rsource "test/Kconfig"
endmenu
```

## samples/wifi/thread_coex_discovery/test/Kconfig
```kconfig
#
# Copyright (c) 2023 Nordic Semiconductor
#
# SPDX-License-Identifier: LicenseRef-Nordic-5-Clause
#

menu "Nordic Coex sample - test"

#-------------------------------------- test parameters
choice TEST_TYPE
	prompt "Test type"
	default TEST_TYPE_WLAN_THREAD

config TEST_TYPE_WLAN_ONLY
	bool "WLAN only"
	help
	  Enable WLAN only

config TEST_TYPE_THREAD_ONLY
	bool "Thread only"
	help
	  Enable Thread only

config TEST_TYPE_WLAN_THREAD
	bool "WLAN and Thread"
	help
	  Enable WLAN and Thread

endchoice

config TEST_TYPE_WLAN
	bool "WLAN"
	default y if TEST_TYPE_WLAN_ONLY || TEST_TYPE_WLAN_THREAD
	select WIFI
	help
	  Enable WLAN

config TEST_TYPE_THREAD
	bool "Thread"
	default y if TEST_TYPE_THREAD_ONLY || TEST_TYPE_WLAN_THREAD
	help
	  Enable Thread

config COEX_TEST_DURATION
	int "test duration in milliseconds"
	default 20000

config COEX_SEP_ANTENNAS
	bool "Control if the antennas are shared/serparate for Thread and WLAN"
	default y

config DEBUG_PRINT_WIFI_SCAN_INFO
	bool "Print Wi-Fi Scan info for debug purpose"
	default n

config DEBUG_PRINT_WIFI_DHCP_INFO
	bool "Print Wi-Fi DHCP info for debug purpose"
	default n

config DEBUG_PRINT_WIFI_CONN_INFO
	bool "Print Wi-Fi Connection info for debug purpose"
	default n

config PRINTS_FOR_AUTOMATION
	bool "Print info required for automation"
	default y

#-------------------------------------- test cases
config WIFI_TP_UDP_CLIENT_THREAD_TP_CLIENT
	bool "Select to run UDP Wi-FI client and Thread client"
	default n

config WIFI_TP_UDP_CLIENT_THREAD_TP_SERVER
	bool "Select to run UDP Wi-FI client and Thread server"
	default n

config WIFI_TP_UDP_SERVER_THREAD_TP_CLIENT
	bool "Select to run UDP Wi-FI server and Thread Client"
	default n

config WIFI_TP_UDP_SERVER_THREAD_TP_SERVER
	bool "Select to run UDP Wi-FI server and Thread server"
	default n

config WIFI_TP_TCP_CLIENT_THREAD_TP_CLIENT
	bool "Select to run TCP Wi-FI client and Thread Client"
	default n

config WIFI_TP_TCP_CLIENT_THREAD_TP_SERVER
	bool "Select to run TCP Wi-FI client and Thread server"
	default n

config WIFI_TP_TCP_SERVER_THREAD_TP_CLIENT
	bool "Select to run TCP Wi-FI server and Thread Client"
	default n

config WIFI_TP_TCP_SERVER_THREAD_TP_SERVER
	bool "Select to run TCP Wi-FI server and Thread server"
	default n


endmenu
```
